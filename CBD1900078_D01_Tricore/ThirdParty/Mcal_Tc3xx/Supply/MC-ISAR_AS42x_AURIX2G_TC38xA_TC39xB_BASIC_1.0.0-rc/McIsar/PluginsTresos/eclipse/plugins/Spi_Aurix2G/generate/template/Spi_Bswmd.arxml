<?xml version="1.0" encoding="UTF-8"?>
<!--
/*******************************************************************************
**                                                                            **
** Copyright (C) Infineon Technologies (2018)                                 **
**                                                                            **
** All rights reserved.                                                       **
**                                                                            **
** This document contains proprietary information belonging to Infineon       **
** Technologies. Passing on and copying of this document, and communication   **
** of its contents is not permitted without prior written authorization.      **
**                                                                            **
********************************************************************************
**                                                                            **
**  FILENAME  : Spi_Bswmd.arxml                                               **
**                                                                            **
**  VERSION   : 8.0.0                                                         **
**                                                                            **
**  DATE      : 2018-09-07                                                    **
**                                                                            **
**  VARIANT   : Variant PB                                                    **
**                                                                            **
**  PLATFORM  : Infineon AURIX2G                                              **
**                                                                            **
**  AUTHOR    : DL-AUTOSAR-Engineering                                        **
**                                                                            **
**  VENDOR    : Infineon Technologies                                         **
**                                                                            **
**  TRACEABILITY : [cover parentID={57CBEA64-43FB-4339-AC87-36C0CA20649B}]    **
**                                                                            **
**  DESCRIPTION  : Basic Software Module Description for Spi driver           **
**                                                                            **
**  [/cover]                                                                  **
**                                                                            **
**  SPECIFICATION(S) : Specification of SPI Handler Driver,                   **
**                     AUTOSAR Release 4.2.2                                  **
**                                                                            **
**  MAY BE CHANGED BY USER : no                                               **
**                                                                            **
*******************************************************************************/
-->
<!-- [cover parentID={2C8A1A6F-94CF-4d77-BB68-0FA41328ECD8}][/cover] -->
<!-- [cover parentID={F535D0DB-74FF-4854-A020-B8958BDF1737}]bmd file[/cover] -->
<!-- [cover parentID={660CAD39-E655-4dc5-AF13-A8FB1D87FA8C}]ant generator[/cover] -->

<AUTOSAR xmlns="http://autosar.org/schema/r4.0" xmlns:xsi="http://www.w3.org/2001/XMLSchema-instance" xsi:schemaLocation="http://autosar.org/schema/r4.0 AUTOSAR_4-2-2.xsd">
[!//[cover parentID={7E648580-4DAF-44af-BB9D-954E937D777D}][/cover][!//
[!//
[!//
[!NOCODE!][!//
[!INCLUDE "Spi_checks.m"!][!//
[!ENDNOCODE!][!//
[!//
[!NOCODE!][!//
[!SELECT "as:modconf('Spi')[1]"!][!//
[!//
[!IF "node:exists(./SpiGeneral/SpiMainFunctionPeriod/*[1])"!]
[!VAR "Spi_MainFunctionPeriod"="./SpiGeneral/SpiMainFunctionPeriod/*[1]"!][!//
[!ELSE!]
[!VAR "Spi_MainFunctionPeriod"="0.01"!][!//
[!ENDIF!]
[!//
[!VAR "Spi_ChannelBuffersAllowed"="SpiGeneral/SpiChannelBuffersAllowed"!][!//
[!VAR "Spi_LevelDelivered"="SpiGeneral/SpiLevelDelivered"!][!//
[!VAR "Spi_VersionInfoApi"="SpiGeneral/SpiVersionInfoApi"!][!//
[!VAR "Spi_HwStatusApi"="SpiGeneral/SpiHwStatusApi"!][!//
[!VAR "Spi_CancelApi"="SpiGeneral/SpiCancelApi"!][!//
[!VAR "SyncJobPresent" = "'TRUE'"!][!//
[!VAR "SpiSafetyEnable_Xpath" = "SpiGeneral/SpiSafetyCheckEnable"!][!//
[!//
[!IF "SpiGeneral/SpiLevelDelivered = 2"!][!//
[!VAR "SyncJobPresent" = "'FALSE'"!][!//
!// Get No of Sequences Configured
[!SELECT "SpiDriver/*[1]"!][!//
[!IF "num:i(count(SpiJob/*[SpiHwUnitSynchronous='Synchronous']) )>0"!][!//
[!IF "$SyncJobPresent = 'FALSE'"!][!//
[!VAR "SyncJobPresent" = "'TRUE'"!][!//
[!ENDIF!][!//
[!ENDIF!][!//
[!ENDSELECT!][!//
[!ENDIF!][!/* [!IF $SpiLevel = 2 */!][!//
[!//
[!VAR "Spi_MaxCore" = "num:i(ecu:get('Mcu.NoOfCoreAvailable')) - num:i(1)"!]
[!CALL "Spi_CGGenerateModuleMap", "Module" = "'SPI'"!][!//
[!CALL "Spi_CGGetCore"!]
[!CALL "Spi_CGStoreCoreConfig"!][!//

[!IF "ecu:has('Tasking.Version') and ecu:has('Tasking.Compiler.Options') and ecu:has('Tasking.Linker.Options')"!][!//
  [!VAR "TaskingCompilerOption" = "ecu:get('Tasking.Compiler.Options')"!][!//
  [!VAR "TaskingLinkerOption"   = "ecu:get('Tasking.Linker.Options')"!][!//
  [!VAR "TaskingVersion"        = "ecu:get('Tasking.Version')"!][!//
[!ELSE!]
  [!ERROR!] Tasking Options not available in Property File[!ENDERROR!][!//
[!ENDIF!]

[!IF "ecu:has('Gnuc.Version') and ecu:has('Gnuc.Compiler.Options') and ecu:has('Gnuc.Linker.Options')"!][!//
[!VAR "GnucCompilerOption" = "ecu:get('Gnuc.Compiler.Options')"!][!//
[!VAR "GnucLinkerOption"   = "ecu:get('Gnuc.Linker.Options')"!][!//
[!VAR "GnucVersion"        = "ecu:get('Gnuc.Version')"!][!//
[!ELSE!]
  [!ERROR!] GNUC Options not available in Property File[!ENDERROR!][!//
[!ENDIF!]

[!IF "ecu:has('Ghs.Version') and ecu:has('Ghs.Compiler.Options') and ecu:has('Ghs.Linker.Options')"!][!//
[!VAR "GhsCompilerOption" = "ecu:get('Ghs.Compiler.Options')"!][!//
[!VAR "GhsLinkerOption"   = "ecu:get('Ghs.Linker.Options')"!][!//
[!VAR "GhsVersion"        = "ecu:get('Ghs.Version')"!][!//
[!ELSE!]
  [!ERROR!] GHS Options not available in Property File[!ENDERROR!][!//
[!ENDIF!]

[!IF "ecu:has('Dcc.Version') and ecu:has('Dcc.Compiler.Options') and ecu:has('Dcc.Linker.Options')"!][!//
[!VAR "DccCompilerOption" = "ecu:get('Dcc.Compiler.Options')"!][!//
[!VAR "DccLinkerOption"   = "ecu:get('Dcc.Linker.Options')"!][!//
[!VAR "DccVersion"        = "ecu:get('Dcc.Version')"!][!//
[!ELSE!]
  [!ERROR!] DCC Options not available in Property File[!ENDERROR!][!//
[!ENDIF!]

[!ENDSELECT!][!//
[!ENDNOCODE!][!//
<AR-PACKAGES>
    <AR-PACKAGE>
        <SHORT-NAME>AUTOSAR_Spi</SHORT-NAME>
        <AR-PACKAGES>
            <AR-PACKAGE>
                <SHORT-NAME>BswModuleDescriptions</SHORT-NAME>
                <CATEGORY>STANDARD</CATEGORY>
                <ELEMENTS>
                    <BSW-MODULE-DESCRIPTION>
                        <SHORT-NAME>Spi</SHORT-NAME>
                        <LONG-NAME>
                            <L-4 L="EN">SPI Driver</L-4>
                        </LONG-NAME>
                        <CATEGORY>BSW_MODULE</CATEGORY>
                        <MODULE-ID>83</MODULE-ID>
                        <PROVIDED-ENTRYS>
                            <BSW-MODULE-ENTRY-REF-CONDITIONAL>
                                <BSW-MODULE-ENTRY-REF DEST="BSW-MODULE-ENTRY">/AUTOSAR_Spi/BswModuleEntrys/Spi_Init</BSW-MODULE-ENTRY-REF>
                            </BSW-MODULE-ENTRY-REF-CONDITIONAL>
[!IF "$Spi_VersionInfoApi = 'true'"!][!//
                            <BSW-MODULE-ENTRY-REF-CONDITIONAL>
                                <BSW-MODULE-ENTRY-REF DEST="BSW-MODULE-ENTRY">/AUTOSAR_Spi/BswModuleEntrys/Spi_GetVersionInfo</BSW-MODULE-ENTRY-REF>
                            </BSW-MODULE-ENTRY-REF-CONDITIONAL>
[!ENDIF!][!//
                            <BSW-MODULE-ENTRY-REF-CONDITIONAL>
                                <BSW-MODULE-ENTRY-REF DEST="BSW-MODULE-ENTRY">/AUTOSAR_Spi/BswModuleEntrys/Spi_DeInit</BSW-MODULE-ENTRY-REF>
                            </BSW-MODULE-ENTRY-REF-CONDITIONAL>
[!IF "$Spi_ChannelBuffersAllowed = 0 or $Spi_ChannelBuffersAllowed = 2"!][!//
                            <BSW-MODULE-ENTRY-REF-CONDITIONAL>
                                <BSW-MODULE-ENTRY-REF DEST="BSW-MODULE-ENTRY">/AUTOSAR_Spi/BswModuleEntrys/Spi_WriteIB</BSW-MODULE-ENTRY-REF>
                            </BSW-MODULE-ENTRY-REF-CONDITIONAL>
                            <BSW-MODULE-ENTRY-REF-CONDITIONAL>
                                <BSW-MODULE-ENTRY-REF DEST="BSW-MODULE-ENTRY">/AUTOSAR_Spi/BswModuleEntrys/Spi_ReadIB</BSW-MODULE-ENTRY-REF>
                            </BSW-MODULE-ENTRY-REF-CONDITIONAL>
[!ENDIF!][!//
[!IF "$Spi_LevelDelivered = 1 or $Spi_LevelDelivered = 2"!][!//
                            <BSW-MODULE-ENTRY-REF-CONDITIONAL>
                                <BSW-MODULE-ENTRY-REF DEST="BSW-MODULE-ENTRY">/AUTOSAR_Spi/BswModuleEntrys/Spi_AsyncTransmit</BSW-MODULE-ENTRY-REF>
                            </BSW-MODULE-ENTRY-REF-CONDITIONAL>
[!ENDIF!][!//

[!IF "$Spi_ChannelBuffersAllowed = 1 or $Spi_ChannelBuffersAllowed = 2"!][!//
                            <BSW-MODULE-ENTRY-REF-CONDITIONAL>
                                <BSW-MODULE-ENTRY-REF DEST="BSW-MODULE-ENTRY">/AUTOSAR_Spi/BswModuleEntrys/Spi_SetupEB</BSW-MODULE-ENTRY-REF>
                            </BSW-MODULE-ENTRY-REF-CONDITIONAL>
[!ENDIF!][!//
                            <BSW-MODULE-ENTRY-REF-CONDITIONAL>
                                <BSW-MODULE-ENTRY-REF DEST="BSW-MODULE-ENTRY">/AUTOSAR_Spi/BswModuleEntrys/Spi_GetStatus</BSW-MODULE-ENTRY-REF>
                            </BSW-MODULE-ENTRY-REF-CONDITIONAL>
                            <BSW-MODULE-ENTRY-REF-CONDITIONAL>
                                <BSW-MODULE-ENTRY-REF DEST="BSW-MODULE-ENTRY">/AUTOSAR_Spi/BswModuleEntrys/Spi_GetJobResult</BSW-MODULE-ENTRY-REF>
                            </BSW-MODULE-ENTRY-REF-CONDITIONAL>
                            <BSW-MODULE-ENTRY-REF-CONDITIONAL>
                                <BSW-MODULE-ENTRY-REF DEST="BSW-MODULE-ENTRY">/AUTOSAR_Spi/BswModuleEntrys/Spi_GetSequenceResult</BSW-MODULE-ENTRY-REF>
                            </BSW-MODULE-ENTRY-REF-CONDITIONAL>
[!IF "($Spi_LevelDelivered = 0 or $Spi_LevelDelivered = 2) and $SyncJobPresent = 'TRUE'"!][!//
                            <BSW-MODULE-ENTRY-REF-CONDITIONAL>
                                <BSW-MODULE-ENTRY-REF DEST="BSW-MODULE-ENTRY">/AUTOSAR_Spi/BswModuleEntrys/Spi_SyncTransmit</BSW-MODULE-ENTRY-REF>
                            </BSW-MODULE-ENTRY-REF-CONDITIONAL>
[!ENDIF!][!//
[!IF "$Spi_HwStatusApi = 'true'"!][!//
                            <BSW-MODULE-ENTRY-REF-CONDITIONAL>
                                <BSW-MODULE-ENTRY-REF DEST="BSW-MODULE-ENTRY">/AUTOSAR_Spi/BswModuleEntrys/Spi_GetHWUnitStatus</BSW-MODULE-ENTRY-REF>
                            </BSW-MODULE-ENTRY-REF-CONDITIONAL>
[!ENDIF!][!//
[!IF "$Spi_CancelApi = 'true'"!][!//
                            <BSW-MODULE-ENTRY-REF-CONDITIONAL>
                                <BSW-MODULE-ENTRY-REF DEST="BSW-MODULE-ENTRY">/AUTOSAR_Spi/BswModuleEntrys/Spi_Cancel</BSW-MODULE-ENTRY-REF>
                            </BSW-MODULE-ENTRY-REF-CONDITIONAL>
[!ENDIF!][!//
[!IF "($Spi_LevelDelivered = 2)"!][!//
                            <BSW-MODULE-ENTRY-REF-CONDITIONAL>
                                <BSW-MODULE-ENTRY-REF DEST="BSW-MODULE-ENTRY">/AUTOSAR_Spi/BswModuleEntrys/Spi_SetAsyncMode</BSW-MODULE-ENTRY-REF>
                            </BSW-MODULE-ENTRY-REF-CONDITIONAL>
[!ENDIF!][!//
[!IF "($Spi_LevelDelivered = 1 or $Spi_LevelDelivered = 2)"!][!//
                            <BSW-MODULE-ENTRY-REF-CONDITIONAL>
                                <BSW-MODULE-ENTRY-REF DEST="BSW-MODULE-ENTRY">/AUTOSAR_Spi/BswModuleEntrys/Spi_IsrQspiPT2</BSW-MODULE-ENTRY-REF>
                            </BSW-MODULE-ENTRY-REF-CONDITIONAL>
[!ENDIF!][!//
[!IF "($Spi_LevelDelivered = 1 or $Spi_LevelDelivered = 2)"!][!//
                            <BSW-MODULE-ENTRY-REF-CONDITIONAL>
                                <BSW-MODULE-ENTRY-REF DEST="BSW-MODULE-ENTRY">/AUTOSAR_Spi/BswModuleEntrys/Spi_IsrQspiError</BSW-MODULE-ENTRY-REF>
                            </BSW-MODULE-ENTRY-REF-CONDITIONAL>
[!ENDIF!][!//
                            <BSW-MODULE-ENTRY-REF-CONDITIONAL>
                                <BSW-MODULE-ENTRY-REF DEST="BSW-MODULE-ENTRY">/AUTOSAR_Spi/BswModuleEntrys/Spi_QspiDmaCallout</BSW-MODULE-ENTRY-REF>
                            </BSW-MODULE-ENTRY-REF-CONDITIONAL>
                            <BSW-MODULE-ENTRY-REF-CONDITIONAL>
                                <BSW-MODULE-ENTRY-REF DEST="BSW-MODULE-ENTRY">/AUTOSAR_Spi/BswModuleEntrys/Spi_QspiDmaErrCallout</BSW-MODULE-ENTRY-REF>
                            </BSW-MODULE-ENTRY-REF-CONDITIONAL>
[!IF "$Spi_LevelDelivered = 2"!][!//
                            <BSW-MODULE-ENTRY-REF-CONDITIONAL>
                                <BSW-MODULE-ENTRY-REF DEST="BSW-MODULE-ENTRY">/AUTOSAR_Spi/BswModuleEntrys/Spi_MainFunction_Handling</BSW-MODULE-ENTRY-REF>
                            </BSW-MODULE-ENTRY-REF-CONDITIONAL>
[!ENDIF!][!//
                        </PROVIDED-ENTRYS>
                        <BSW-MODULE-DEPENDENCYS>
                            <BSW-MODULE-DEPENDENCY>
                              <SHORT-NAME>DetDependency</SHORT-NAME>
                              <TARGET-MODULE-ID>15</TARGET-MODULE-ID>
                              <REQUIRED-ENTRYS>
                                <BSW-MODULE-ENTRY-REF-CONDITIONAL>
                                  <BSW-MODULE-ENTRY-REF DEST="BSW-MODULE-ENTRY">/AUTOSAR_Det/BswModuleEntrys/Det_ReportError</BSW-MODULE-ENTRY-REF>
                                </BSW-MODULE-ENTRY-REF-CONDITIONAL>
                              </REQUIRED-ENTRYS>
                            </BSW-MODULE-DEPENDENCY>
                            <BSW-MODULE-DEPENDENCY>
                              <SHORT-NAME>DemDependency</SHORT-NAME>
                              <TARGET-MODULE-ID>54</TARGET-MODULE-ID>
                              <REQUIRED-ENTRYS>
                                <BSW-MODULE-ENTRY-REF-CONDITIONAL>
                                  <BSW-MODULE-ENTRY-REF DEST="BSW-MODULE-ENTRY">/AUTOSAR_Dem/BswModuleEntrys/Dem_ReportErrorStatus</BSW-MODULE-ENTRY-REF>
                                </BSW-MODULE-ENTRY-REF-CONDITIONAL>
                              </REQUIRED-ENTRYS>
                            </BSW-MODULE-DEPENDENCY>
                            <BSW-MODULE-DEPENDENCY>
                              <SHORT-NAME>McalLibDependency</SHORT-NAME>
                              <TARGET-MODULE-ID>255</TARGET-MODULE-ID>
                              <REQUIRED-ENTRYS>
                                <BSW-MODULE-ENTRY-REF-CONDITIONAL>
                                  <BSW-MODULE-ENTRY-REF DEST="BSW-MODULE-ENTRY">/AUTOSAR_McalLib/BswModuleEntrys/Mcal_WritePeripEndInitProtReg</BSW-MODULE-ENTRY-REF>
                                </BSW-MODULE-ENTRY-REF-CONDITIONAL>
                              </REQUIRED-ENTRYS>
                            </BSW-MODULE-DEPENDENCY>
[!IF "$SpiSafetyEnable_Xpath = 'true'"!][!//
                            <BSW-MODULE-DEPENDENCY>
                              <SHORT-NAME>McalSafetyErrorDependency</SHORT-NAME>
                              <TARGET-MODULE-ID>255</TARGET-MODULE-ID>
                              <REQUIRED-ENTRYS>
                                <BSW-MODULE-ENTRY-REF-CONDITIONAL>
                                  <BSW-MODULE-ENTRY-REF DEST="BSW-MODULE-ENTRY">/AUTOSAR_SafetyError/BswModuleEntrys/Mcal_ReportSafetyError</BSW-MODULE-ENTRY-REF>
                                </BSW-MODULE-ENTRY-REF-CONDITIONAL>
                              </REQUIRED-ENTRYS>
                            </BSW-MODULE-DEPENDENCY>
[!ENDIF!][!//
[!IF "($Spi_LevelDelivered = 1 or $Spi_LevelDelivered = 2)"!][!//
                            <BSW-MODULE-DEPENDENCY>
                              <SHORT-NAME>DmaDependency</SHORT-NAME>
                              <TARGET-MODULE-ID>101</TARGET-MODULE-ID>
                              <EXPECTED-CALLBACKS>
                                <BSW-MODULE-ENTRY-REF-CONDITIONAL>
                                  <BSW-MODULE-ENTRY-REF DEST="BSW-MODULE-ENTRY">/AUTOSAR_Dma/BswModuleEntrys/Spi_QspiDmaCallout</BSW-MODULE-ENTRY-REF>
                                </BSW-MODULE-ENTRY-REF-CONDITIONAL>
                              </EXPECTED-CALLBACKS>
                            </BSW-MODULE-DEPENDENCY>
[!ENDIF!][!//
                        </BSW-MODULE-DEPENDENCYS>
                        <INTERNAL-BEHAVIORS>
                          <BSW-INTERNAL-BEHAVIOR>
                            <SHORT-NAME>SpiBehavior</SHORT-NAME>
                            <EXCLUSIVE-AREAS>
[!IF "$Spi_ChannelBuffersAllowed = 0 or $Spi_ChannelBuffersAllowed = 2"!][!//
                              <EXCLUSIVE-AREA>
                                <SHORT-NAME>ChannelLock</SHORT-NAME>
                                <INTRODUCTION><NOTE SI="The user should implement the SchM interfaces defined in SchM_Spi.c as either suspend and resume of CPU global interrupt or suspend and resume of Spi interrupts. Other possible methods should also be analyzed. User should carefully analyze for the side effects of such types of implementation. Common techniques like saverestore of interrupt enable status may be implemented to have a consistent behavior." NOTE-TYPE="HINT"/></INTRODUCTION>
                              </EXCLUSIVE-AREA>
[!ENDIF!][!//
[!IF "($Spi_LevelDelivered = 0 or $Spi_LevelDelivered = 2) and $SyncJobPresent = 'TRUE'"!][!//
                              <EXCLUSIVE-AREA>
                                <SHORT-NAME>SyncLock</SHORT-NAME>
                                <INTRODUCTION><NOTE SI="The user should implement the SchM interfaces defined in SchM_Spi.c as either suspend and resume of CPU global interrupt or suspend and resume of Spi interrupts. Other possible methods should also be analyzed. User should carefully analyze for the side effects of such types of implementation. Common techniques like saverestore of interrupt enable status may be implemented to have a consistent behavior." NOTE-TYPE="HINT"/></INTRODUCTION>
                              </EXCLUSIVE-AREA>
[!ENDIF!][!//
                              <EXCLUSIVE-AREA>
                                <SHORT-NAME>Queue_Update</SHORT-NAME>
                                <INTRODUCTION><NOTE SI="The user should implement the SchM interfaces defined in SchM_Spi.c as either suspend and resume of CPU global interrupt or suspend and resume of Spi interrupts. Other possible methods should also be analyzed. User should carefully analyze for the side effects of such types of implementation. Common techniques like saverestore of interrupt enable status may be implemented to have a consistent behavior." NOTE-TYPE="HINT"/></INTRODUCTION>
                              </EXCLUSIVE-AREA>
                            </EXCLUSIVE-AREAS>
                            <ENTITYS>
                              <BSW-CALLED-ENTITY>
                                <SHORT-NAME>Spi_Init</SHORT-NAME>
                                <REENTRANCY-LEVEL>NON-REENTRANT</REENTRANCY-LEVEL>
                                <IMPLEMENTED-ENTRY-REF DEST="BSW-MODULE-ENTRY">/AUTOSAR_Spi/BswModuleEntrys/Spi_Init</IMPLEMENTED-ENTRY-REF>
                              </BSW-CALLED-ENTITY>
[!IF "$Spi_VersionInfoApi = 'true'"!][!//
                              <BSW-CALLED-ENTITY>
                                <SHORT-NAME>Spi_GetVersionInfo</SHORT-NAME>
                                <REENTRANCY-LEVEL>MULTICORE-REENTRANT</REENTRANCY-LEVEL>
                                <IMPLEMENTED-ENTRY-REF DEST="BSW-MODULE-ENTRY">/AUTOSAR_Spi/BswModuleEntrys/Spi_GetVersionInfo</IMPLEMENTED-ENTRY-REF>
                              </BSW-CALLED-ENTITY>
[!ENDIF!][!//
                              <BSW-CALLED-ENTITY>
                                <SHORT-NAME>Spi_DeInit</SHORT-NAME>
                                <REENTRANCY-LEVEL>NON-REENTRANT</REENTRANCY-LEVEL>
                                <IMPLEMENTED-ENTRY-REF DEST="BSW-MODULE-ENTRY">/AUTOSAR_Spi/BswModuleEntrys/Spi_DeInit</IMPLEMENTED-ENTRY-REF>
                              </BSW-CALLED-ENTITY>
[!IF "$Spi_ChannelBuffersAllowed = 0 or $Spi_ChannelBuffersAllowed = 2"!][!//
                              <BSW-CALLED-ENTITY>
                                <SHORT-NAME>Spi_WriteIB</SHORT-NAME>
                                <CAN-ENTER-EXCLUSIVE-AREA-REFS>
                                  <CAN-ENTER-EXCLUSIVE-AREA-REF DEST="EXCLUSIVE-AREA">/AUTOSAR_Spi/BswModuleDescriptions/Spi/SpiBehavior/ChannelLock</CAN-ENTER-EXCLUSIVE-AREA-REF>
                                </CAN-ENTER-EXCLUSIVE-AREA-REFS>
                                <REENTRANCY-LEVEL>MULTICORE-REENTRANT</REENTRANCY-LEVEL>
                                <IMPLEMENTED-ENTRY-REF DEST="BSW-MODULE-ENTRY">/AUTOSAR_Spi/BswModuleEntrys/Spi_WriteIB</IMPLEMENTED-ENTRY-REF>
                              </BSW-CALLED-ENTITY>
                              <BSW-CALLED-ENTITY>
                                <SHORT-NAME>Spi_ReadIB</SHORT-NAME>
                                <REENTRANCY-LEVEL>MULTICORE-REENTRANT</REENTRANCY-LEVEL>
                                <IMPLEMENTED-ENTRY-REF DEST="BSW-MODULE-ENTRY">/AUTOSAR_Spi/BswModuleEntrys/Spi_ReadIB</IMPLEMENTED-ENTRY-REF>
                              </BSW-CALLED-ENTITY>
[!ENDIF!][!//
[!IF "$Spi_LevelDelivered = 1 or $Spi_LevelDelivered = 2"!][!//
                              <BSW-CALLED-ENTITY>
                                <SHORT-NAME>Spi_AsyncTransmit</SHORT-NAME>
                                <CAN-ENTER-EXCLUSIVE-AREA-REFS>
                                  <CAN-ENTER-EXCLUSIVE-AREA-REF DEST="EXCLUSIVE-AREA">/AUTOSAR_Spi/BswModuleDescriptions/Spi/SpiBehavior/Queue_Update</CAN-ENTER-EXCLUSIVE-AREA-REF>
                                </CAN-ENTER-EXCLUSIVE-AREA-REFS>
                                <REENTRANCY-LEVEL>MULTICORE-REENTRANT</REENTRANCY-LEVEL>
                                <IMPLEMENTED-ENTRY-REF DEST="BSW-MODULE-ENTRY">/AUTOSAR_Spi/BswModuleEntrys/Spi_AsyncTransmit</IMPLEMENTED-ENTRY-REF>
                              </BSW-CALLED-ENTITY>
[!ENDIF!][!//
[!IF "$Spi_ChannelBuffersAllowed = 1 or $Spi_ChannelBuffersAllowed = 2"!][!//
                              <BSW-CALLED-ENTITY>
                                <SHORT-NAME>Spi_SetupEB</SHORT-NAME>
                                <REENTRANCY-LEVEL>MULTICORE-REENTRANT</REENTRANCY-LEVEL>
                                <IMPLEMENTED-ENTRY-REF DEST="BSW-MODULE-ENTRY">/AUTOSAR_Spi/BswModuleEntrys/Spi_SetupEB</IMPLEMENTED-ENTRY-REF>
                              </BSW-CALLED-ENTITY>
[!ENDIF!][!//
                              <BSW-CALLED-ENTITY>
                                <SHORT-NAME>Spi_GetStatus</SHORT-NAME>
                                <REENTRANCY-LEVEL>MULTICORE-REENTRANT</REENTRANCY-LEVEL>
                                <IMPLEMENTED-ENTRY-REF DEST="BSW-MODULE-ENTRY">/AUTOSAR_Spi/BswModuleEntrys/Spi_GetStatus</IMPLEMENTED-ENTRY-REF>
                              </BSW-CALLED-ENTITY>
                              <BSW-CALLED-ENTITY>
                                <SHORT-NAME>Spi_GetJobResult</SHORT-NAME>
                                <REENTRANCY-LEVEL>MULTICORE-REENTRANT</REENTRANCY-LEVEL>
                                <IMPLEMENTED-ENTRY-REF DEST="BSW-MODULE-ENTRY">/AUTOSAR_Spi/BswModuleEntrys/Spi_GetJobResult</IMPLEMENTED-ENTRY-REF>
                              </BSW-CALLED-ENTITY>
                              <BSW-CALLED-ENTITY>
                                <SHORT-NAME>Spi_GetSequenceResult</SHORT-NAME>
                                <REENTRANCY-LEVEL>MULTICORE-REENTRANT</REENTRANCY-LEVEL>
                                <IMPLEMENTED-ENTRY-REF DEST="BSW-MODULE-ENTRY">/AUTOSAR_Spi/BswModuleEntrys/Spi_GetSequenceResult</IMPLEMENTED-ENTRY-REF>
                              </BSW-CALLED-ENTITY>
[!IF "($Spi_LevelDelivered = 0 or $Spi_LevelDelivered = 2) and $SyncJobPresent = 'TRUE'"!][!//
                              <BSW-CALLED-ENTITY>
                                <SHORT-NAME>Spi_SyncTransmit</SHORT-NAME>
                                <CAN-ENTER-EXCLUSIVE-AREA-REFS>
                                  <CAN-ENTER-EXCLUSIVE-AREA-REF DEST="EXCLUSIVE-AREA">/AUTOSAR_Spi/BswModuleDescriptions/Spi/SpiBehavior/SyncLock</CAN-ENTER-EXCLUSIVE-AREA-REF>
                                </CAN-ENTER-EXCLUSIVE-AREA-REFS>
                                <REENTRANCY-LEVEL>MULTICORE-REENTRANT</REENTRANCY-LEVEL>
                                <IMPLEMENTED-ENTRY-REF DEST="BSW-MODULE-ENTRY">/AUTOSAR_Spi/BswModuleEntrys/Spi_SyncTransmit</IMPLEMENTED-ENTRY-REF>
                              </BSW-CALLED-ENTITY>
[!ENDIF!][!//
[!IF "$Spi_HwStatusApi = 'true'"!][!//
                              <BSW-CALLED-ENTITY>
                                <SHORT-NAME>Spi_GetHWUnitStatus</SHORT-NAME>
                                <REENTRANCY-LEVEL>MULTICORE-REENTRANT</REENTRANCY-LEVEL>
                                <IMPLEMENTED-ENTRY-REF DEST="BSW-MODULE-ENTRY">/AUTOSAR_Spi/BswModuleEntrys/Spi_GetHWUnitStatus</IMPLEMENTED-ENTRY-REF>
                              </BSW-CALLED-ENTITY>
[!ENDIF!][!//
[!IF "$Spi_CancelApi = 'true'"!][!//
                              <BSW-CALLED-ENTITY>
                                <SHORT-NAME>Spi_Cancel</SHORT-NAME>
                                <CAN-ENTER-EXCLUSIVE-AREA-REFS>
                                  <CAN-ENTER-EXCLUSIVE-AREA-REF DEST="EXCLUSIVE-AREA">/AUTOSAR_Spi/BswModuleDescriptions/Spi/SpiBehavior/Queue_Update</CAN-ENTER-EXCLUSIVE-AREA-REF>
                                </CAN-ENTER-EXCLUSIVE-AREA-REFS>
                                <REENTRANCY-LEVEL>MULTICORE-REENTRANT</REENTRANCY-LEVEL>
                                <IMPLEMENTED-ENTRY-REF DEST="BSW-MODULE-ENTRY">/AUTOSAR_Spi/BswModuleEntrys/Spi_Cancel</IMPLEMENTED-ENTRY-REF>
                              </BSW-CALLED-ENTITY>
[!ENDIF!][!//
[!IF "$Spi_LevelDelivered = 2"!][!//
                              <BSW-CALLED-ENTITY>
                                <SHORT-NAME>Spi_SetAsyncMode</SHORT-NAME>
                                <REENTRANCY-LEVEL>NON-REENTRANT</REENTRANCY-LEVEL>
                                <IMPLEMENTED-ENTRY-REF DEST="BSW-MODULE-ENTRY">/AUTOSAR_Spi/BswModuleEntrys/Spi_SetAsyncMode</IMPLEMENTED-ENTRY-REF>
                              </BSW-CALLED-ENTITY>
[!ENDIF!][!//
[!IF "$Spi_LevelDelivered = 2"!][!//
                              <BSW-SCHEDULABLE-ENTITY>
                                <SHORT-NAME>Spi_MainFunction_Handling</SHORT-NAME>
                                <MINIMUM-START-INTERVAL>[!"num:f($Spi_MainFunctionPeriod)"!]</MINIMUM-START-INTERVAL>
                                <REENTRANCY-LEVEL>NON-REENTRANT</REENTRANCY-LEVEL>
                                <IMPLEMENTED-ENTRY-REF DEST="BSW-MODULE-ENTRY">/AUTOSAR_Spi/BswModuleEntrys/Spi_MainFunction_Handling</IMPLEMENTED-ENTRY-REF>
                              </BSW-SCHEDULABLE-ENTITY>
[!ENDIF!][!//
[!IF "$Spi_LevelDelivered != 0"!][!//
                              <BSW-INTERRUPT-ENTITY>
                                <SHORT-NAME>Spi_IsrQspiPT2</SHORT-NAME>
                                <CAN-ENTER-EXCLUSIVE-AREA-REFS>
                                  <CAN-ENTER-EXCLUSIVE-AREA-REF DEST="EXCLUSIVE-AREA">/AUTOSAR_Spi/BswModuleDescriptions/Spi/SpiBehavior/Queue_Update</CAN-ENTER-EXCLUSIVE-AREA-REF>
                                </CAN-ENTER-EXCLUSIVE-AREA-REFS>
                                <REENTRANCY-LEVEL>NON-REENTRANT</REENTRANCY-LEVEL>
                                <IMPLEMENTED-ENTRY-REF DEST="BSW-MODULE-ENTRY">/AUTOSAR_Spi/BswModuleEntrys/Spi_IsrQspiPT2</IMPLEMENTED-ENTRY-REF>
                              </BSW-INTERRUPT-ENTITY>
[!ENDIF!][!//
[!IF "$Spi_LevelDelivered != 0"!][!//
                              <BSW-INTERRUPT-ENTITY>
                                <SHORT-NAME>Spi_IsrQspiError</SHORT-NAME>
                                <REENTRANCY-LEVEL>NON-REENTRANT</REENTRANCY-LEVEL>
                                <IMPLEMENTED-ENTRY-REF DEST="BSW-MODULE-ENTRY">/AUTOSAR_Spi/BswModuleEntrys/Spi_IsrQspiError</IMPLEMENTED-ENTRY-REF>
                              </BSW-INTERRUPT-ENTITY>
[!ENDIF!][!//
                              <BSW-CALLED-ENTITY>
                                <SHORT-NAME>Spi_QspiDmaCallout</SHORT-NAME>
                                <REENTRANCY-LEVEL>NON-REENTRANT</REENTRANCY-LEVEL>
                                <IMPLEMENTED-ENTRY-REF DEST="BSW-MODULE-ENTRY">/AUTOSAR_Spi/BswModuleEntrys/Spi_QspiDmaCallout</IMPLEMENTED-ENTRY-REF>
                              </BSW-CALLED-ENTITY>
                              <BSW-CALLED-ENTITY>
                                <SHORT-NAME>Spi_QspiDmaErrCallout</SHORT-NAME>
                                <REENTRANCY-LEVEL>NON-REENTRANT</REENTRANCY-LEVEL>
                                <IMPLEMENTED-ENTRY-REF DEST="BSW-MODULE-ENTRY">/AUTOSAR_Spi/BswModuleEntrys/Spi_QspiDmaErrCallout</IMPLEMENTED-ENTRY-REF>
                              </BSW-CALLED-ENTITY>
                            </ENTITYS>
                            <EVENTS>
[!IF "$Spi_LevelDelivered = 2"!][!//
                                <BSW-TIMING-EVENT>
                                    <SHORT-NAME>TimingEvent_Spi_MainFunction_Handling</SHORT-NAME>
                                    <STARTS-ON-EVENT-REF DEST="BSW-SCHEDULABLE-ENTITY">/AUTOSAR_Spi/BswModuleDescriptions/Spi/SpiBehavior/Spi_MainFunction_Handling</STARTS-ON-EVENT-REF>
                                    <PERIOD>[!"num:f($Spi_MainFunctionPeriod)"!]</PERIOD>
                                </BSW-TIMING-EVENT>
[!ENDIF!][!//
                            </EVENTS>
                            <SERVICE-DEPENDENCYS>
                              <BSW-SERVICE-DEPENDENCY>
                                <SERVICE-NEEDS>
                                  <DIAGNOSTIC-EVENT-NEEDS>
                                    <SHORT-NAME>SPI_E_HARDWARE_ERROR</SHORT-NAME>
                                  </DIAGNOSTIC-EVENT-NEEDS>
                                </SERVICE-NEEDS>
                              </BSW-SERVICE-DEPENDENCY>
                            </SERVICE-DEPENDENCYS>
                          </BSW-INTERNAL-BEHAVIOR>
                        </INTERNAL-BEHAVIORS>
                    </BSW-MODULE-DESCRIPTION>
                </ELEMENTS>
            </AR-PACKAGE>
            <AR-PACKAGE>
                <SHORT-NAME>BswModuleEntrys</SHORT-NAME>
                <CATEGORY>STANDARD</CATEGORY>
                <ELEMENTS>
                    <BSW-MODULE-ENTRY>
                        <SHORT-NAME>Spi_Init</SHORT-NAME>
                        <SERVICE-ID>0</SERVICE-ID>
                        <IS-REENTRANT>false</IS-REENTRANT>
                        <IS-SYNCHRONOUS>true</IS-SYNCHRONOUS>
                        <CALL-TYPE>REGULAR</CALL-TYPE>
                        <EXECUTION-CONTEXT>TASK</EXECUTION-CONTEXT>
                        <SW-SERVICE-IMPL-POLICY>STANDARD</SW-SERVICE-IMPL-POLICY>
                        <ARGUMENTS>
                          <SW-SERVICE-ARG>
                            <SHORT-NAME>ConfigPtr</SHORT-NAME>
                            <CATEGORY>DATA_REFERENCE</CATEGORY>
                            <SW-DATA-DEF-PROPS>
                              <SW-DATA-DEF-PROPS-VARIANTS>
                                <SW-DATA-DEF-PROPS-CONDITIONAL>
                                <SW-POINTER-TARGET-PROPS>
                                <TARGET-CATEGORY>TYPE_REFERENCE</TARGET-CATEGORY>
                                <SW-DATA-DEF-PROPS>
                                <SW-DATA-DEF-PROPS-VARIANTS>
                                <SW-DATA-DEF-PROPS-CONDITIONAL>
                                <IMPLEMENTATION-DATA-TYPE-REF DEST = "IMPLEMENTATION-DATA-TYPE">/AUTOSAR_Spi/ImplementationDataTypes/Spi_ConfigType</IMPLEMENTATION-DATA-TYPE-REF>
                                </SW-DATA-DEF-PROPS-CONDITIONAL>
                                </SW-DATA-DEF-PROPS-VARIANTS>
                                </SW-DATA-DEF-PROPS>
                                </SW-POINTER-TARGET-PROPS>
                                </SW-DATA-DEF-PROPS-CONDITIONAL>
                              </SW-DATA-DEF-PROPS-VARIANTS>
                            </SW-DATA-DEF-PROPS>
                          </SW-SERVICE-ARG>
                        </ARGUMENTS>
                    </BSW-MODULE-ENTRY>
[!IF "$Spi_VersionInfoApi = 'true'"!][!//
                    <BSW-MODULE-ENTRY>
                        <SHORT-NAME>Spi_GetVersionInfo</SHORT-NAME>
                        <SERVICE-ID>9</SERVICE-ID>
                        <IS-REENTRANT>true</IS-REENTRANT>
                        <IS-SYNCHRONOUS>true</IS-SYNCHRONOUS>
                        <CALL-TYPE>REGULAR</CALL-TYPE>
                        <EXECUTION-CONTEXT>TASK</EXECUTION-CONTEXT>
                        <SW-SERVICE-IMPL-POLICY>MACRO</SW-SERVICE-IMPL-POLICY>
                        <ARGUMENTS>
                          <SW-SERVICE-ARG>
                            <SHORT-NAME>VersionInfoPtr</SHORT-NAME>
                            <CATEGORY>DATA_REFERENCE</CATEGORY>
                            <SW-DATA-DEF-PROPS>
                              <SW-DATA-DEF-PROPS-VARIANTS>
                                <SW-DATA-DEF-PROPS-CONDITIONAL>
                                <SW-POINTER-TARGET-PROPS>
                                <TARGET-CATEGORY>TYPE_REFERENCE</TARGET-CATEGORY>
                                <SW-DATA-DEF-PROPS>
                                <SW-DATA-DEF-PROPS-VARIANTS>
                                <SW-DATA-DEF-PROPS-CONDITIONAL>
                                <IMPLEMENTATION-DATA-TYPE-REF DEST = "IMPLEMENTATION-DATA-TYPE">/AUTOSAR_StdTypes/ImplementationDataTypes/Std_VersionInfoType</IMPLEMENTATION-DATA-TYPE-REF>
                                </SW-DATA-DEF-PROPS-CONDITIONAL>
                                </SW-DATA-DEF-PROPS-VARIANTS>
                                </SW-DATA-DEF-PROPS>
                                </SW-POINTER-TARGET-PROPS>
                                </SW-DATA-DEF-PROPS-CONDITIONAL>
                              </SW-DATA-DEF-PROPS-VARIANTS>
                            </SW-DATA-DEF-PROPS>
                          </SW-SERVICE-ARG>
                        </ARGUMENTS>
                    </BSW-MODULE-ENTRY>
[!ENDIF!][!//
                    <BSW-MODULE-ENTRY>
                        <SHORT-NAME>Spi_DeInit</SHORT-NAME>
                        <SERVICE-ID>1</SERVICE-ID>
                        <IS-REENTRANT>false</IS-REENTRANT>
                        <IS-SYNCHRONOUS>true</IS-SYNCHRONOUS>
                        <CALL-TYPE>REGULAR</CALL-TYPE>
                        <EXECUTION-CONTEXT>TASK</EXECUTION-CONTEXT>
                        <SW-SERVICE-IMPL-POLICY>STANDARD</SW-SERVICE-IMPL-POLICY>
                        <RETURN-TYPE>
                          <SHORT-NAME>Return</SHORT-NAME>
                          <SW-DATA-DEF-PROPS>
                            <SW-DATA-DEF-PROPS-VARIANTS>
                              <SW-DATA-DEF-PROPS-CONDITIONAL>
                                <IMPLEMENTATION-DATA-TYPE-REF DEST = "IMPLEMENTATION-DATA-TYPE">/AUTOSAR_StdTypes/ImplementationDataTypes/Std_ReturnType</IMPLEMENTATION-DATA-TYPE-REF>
                              </SW-DATA-DEF-PROPS-CONDITIONAL>
                            </SW-DATA-DEF-PROPS-VARIANTS>
                          </SW-DATA-DEF-PROPS>
                        </RETURN-TYPE>
                    </BSW-MODULE-ENTRY>
[!IF "$Spi_ChannelBuffersAllowed = 0 or $Spi_ChannelBuffersAllowed = 2"!][!//
                    <BSW-MODULE-ENTRY>
                        <SHORT-NAME>Spi_WriteIB</SHORT-NAME>
                        <INTRODUCTION>
                            <NOTE SI="Spi_WriteIB is reentrant for different channel or core" NOTE-TYPE="HINT" />
                        </INTRODUCTION>
                        <SERVICE-ID>2</SERVICE-ID>
                        <IS-REENTRANT>true</IS-REENTRANT>
                        <IS-SYNCHRONOUS>true</IS-SYNCHRONOUS>
                        <CALL-TYPE>REGULAR</CALL-TYPE>
                        <EXECUTION-CONTEXT>TASK</EXECUTION-CONTEXT>
                        <SW-SERVICE-IMPL-POLICY>STANDARD</SW-SERVICE-IMPL-POLICY>
                        <RETURN-TYPE>
                          <SHORT-NAME>Return</SHORT-NAME>
                          <SW-DATA-DEF-PROPS>
                            <SW-DATA-DEF-PROPS-VARIANTS>
                              <SW-DATA-DEF-PROPS-CONDITIONAL>
                                <IMPLEMENTATION-DATA-TYPE-REF DEST = "IMPLEMENTATION-DATA-TYPE">/AUTOSAR_StdTypes/ImplementationDataTypes/Std_ReturnType</IMPLEMENTATION-DATA-TYPE-REF>
                              </SW-DATA-DEF-PROPS-CONDITIONAL>
                            </SW-DATA-DEF-PROPS-VARIANTS>
                          </SW-DATA-DEF-PROPS>
                        </RETURN-TYPE>
                        <ARGUMENTS>
                          <SW-SERVICE-ARG>
                            <SHORT-NAME>Channel</SHORT-NAME>
                            <SW-DATA-DEF-PROPS>
                              <SW-DATA-DEF-PROPS-VARIANTS>
                                <SW-DATA-DEF-PROPS-CONDITIONAL>
                                <IMPLEMENTATION-DATA-TYPE-REF DEST = "IMPLEMENTATION-DATA-TYPE">/AUTOSAR_Spi/ImplementationDataTypes/Spi_ChannelType</IMPLEMENTATION-DATA-TYPE-REF>
                                </SW-DATA-DEF-PROPS-CONDITIONAL>
                              </SW-DATA-DEF-PROPS-VARIANTS>
                            </SW-DATA-DEF-PROPS>
                          </SW-SERVICE-ARG>
                          <SW-SERVICE-ARG>
                            <SHORT-NAME>DataBufferPtr</SHORT-NAME>
                            <CATEGORY>DATA_REFERENCE</CATEGORY>
                            <SW-DATA-DEF-PROPS>
                              <SW-DATA-DEF-PROPS-VARIANTS>
                                <SW-DATA-DEF-PROPS-CONDITIONAL>
                                <SW-POINTER-TARGET-PROPS>
                                <TARGET-CATEGORY>TYPE_REFERENCE</TARGET-CATEGORY>
                                <SW-DATA-DEF-PROPS>
                                <SW-DATA-DEF-PROPS-VARIANTS>
                                <SW-DATA-DEF-PROPS-CONDITIONAL>
                                <IMPLEMENTATION-DATA-TYPE-REF DEST = "IMPLEMENTATION-DATA-TYPE">/AUTOSAR_Spi/ImplementationDataTypes/Spi_DataBufferType</IMPLEMENTATION-DATA-TYPE-REF>
                                </SW-DATA-DEF-PROPS-CONDITIONAL>
                                </SW-DATA-DEF-PROPS-VARIANTS>
                                </SW-DATA-DEF-PROPS>
                                </SW-POINTER-TARGET-PROPS>
                                </SW-DATA-DEF-PROPS-CONDITIONAL>
                              </SW-DATA-DEF-PROPS-VARIANTS>
                            </SW-DATA-DEF-PROPS>
                          </SW-SERVICE-ARG>
                        </ARGUMENTS>
                    </BSW-MODULE-ENTRY>
                    <BSW-MODULE-ENTRY>
                        <SHORT-NAME>Spi_ReadIB</SHORT-NAME>
                        <INTRODUCTION>
                            <NOTE SI="Spi_ReadIB is reentrant for different channel or core" NOTE-TYPE="HINT" />
                        </INTRODUCTION>
                        <SERVICE-ID>4</SERVICE-ID>
                        <IS-REENTRANT>true</IS-REENTRANT>
                        <IS-SYNCHRONOUS>true</IS-SYNCHRONOUS>
                        <CALL-TYPE>REGULAR</CALL-TYPE>
                        <EXECUTION-CONTEXT>TASK</EXECUTION-CONTEXT>
                        <SW-SERVICE-IMPL-POLICY>STANDARD</SW-SERVICE-IMPL-POLICY>
                        <RETURN-TYPE>
                          <SHORT-NAME>Return</SHORT-NAME>
                          <SW-DATA-DEF-PROPS>
                            <SW-DATA-DEF-PROPS-VARIANTS>
                              <SW-DATA-DEF-PROPS-CONDITIONAL>
                                <IMPLEMENTATION-DATA-TYPE-REF DEST = "IMPLEMENTATION-DATA-TYPE">/AUTOSAR_StdTypes/ImplementationDataTypes/Std_ReturnType</IMPLEMENTATION-DATA-TYPE-REF>
                              </SW-DATA-DEF-PROPS-CONDITIONAL>
                            </SW-DATA-DEF-PROPS-VARIANTS>
                          </SW-DATA-DEF-PROPS>
                        </RETURN-TYPE>
                        <ARGUMENTS>
                          <SW-SERVICE-ARG>
                            <SHORT-NAME>Channel</SHORT-NAME>
                            <SW-DATA-DEF-PROPS>
                              <SW-DATA-DEF-PROPS-VARIANTS>
                                <SW-DATA-DEF-PROPS-CONDITIONAL>
                                <IMPLEMENTATION-DATA-TYPE-REF DEST = "IMPLEMENTATION-DATA-TYPE">/AUTOSAR_Spi/ImplementationDataTypes/Spi_ChannelType</IMPLEMENTATION-DATA-TYPE-REF>
                                </SW-DATA-DEF-PROPS-CONDITIONAL>
                              </SW-DATA-DEF-PROPS-VARIANTS>
                            </SW-DATA-DEF-PROPS>
                          </SW-SERVICE-ARG>
                          <SW-SERVICE-ARG>
                            <SHORT-NAME>DataBufferPointer</SHORT-NAME>
                            <CATEGORY>DATA_REFERENCE</CATEGORY>
                            <SW-DATA-DEF-PROPS>
                              <SW-DATA-DEF-PROPS-VARIANTS>
                                <SW-DATA-DEF-PROPS-CONDITIONAL>
                                <SW-POINTER-TARGET-PROPS>
                                <TARGET-CATEGORY>TYPE_REFERENCE</TARGET-CATEGORY>
                                <SW-DATA-DEF-PROPS>
                                <SW-DATA-DEF-PROPS-VARIANTS>
                                <SW-DATA-DEF-PROPS-CONDITIONAL>
                                <IMPLEMENTATION-DATA-TYPE-REF DEST = "IMPLEMENTATION-DATA-TYPE">/AUTOSAR_Spi/ImplementationDataTypes/Spi_DataBufferType</IMPLEMENTATION-DATA-TYPE-REF>
                                </SW-DATA-DEF-PROPS-CONDITIONAL>
                                </SW-DATA-DEF-PROPS-VARIANTS>
                                </SW-DATA-DEF-PROPS>
                                </SW-POINTER-TARGET-PROPS>
                                </SW-DATA-DEF-PROPS-CONDITIONAL>
                              </SW-DATA-DEF-PROPS-VARIANTS>
                            </SW-DATA-DEF-PROPS>
                          </SW-SERVICE-ARG>
                        </ARGUMENTS>
                    </BSW-MODULE-ENTRY>
[!ENDIF!][!//
[!IF "$Spi_LevelDelivered = 1 or $Spi_LevelDelivered = 2"!][!//
                    <BSW-MODULE-ENTRY>
                        <SHORT-NAME>Spi_AsyncTransmit</SHORT-NAME>
                        <INTRODUCTION>
                            <NOTE SI="Spi_AsyncTransmit is reentrant for different core" NOTE-TYPE="HINT" />
                        </INTRODUCTION>
                        <SERVICE-ID>3</SERVICE-ID>
                        <IS-REENTRANT>true</IS-REENTRANT>
                        <IS-SYNCHRONOUS>false</IS-SYNCHRONOUS>
                        <CALL-TYPE>REGULAR</CALL-TYPE>
                        <EXECUTION-CONTEXT>TASK</EXECUTION-CONTEXT>
                        <SW-SERVICE-IMPL-POLICY>STANDARD</SW-SERVICE-IMPL-POLICY>
                        <RETURN-TYPE>
                          <SHORT-NAME>Return</SHORT-NAME>
                          <SW-DATA-DEF-PROPS>
                            <SW-DATA-DEF-PROPS-VARIANTS>
                              <SW-DATA-DEF-PROPS-CONDITIONAL>
                                <IMPLEMENTATION-DATA-TYPE-REF DEST = "IMPLEMENTATION-DATA-TYPE">/AUTOSAR_StdTypes/ImplementationDataTypes/Std_ReturnType</IMPLEMENTATION-DATA-TYPE-REF>
                              </SW-DATA-DEF-PROPS-CONDITIONAL>
                            </SW-DATA-DEF-PROPS-VARIANTS>
                          </SW-DATA-DEF-PROPS>
                        </RETURN-TYPE>
                        <ARGUMENTS>
                          <SW-SERVICE-ARG>
                            <SHORT-NAME>Sequence</SHORT-NAME>
                            <SW-DATA-DEF-PROPS>
                              <SW-DATA-DEF-PROPS-VARIANTS>
                                <SW-DATA-DEF-PROPS-CONDITIONAL>
                                <IMPLEMENTATION-DATA-TYPE-REF DEST = "IMPLEMENTATION-DATA-TYPE">/AUTOSAR_Spi/ImplementationDataTypes/Spi_SequenceType</IMPLEMENTATION-DATA-TYPE-REF>
                                </SW-DATA-DEF-PROPS-CONDITIONAL>
                              </SW-DATA-DEF-PROPS-VARIANTS>
                            </SW-DATA-DEF-PROPS>
                          </SW-SERVICE-ARG>
                        </ARGUMENTS>
                    </BSW-MODULE-ENTRY>
[!ENDIF!][!//
[!IF "$Spi_ChannelBuffersAllowed = 1 or $Spi_ChannelBuffersAllowed = 2"!][!//
                    <BSW-MODULE-ENTRY>
                        <SHORT-NAME>Spi_SetupEB</SHORT-NAME>
                        <INTRODUCTION>
                            <NOTE SI="Spi_SetupEB is reentrant for different channel or core" NOTE-TYPE="HINT" />
                        </INTRODUCTION>
                        <SERVICE-ID>5</SERVICE-ID>
                        <IS-REENTRANT>true</IS-REENTRANT>
                        <IS-SYNCHRONOUS>true</IS-SYNCHRONOUS>
                        <CALL-TYPE>REGULAR</CALL-TYPE>
                        <EXECUTION-CONTEXT>TASK</EXECUTION-CONTEXT>
                        <SW-SERVICE-IMPL-POLICY>STANDARD</SW-SERVICE-IMPL-POLICY>
                        <RETURN-TYPE>
                          <SHORT-NAME>Return</SHORT-NAME>
                          <SW-DATA-DEF-PROPS>
                            <SW-DATA-DEF-PROPS-VARIANTS>
                              <SW-DATA-DEF-PROPS-CONDITIONAL>
                                <IMPLEMENTATION-DATA-TYPE-REF DEST = "IMPLEMENTATION-DATA-TYPE">/AUTOSAR_StdTypes/ImplementationDataTypes/Std_ReturnType</IMPLEMENTATION-DATA-TYPE-REF>
                              </SW-DATA-DEF-PROPS-CONDITIONAL>
                            </SW-DATA-DEF-PROPS-VARIANTS>
                          </SW-DATA-DEF-PROPS>
                        </RETURN-TYPE>
                        <ARGUMENTS>
                          <SW-SERVICE-ARG>
                            <SHORT-NAME>Channel</SHORT-NAME>
                            <SW-DATA-DEF-PROPS>
                              <SW-DATA-DEF-PROPS-VARIANTS>
                                <SW-DATA-DEF-PROPS-CONDITIONAL>
                                <IMPLEMENTATION-DATA-TYPE-REF DEST = "IMPLEMENTATION-DATA-TYPE">/AUTOSAR_Spi/ImplementationDataTypes/Spi_ChannelType</IMPLEMENTATION-DATA-TYPE-REF>
                                </SW-DATA-DEF-PROPS-CONDITIONAL>
                              </SW-DATA-DEF-PROPS-VARIANTS>
                            </SW-DATA-DEF-PROPS>
                          </SW-SERVICE-ARG>
                          <SW-SERVICE-ARG>
                            <SHORT-NAME>SrcDataBufferPtr</SHORT-NAME>
                            <CATEGORY>DATA_REFERENCE</CATEGORY>
                            <SW-DATA-DEF-PROPS>
                              <SW-DATA-DEF-PROPS-VARIANTS>
                                <SW-DATA-DEF-PROPS-CONDITIONAL>
                                <SW-POINTER-TARGET-PROPS>
                                <TARGET-CATEGORY>TYPE_REFERENCE</TARGET-CATEGORY>
                                <SW-DATA-DEF-PROPS>
                                <SW-DATA-DEF-PROPS-VARIANTS>
                                <SW-DATA-DEF-PROPS-CONDITIONAL>
                                <IMPLEMENTATION-DATA-TYPE-REF DEST = "IMPLEMENTATION-DATA-TYPE">/AUTOSAR_Spi/ImplementationDataTypes/Spi_DataBufferType</IMPLEMENTATION-DATA-TYPE-REF>
                                </SW-DATA-DEF-PROPS-CONDITIONAL>
                                </SW-DATA-DEF-PROPS-VARIANTS>
                                </SW-DATA-DEF-PROPS>
                                </SW-POINTER-TARGET-PROPS>
                                </SW-DATA-DEF-PROPS-CONDITIONAL>
                              </SW-DATA-DEF-PROPS-VARIANTS>
                            </SW-DATA-DEF-PROPS>
                          </SW-SERVICE-ARG>
                          <SW-SERVICE-ARG>
                            <SHORT-NAME>DesDataBufferPtr</SHORT-NAME>
                            <CATEGORY>DATA_REFERENCE</CATEGORY>
                            <SW-DATA-DEF-PROPS>
                              <SW-DATA-DEF-PROPS-VARIANTS>
                                <SW-DATA-DEF-PROPS-CONDITIONAL>
                                <SW-POINTER-TARGET-PROPS>
                                <TARGET-CATEGORY>TYPE_REFERENCE</TARGET-CATEGORY>
                                <SW-DATA-DEF-PROPS>
                                <SW-DATA-DEF-PROPS-VARIANTS>
                                <SW-DATA-DEF-PROPS-CONDITIONAL>
                                <IMPLEMENTATION-DATA-TYPE-REF DEST = "IMPLEMENTATION-DATA-TYPE">/AUTOSAR_Spi/ImplementationDataTypes/Spi_DataBufferType</IMPLEMENTATION-DATA-TYPE-REF>
                                </SW-DATA-DEF-PROPS-CONDITIONAL>
                                </SW-DATA-DEF-PROPS-VARIANTS>
                                </SW-DATA-DEF-PROPS>
                                </SW-POINTER-TARGET-PROPS>
                                </SW-DATA-DEF-PROPS-CONDITIONAL>
                              </SW-DATA-DEF-PROPS-VARIANTS>
                            </SW-DATA-DEF-PROPS>
                          </SW-SERVICE-ARG>
                          <SW-SERVICE-ARG>
                            <SHORT-NAME>Length</SHORT-NAME>
                            <SW-DATA-DEF-PROPS>
                              <SW-DATA-DEF-PROPS-VARIANTS>
                                <SW-DATA-DEF-PROPS-CONDITIONAL>
                                <IMPLEMENTATION-DATA-TYPE-REF DEST = "IMPLEMENTATION-DATA-TYPE">/AUTOSAR_Spi/ImplementationDataTypes/Spi_NumberOfDataType</IMPLEMENTATION-DATA-TYPE-REF>
                                </SW-DATA-DEF-PROPS-CONDITIONAL>
                              </SW-DATA-DEF-PROPS-VARIANTS>
                            </SW-DATA-DEF-PROPS>
                          </SW-SERVICE-ARG>
                        </ARGUMENTS>
                    </BSW-MODULE-ENTRY>
[!ENDIF!][!//
                    <BSW-MODULE-ENTRY>
                        <SHORT-NAME>Spi_GetStatus</SHORT-NAME>
                        <INTRODUCTION>
                            <NOTE SI="Spi_GetStatus is reentrant for different core" NOTE-TYPE="HINT" />
                        </INTRODUCTION>
                        <SERVICE-ID>6</SERVICE-ID>
                        <IS-REENTRANT>true</IS-REENTRANT>
                        <IS-SYNCHRONOUS>true</IS-SYNCHRONOUS>
                        <CALL-TYPE>REGULAR</CALL-TYPE>
                        <EXECUTION-CONTEXT>TASK</EXECUTION-CONTEXT>
                        <SW-SERVICE-IMPL-POLICY>STANDARD</SW-SERVICE-IMPL-POLICY>
                        <RETURN-TYPE>
                          <SHORT-NAME>Return</SHORT-NAME>
                          <SW-DATA-DEF-PROPS>
                            <SW-DATA-DEF-PROPS-VARIANTS>
                              <SW-DATA-DEF-PROPS-CONDITIONAL>
                                <IMPLEMENTATION-DATA-TYPE-REF DEST = "IMPLEMENTATION-DATA-TYPE">/AUTOSAR_Spi/ImplementationDataTypes/Spi_StatusType</IMPLEMENTATION-DATA-TYPE-REF>
                              </SW-DATA-DEF-PROPS-CONDITIONAL>
                            </SW-DATA-DEF-PROPS-VARIANTS>
                          </SW-DATA-DEF-PROPS>
                        </RETURN-TYPE>
                    </BSW-MODULE-ENTRY>
                    <BSW-MODULE-ENTRY>
                        <SHORT-NAME>Spi_GetJobResult</SHORT-NAME>
                        <INTRODUCTION>
                            <NOTE SI="Spi_GetJobResult is reentrant for different channel or core" NOTE-TYPE="HINT" />
                        </INTRODUCTION>
                        <SERVICE-ID>7</SERVICE-ID>
                        <IS-REENTRANT>true</IS-REENTRANT>
                        <IS-SYNCHRONOUS>true</IS-SYNCHRONOUS>
                        <CALL-TYPE>REGULAR</CALL-TYPE>
                        <EXECUTION-CONTEXT>TASK</EXECUTION-CONTEXT>
                        <SW-SERVICE-IMPL-POLICY>STANDARD</SW-SERVICE-IMPL-POLICY>
                        <RETURN-TYPE>
                          <SHORT-NAME>Return</SHORT-NAME>
                          <SW-DATA-DEF-PROPS>
                            <SW-DATA-DEF-PROPS-VARIANTS>
                              <SW-DATA-DEF-PROPS-CONDITIONAL>
                                <IMPLEMENTATION-DATA-TYPE-REF DEST = "IMPLEMENTATION-DATA-TYPE">/AUTOSAR_Spi/ImplementationDataTypes/Spi_JobResultType</IMPLEMENTATION-DATA-TYPE-REF>
                              </SW-DATA-DEF-PROPS-CONDITIONAL>
                            </SW-DATA-DEF-PROPS-VARIANTS>
                          </SW-DATA-DEF-PROPS>
                        </RETURN-TYPE>
                        <ARGUMENTS>
                          <SW-SERVICE-ARG>
                            <SHORT-NAME>Job</SHORT-NAME>
                            <SW-DATA-DEF-PROPS>
                              <SW-DATA-DEF-PROPS-VARIANTS>
                                <SW-DATA-DEF-PROPS-CONDITIONAL>
                                <IMPLEMENTATION-DATA-TYPE-REF DEST = "IMPLEMENTATION-DATA-TYPE">/AUTOSAR_Spi/ImplementationDataTypes/Spi_JobType</IMPLEMENTATION-DATA-TYPE-REF>
                                </SW-DATA-DEF-PROPS-CONDITIONAL>
                              </SW-DATA-DEF-PROPS-VARIANTS>
                            </SW-DATA-DEF-PROPS>
                          </SW-SERVICE-ARG>
                        </ARGUMENTS>
                    </BSW-MODULE-ENTRY>
                    <BSW-MODULE-ENTRY>
                        <SHORT-NAME>Spi_GetSequenceResult</SHORT-NAME>
                        <INTRODUCTION>
                            <NOTE SI="Spi_SequenceResult is reentrant for different channel or core" NOTE-TYPE="HINT" />
                        </INTRODUCTION>
                        <SERVICE-ID>8</SERVICE-ID>
                        <IS-REENTRANT>true</IS-REENTRANT>
                        <IS-SYNCHRONOUS>true</IS-SYNCHRONOUS>
                        <CALL-TYPE>REGULAR</CALL-TYPE>
                        <EXECUTION-CONTEXT>TASK</EXECUTION-CONTEXT>
                        <SW-SERVICE-IMPL-POLICY>STANDARD</SW-SERVICE-IMPL-POLICY>
                        <RETURN-TYPE>
                          <SHORT-NAME>Return</SHORT-NAME>
                          <SW-DATA-DEF-PROPS>
                            <SW-DATA-DEF-PROPS-VARIANTS>
                              <SW-DATA-DEF-PROPS-CONDITIONAL>
                                <IMPLEMENTATION-DATA-TYPE-REF DEST = "IMPLEMENTATION-DATA-TYPE">/AUTOSAR_Spi/ImplementationDataTypes/Spi_SeqResultType</IMPLEMENTATION-DATA-TYPE-REF>
                              </SW-DATA-DEF-PROPS-CONDITIONAL>
                            </SW-DATA-DEF-PROPS-VARIANTS>
                          </SW-DATA-DEF-PROPS>
                        </RETURN-TYPE>
                        <ARGUMENTS>
                          <SW-SERVICE-ARG>
                            <SHORT-NAME>Sequence</SHORT-NAME>
                            <SW-DATA-DEF-PROPS>
                              <SW-DATA-DEF-PROPS-VARIANTS>
                                <SW-DATA-DEF-PROPS-CONDITIONAL>
                                <IMPLEMENTATION-DATA-TYPE-REF DEST = "IMPLEMENTATION-DATA-TYPE">/AUTOSAR_Spi/ImplementationDataTypes/Spi_SequenceType</IMPLEMENTATION-DATA-TYPE-REF>
                                </SW-DATA-DEF-PROPS-CONDITIONAL>
                              </SW-DATA-DEF-PROPS-VARIANTS>
                            </SW-DATA-DEF-PROPS>
                          </SW-SERVICE-ARG>
                        </ARGUMENTS>
                    </BSW-MODULE-ENTRY>
[!IF "($Spi_LevelDelivered = 0 or $Spi_LevelDelivered = 2) and $SyncJobPresent = 'TRUE'"!][!//
                    <BSW-MODULE-ENTRY>
                        <SHORT-NAME>Spi_SyncTransmit</SHORT-NAME>
                        <INTRODUCTION>
                            <NOTE SI="Spi_SyncTransmit is reentrant for different core" NOTE-TYPE="HINT" />
                        </INTRODUCTION>
                        <SERVICE-ID>10</SERVICE-ID>
                        <IS-REENTRANT>true</IS-REENTRANT>
                        <IS-SYNCHRONOUS>true</IS-SYNCHRONOUS>
                        <CALL-TYPE>REGULAR</CALL-TYPE>
                        <EXECUTION-CONTEXT>TASK</EXECUTION-CONTEXT>
                        <SW-SERVICE-IMPL-POLICY>STANDARD</SW-SERVICE-IMPL-POLICY>
                        <RETURN-TYPE>
                          <SHORT-NAME>Return</SHORT-NAME>
                          <SW-DATA-DEF-PROPS>
                            <SW-DATA-DEF-PROPS-VARIANTS>
                              <SW-DATA-DEF-PROPS-CONDITIONAL>
                                <IMPLEMENTATION-DATA-TYPE-REF DEST = "IMPLEMENTATION-DATA-TYPE">/AUTOSAR_StdTypes/ImplementationDataTypes/Std_ReturnType</IMPLEMENTATION-DATA-TYPE-REF>
                              </SW-DATA-DEF-PROPS-CONDITIONAL>
                            </SW-DATA-DEF-PROPS-VARIANTS>
                          </SW-DATA-DEF-PROPS>
                        </RETURN-TYPE>
                        <ARGUMENTS>
                          <SW-SERVICE-ARG>
                            <SHORT-NAME>Sequence</SHORT-NAME>
                            <SW-DATA-DEF-PROPS>
                              <SW-DATA-DEF-PROPS-VARIANTS>
                                <SW-DATA-DEF-PROPS-CONDITIONAL>
                                <IMPLEMENTATION-DATA-TYPE-REF DEST = "IMPLEMENTATION-DATA-TYPE">/AUTOSAR_Spi/ImplementationDataTypes/Spi_SequenceType</IMPLEMENTATION-DATA-TYPE-REF>
                                </SW-DATA-DEF-PROPS-CONDITIONAL>
                              </SW-DATA-DEF-PROPS-VARIANTS>
                            </SW-DATA-DEF-PROPS>
                          </SW-SERVICE-ARG>
                        </ARGUMENTS>
                    </BSW-MODULE-ENTRY>
[!ENDIF!][!//
[!IF "$Spi_HwStatusApi = 'true'"!][!//
                    <BSW-MODULE-ENTRY>
                        <SHORT-NAME>Spi_GetHWUnitStatus</SHORT-NAME>
                        <INTRODUCTION>
                            <NOTE SI="Spi_GetHwUnitStatus is reentrant for different core" NOTE-TYPE="HINT" />
                        </INTRODUCTION>
                        <SERVICE-ID>11</SERVICE-ID>
                        <IS-REENTRANT>true</IS-REENTRANT>
                        <IS-SYNCHRONOUS>true</IS-SYNCHRONOUS>
                        <CALL-TYPE>REGULAR</CALL-TYPE>
                        <EXECUTION-CONTEXT>TASK</EXECUTION-CONTEXT>
                        <SW-SERVICE-IMPL-POLICY>STANDARD</SW-SERVICE-IMPL-POLICY>
                        <RETURN-TYPE>
                          <SHORT-NAME>Return</SHORT-NAME>
                          <SW-DATA-DEF-PROPS>
                            <SW-DATA-DEF-PROPS-VARIANTS>
                              <SW-DATA-DEF-PROPS-CONDITIONAL>
                                <IMPLEMENTATION-DATA-TYPE-REF DEST = "IMPLEMENTATION-DATA-TYPE">/AUTOSAR_Spi/ImplementationDataTypes/Spi_StatusType</IMPLEMENTATION-DATA-TYPE-REF>
                              </SW-DATA-DEF-PROPS-CONDITIONAL>
                            </SW-DATA-DEF-PROPS-VARIANTS>
                          </SW-DATA-DEF-PROPS>
                        </RETURN-TYPE>
                        <ARGUMENTS>
                          <SW-SERVICE-ARG>
                            <SHORT-NAME>HWUnit</SHORT-NAME>
                            <SW-DATA-DEF-PROPS>
                              <SW-DATA-DEF-PROPS-VARIANTS>
                                <SW-DATA-DEF-PROPS-CONDITIONAL>
                                <IMPLEMENTATION-DATA-TYPE-REF DEST = "IMPLEMENTATION-DATA-TYPE">/AUTOSAR_Spi/ImplementationDataTypes/Spi_HWUnitType</IMPLEMENTATION-DATA-TYPE-REF>
                                </SW-DATA-DEF-PROPS-CONDITIONAL>
                              </SW-DATA-DEF-PROPS-VARIANTS>
                            </SW-DATA-DEF-PROPS>
                          </SW-SERVICE-ARG>
                        </ARGUMENTS>
                    </BSW-MODULE-ENTRY>
[!ENDIF!][!//
[!IF "$Spi_CancelApi = 'true'"!][!//
                    <BSW-MODULE-ENTRY>
                        <SHORT-NAME>Spi_Cancel</SHORT-NAME>
                        <INTRODUCTION>
                            <NOTE SI="Spi_Cancel is reentrant for different channel or core" NOTE-TYPE="HINT" />
                        </INTRODUCTION>
                        <SERVICE-ID>12</SERVICE-ID>
                        <IS-REENTRANT>true</IS-REENTRANT>
                        <IS-SYNCHRONOUS>false</IS-SYNCHRONOUS>
                        <CALL-TYPE>REGULAR</CALL-TYPE>
                        <EXECUTION-CONTEXT>TASK</EXECUTION-CONTEXT>
                        <SW-SERVICE-IMPL-POLICY>STANDARD</SW-SERVICE-IMPL-POLICY>
                        <ARGUMENTS>
                          <SW-SERVICE-ARG>
                            <SHORT-NAME>Sequence</SHORT-NAME>
                            <SW-DATA-DEF-PROPS>
                              <SW-DATA-DEF-PROPS-VARIANTS>
                                <SW-DATA-DEF-PROPS-CONDITIONAL>
                                <IMPLEMENTATION-DATA-TYPE-REF DEST = "IMPLEMENTATION-DATA-TYPE">/AUTOSAR_Spi/ImplementationDataTypes/Spi_SequenceType</IMPLEMENTATION-DATA-TYPE-REF>
                                </SW-DATA-DEF-PROPS-CONDITIONAL>
                              </SW-DATA-DEF-PROPS-VARIANTS>
                            </SW-DATA-DEF-PROPS>
                          </SW-SERVICE-ARG>
                        </ARGUMENTS>
                    </BSW-MODULE-ENTRY>
[!ENDIF!][!//
[!IF "$Spi_LevelDelivered = 2"!][!//
                    <BSW-MODULE-ENTRY>
                        <SHORT-NAME>Spi_SetAsyncMode</SHORT-NAME>
                        <SERVICE-ID>13</SERVICE-ID>
                        <IS-REENTRANT>false</IS-REENTRANT>
                        <IS-SYNCHRONOUS>true</IS-SYNCHRONOUS>
                        <CALL-TYPE>REGULAR</CALL-TYPE>
                        <EXECUTION-CONTEXT>TASK</EXECUTION-CONTEXT>
                        <SW-SERVICE-IMPL-POLICY>STANDARD</SW-SERVICE-IMPL-POLICY>
                        <RETURN-TYPE>
                          <SHORT-NAME>Return</SHORT-NAME>
                          <SW-DATA-DEF-PROPS>
                            <SW-DATA-DEF-PROPS-VARIANTS>
                              <SW-DATA-DEF-PROPS-CONDITIONAL>
                                <IMPLEMENTATION-DATA-TYPE-REF DEST = "IMPLEMENTATION-DATA-TYPE">/AUTOSAR_StdTypes/ImplementationDataTypes/Std_ReturnType</IMPLEMENTATION-DATA-TYPE-REF>
                              </SW-DATA-DEF-PROPS-CONDITIONAL>
                            </SW-DATA-DEF-PROPS-VARIANTS>
                          </SW-DATA-DEF-PROPS>
                        </RETURN-TYPE>
                        <ARGUMENTS>
                          <SW-SERVICE-ARG>
                            <SHORT-NAME>Mode</SHORT-NAME>
                            <SW-DATA-DEF-PROPS>
                              <SW-DATA-DEF-PROPS-VARIANTS>
                                <SW-DATA-DEF-PROPS-CONDITIONAL>
                                <IMPLEMENTATION-DATA-TYPE-REF DEST = "IMPLEMENTATION-DATA-TYPE">/AUTOSAR_Spi/ImplementationDataTypes/Spi_AsyncModeType</IMPLEMENTATION-DATA-TYPE-REF>
                                </SW-DATA-DEF-PROPS-CONDITIONAL>
                              </SW-DATA-DEF-PROPS-VARIANTS>
                            </SW-DATA-DEF-PROPS>
                          </SW-SERVICE-ARG>
                        </ARGUMENTS>
                    </BSW-MODULE-ENTRY>
[!ENDIF!][!//
[!IF "$Spi_LevelDelivered != 0"!][!//
                    <BSW-MODULE-ENTRY>
                        <SHORT-NAME>Spi_IsrQspiPT2</SHORT-NAME>
                        <IS-REENTRANT>false</IS-REENTRANT>
                        <IS-SYNCHRONOUS>true</IS-SYNCHRONOUS>
                        <CALL-TYPE>INTERRUPT</CALL-TYPE>
                        <EXECUTION-CONTEXT>INTERRUPT-CAT-1</EXECUTION-CONTEXT>
                        <SW-SERVICE-IMPL-POLICY>STANDARD</SW-SERVICE-IMPL-POLICY>
                        <ARGUMENTS>
                          <SW-SERVICE-ARG>
                            <SHORT-NAME>Module</SHORT-NAME>
                            <SW-DATA-DEF-PROPS>
                              <SW-DATA-DEF-PROPS-VARIANTS>
                                <SW-DATA-DEF-PROPS-CONDITIONAL>
                                  <IMPLEMENTATION-DATA-TYPE-REF DEST="IMPLEMENTATION-DATA-TYPE">/AUTOSAR_Platform/ImplementationDataTypes/uint8</IMPLEMENTATION-DATA-TYPE-REF>
                                </SW-DATA-DEF-PROPS-CONDITIONAL>
                              </SW-DATA-DEF-PROPS-VARIANTS>
                            </SW-DATA-DEF-PROPS>
                          </SW-SERVICE-ARG>
                        </ARGUMENTS>
                    </BSW-MODULE-ENTRY>
[!ENDIF!][!//
[!IF "$Spi_LevelDelivered != 0"!][!//
                    <BSW-MODULE-ENTRY>
                        <SHORT-NAME>Spi_IsrQspiError</SHORT-NAME>
                        <IS-REENTRANT>false</IS-REENTRANT>
                        <IS-SYNCHRONOUS>true</IS-SYNCHRONOUS>
                        <CALL-TYPE>INTERRUPT</CALL-TYPE>
                        <EXECUTION-CONTEXT>INTERRUPT-CAT-1</EXECUTION-CONTEXT>
                        <SW-SERVICE-IMPL-POLICY>STANDARD</SW-SERVICE-IMPL-POLICY>
                        <ARGUMENTS>
                          <SW-SERVICE-ARG>
                            <SHORT-NAME>Module</SHORT-NAME>
                            <SW-DATA-DEF-PROPS>
                              <SW-DATA-DEF-PROPS-VARIANTS>
                                <SW-DATA-DEF-PROPS-CONDITIONAL>
                                  <IMPLEMENTATION-DATA-TYPE-REF DEST="IMPLEMENTATION-DATA-TYPE">/AUTOSAR_Platform/ImplementationDataTypes/uint8</IMPLEMENTATION-DATA-TYPE-REF>
                                </SW-DATA-DEF-PROPS-CONDITIONAL>
                              </SW-DATA-DEF-PROPS-VARIANTS>
                            </SW-DATA-DEF-PROPS>
                          </SW-SERVICE-ARG>
                        </ARGUMENTS>
                    </BSW-MODULE-ENTRY>
[!ENDIF!][!//
                    <BSW-MODULE-ENTRY>
                        <SHORT-NAME>Spi_QspiDmaCallout</SHORT-NAME>
                        <IS-REENTRANT>false</IS-REENTRANT>
                        <IS-SYNCHRONOUS>true</IS-SYNCHRONOUS>
                        <CALL-TYPE>CALLBACK</CALL-TYPE>
                        <EXECUTION-CONTEXT>TASK</EXECUTION-CONTEXT>
                        <SW-SERVICE-IMPL-POLICY>STANDARD</SW-SERVICE-IMPL-POLICY>
                        <ARGUMENTS>
                          <SW-SERVICE-ARG>
                            <SHORT-NAME>Channel</SHORT-NAME>
                            <SW-DATA-DEF-PROPS>
                              <SW-DATA-DEF-PROPS-VARIANTS>
                                <SW-DATA-DEF-PROPS-CONDITIONAL>
                                  <IMPLEMENTATION-DATA-TYPE-REF DEST="IMPLEMENTATION-DATA-TYPE">/AUTOSAR_Platform/ImplementationDataTypes/uint32</IMPLEMENTATION-DATA-TYPE-REF>
                                </SW-DATA-DEF-PROPS-CONDITIONAL>
                              </SW-DATA-DEF-PROPS-VARIANTS>
                            </SW-DATA-DEF-PROPS>
                          </SW-SERVICE-ARG>
                          <SW-SERVICE-ARG>
                            <SHORT-NAME>Event</SHORT-NAME>
                            <SW-DATA-DEF-PROPS>
                              <SW-DATA-DEF-PROPS-VARIANTS>
                                <SW-DATA-DEF-PROPS-CONDITIONAL>
                                  <IMPLEMENTATION-DATA-TYPE-REF DEST="IMPLEMENTATION-DATA-TYPE">/AURIX2G_Dma/ImplementationDataTypes/Dma_ChEventType</IMPLEMENTATION-DATA-TYPE-REF>
                                </SW-DATA-DEF-PROPS-CONDITIONAL>
                              </SW-DATA-DEF-PROPS-VARIANTS>
                            </SW-DATA-DEF-PROPS>
                          </SW-SERVICE-ARG>
                        </ARGUMENTS>
                    </BSW-MODULE-ENTRY>
                    <BSW-MODULE-ENTRY>
                        <SHORT-NAME>Spi_QspiDmaErrCallout</SHORT-NAME>
                        <IS-REENTRANT>false</IS-REENTRANT>
                        <IS-SYNCHRONOUS>true</IS-SYNCHRONOUS>
                        <CALL-TYPE>CALLBACK</CALL-TYPE>
                        <EXECUTION-CONTEXT>TASK</EXECUTION-CONTEXT>
                        <SW-SERVICE-IMPL-POLICY>STANDARD</SW-SERVICE-IMPL-POLICY>
                        <ARGUMENTS>
                          <SW-SERVICE-ARG>
                            <SHORT-NAME>Channel</SHORT-NAME>
                            <SW-DATA-DEF-PROPS>
                              <SW-DATA-DEF-PROPS-VARIANTS>
                                <SW-DATA-DEF-PROPS-CONDITIONAL>
                                  <IMPLEMENTATION-DATA-TYPE-REF DEST="IMPLEMENTATION-DATA-TYPE">/AUTOSAR_Platform/ImplementationDataTypes/uint32</IMPLEMENTATION-DATA-TYPE-REF>
                                </SW-DATA-DEF-PROPS-CONDITIONAL>
                              </SW-DATA-DEF-PROPS-VARIANTS>
                            </SW-DATA-DEF-PROPS>
                          </SW-SERVICE-ARG>
                          <SW-SERVICE-ARG>
                            <SHORT-NAME>Event</SHORT-NAME>
                            <SW-DATA-DEF-PROPS>
                              <SW-DATA-DEF-PROPS-VARIANTS>
                                <SW-DATA-DEF-PROPS-CONDITIONAL>
                                  <IMPLEMENTATION-DATA-TYPE-REF DEST="IMPLEMENTATION-DATA-TYPE">/AURIX2G_Dma/ImplementationDataTypes/Dma_MoveEngineEventType</IMPLEMENTATION-DATA-TYPE-REF>
                                </SW-DATA-DEF-PROPS-CONDITIONAL>
                              </SW-DATA-DEF-PROPS-VARIANTS>
                            </SW-DATA-DEF-PROPS>
                          </SW-SERVICE-ARG>
                        </ARGUMENTS>
                    </BSW-MODULE-ENTRY>
[!IF "$Spi_LevelDelivered = 2"!][!//
                    <BSW-MODULE-ENTRY>
                        <SHORT-NAME>Spi_MainFunction_Handling</SHORT-NAME>
                        <SERVICE-ID>16</SERVICE-ID>
                        <IS-REENTRANT>false</IS-REENTRANT>
                        <IS-SYNCHRONOUS>true</IS-SYNCHRONOUS>
                        <CALL-TYPE>SCHEDULED</CALL-TYPE>
                        <EXECUTION-CONTEXT>TASK</EXECUTION-CONTEXT>
                        <SW-SERVICE-IMPL-POLICY>STANDARD</SW-SERVICE-IMPL-POLICY>
                    </BSW-MODULE-ENTRY>
[!ENDIF!][!//
                </ELEMENTS>
            </AR-PACKAGE>
            <AR-PACKAGE>
                <SHORT-NAME>Implementations</SHORT-NAME>
                <ELEMENTS>
                    <BSW-IMPLEMENTATION>
                        <SHORT-NAME>Spi</SHORT-NAME>
                        <CODE-DESCRIPTORS>
                            <CODE>
                                <SHORT-NAME>Files</SHORT-NAME>
                                <ARTIFACT-DESCRIPTORS>
                                    <AUTOSAR-ENGINEERING-OBJECT>
                                        <SHORT-LABEL>ssc::src::Spi.c</SHORT-LABEL>
                                        <CATEGORY>SWSRC</CATEGORY>
                                    </AUTOSAR-ENGINEERING-OBJECT>
                                    <AUTOSAR-ENGINEERING-OBJECT>
                                        <SHORT-LABEL>ssc::inc::Spi.h</SHORT-LABEL>
                                        <CATEGORY>SWHDR</CATEGORY>
                                    </AUTOSAR-ENGINEERING-OBJECT>
                                </ARTIFACT-DESCRIPTORS>
                            </CODE>
                        </CODE-DESCRIPTORS>
                        <COMPILERS>
                           <COMPILER>
                             <SHORT-NAME>TASKING_COMPILE</SHORT-NAME>
                             <NAME>TASKING</NAME>
                             <OPTIONS>"[!"$TaskingCompilerOption"!]"</OPTIONS>
                             <VENDOR>Altium</VENDOR>
                             <VERSION>[!"$TaskingVersion"!]</VERSION>
                           </COMPILER>
                            <COMPILER>
                              <SHORT-NAME>GNU_COMPILE</SHORT-NAME>
                              <NAME>GNU</NAME>
                              <OPTIONS>"[!"$GnucCompilerOption"!]"</OPTIONS>
                              <VENDOR>Hightec</VENDOR>
                              <VERSION>[!"$GnucVersion"!]</VERSION>
                            </COMPILER>
                            <COMPILER>
                              <SHORT-NAME>DIAB_COMPILE</SHORT-NAME>
                              <NAME>DIAB</NAME>
                              <OPTIONS>"[!"$DccCompilerOption"!]"</OPTIONS>
                              <VENDOR>Windriver</VENDOR>
                              <VERSION>[!"$DccVersion"!]</VERSION>
                            </COMPILER>
                            <COMPILER>
                              <SHORT-NAME>GHS_COMPILE</SHORT-NAME>
                              <NAME>GHS</NAME>
                              <OPTIONS>"[!"$GhsCompilerOption"!]"</OPTIONS>
                              <VENDOR>GreenHills</VENDOR>
                              <VERSION>[!"$GhsVersion"!]</VERSION>
                            </COMPILER>
                        </COMPILERS>
                        <GENERATED-ARTIFACTS>
                            <DEPENDENCY-ON-ARTIFACT>
                                <SHORT-NAME>Spi_PBcfg_c</SHORT-NAME>
                                <ARTIFACT-DESCRIPTOR>
                                    <SHORT-LABEL>generate::template::src::Spi_PBcfg.c</SHORT-LABEL>
                                    <CATEGORY>SWTEMPLATE</CATEGORY>
                                </ARTIFACT-DESCRIPTOR>
                                <USAGES>
                                    <USAGE>EXECUTE</USAGE>
                                </USAGES>
                            </DEPENDENCY-ON-ARTIFACT>
                            <DEPENDENCY-ON-ARTIFACT>
                                <SHORT-NAME>Spi_PBcfg_h</SHORT-NAME>
                                <ARTIFACT-DESCRIPTOR>
                                    <SHORT-LABEL>generate::template::inc::Spi_PBcfg.h</SHORT-LABEL>
                                    <CATEGORY>SWTEMPLATE</CATEGORY>
                                </ARTIFACT-DESCRIPTOR>
                                <USAGES>
                                    <USAGE>EXECUTE</USAGE>
                                </USAGES>
                            </DEPENDENCY-ON-ARTIFACT>
                            <DEPENDENCY-ON-ARTIFACT>
                                <SHORT-NAME>Spi_Cfg_h</SHORT-NAME>
                                <ARTIFACT-DESCRIPTOR>
                                    <SHORT-LABEL>generate::template::inc::Spi_Cfg.h</SHORT-LABEL>
                                    <CATEGORY>SWTEMPLATE</CATEGORY>
                                </ARTIFACT-DESCRIPTOR>
                                <USAGES>
                                    <USAGE>EXECUTE</USAGE>
                                </USAGES>
                            </DEPENDENCY-ON-ARTIFACT>
                            <DEPENDENCY-ON-ARTIFACT>
                                <SHORT-NAME>Spi_xdm</SHORT-NAME>
                                <ARTIFACT-DESCRIPTOR>
                                    <SHORT-LABEL>Config::Spi.xdm</SHORT-LABEL>
                                    <CATEGORY>SWTOOL</CATEGORY>
                                </ARTIFACT-DESCRIPTOR>
                                <USAGES>
                                    <USAGE>CODEGENERATION</USAGE>
                                </USAGES>
                            </DEPENDENCY-ON-ARTIFACT>
                            <DEPENDENCY-ON-ARTIFACT>
                              <SHORT-NAME>Spi_bmd</SHORT-NAME>
                              <ARTIFACT-DESCRIPTOR>
                                <SHORT-LABEL>autosar::[!"concat(substring(ecu:get('Rel.SubDerivate'),1,4),'x')"!]::[!"ecu:get('Rel.SubDerivate')"!]::Spi.bmd</SHORT-LABEL>
                                <CATEGORY>SWTOOL</CATEGORY>
                              </ARTIFACT-DESCRIPTOR>
                              <USAGES>
                                <USAGE>CODEGENERATION</USAGE>
                              </USAGES>
                            </DEPENDENCY-ON-ARTIFACT>
                        </GENERATED-ARTIFACTS>
                      <LINKERS>
                        <LINKER>
                          <SHORT-NAME>TASKING_LINK</SHORT-NAME>
                          <NAME>TASKING</NAME>
                          <OPTIONS>"[!"$TaskingLinkerOption"!]"</OPTIONS>
                          <VENDOR>Altium</VENDOR>
                          <VERSION>[!"$TaskingVersion"!]</VERSION>
                        </LINKER>
                        <LINKER>
                          <SHORT-NAME>GNU_LINK</SHORT-NAME>
                          <NAME>GNU</NAME>
                          <OPTIONS>"[!"$GnucLinkerOption"!]"</OPTIONS>
                          <VENDOR>Hightec</VENDOR>
                          <VERSION>[!"$GnucVersion"!]</VERSION>
                        </LINKER>
                        <LINKER>
                          <SHORT-NAME>DIAB_LINK</SHORT-NAME>
                          <NAME>DIAB</NAME>
                          <OPTIONS>"[!"$DccLinkerOption"!]"</OPTIONS>
                          <VENDOR>Windriver</VENDOR>
                          <VERSION>[!"$DccVersion"!]</VERSION>
                        </LINKER>
                        <LINKER>
                          <SHORT-NAME>GHS_LINK</SHORT-NAME>
                          <NAME>GHS</NAME>
                          <OPTIONS>"[!"$GhsLinkerOption"!]"</OPTIONS>
                          <VENDOR>GreenHills</VENDOR>
                          <VERSION>[!"$GhsVersion"!]</VERSION>
                        </LINKER>
                      </LINKERS>
                        <PROGRAMMING-LANGUAGE>C</PROGRAMMING-LANGUAGE>
                        <RESOURCE-CONSUMPTION>
                                <SHORT-NAME>ResourceConsumption</SHORT-NAME>
                                <MEMORY-SECTIONS>
[!FOR "CoreIndex" = "num:i(1)" TO "num:i(ecu:get('Mcu.NoOfCoreAvailable'))"!][!//
  [!IF "text:split($Core_config,',')[position() = $CoreIndex] = num:i(1)"!][!//
                                    <MEMORY-SECTION>
                                        <SHORT-NAME>VAR_CLEARED_ASIL_B_CORE[!"num:i($CoreIndex - 1)"!]_32</SHORT-NAME>
                                        <ALIGNMENT>32</ALIGNMENT>
                                        <SW-ADDRMETHOD-REF DEST="SW-ADDR-METHOD">/AUTOSAR_MemMap/SwAddrMethods/VAR</SW-ADDRMETHOD-REF>
                                    </MEMORY-SECTION>
                                    <MEMORY-SECTION>
                                        <SHORT-NAME>VAR_CLEARED_ASIL_B_CORE[!"num:i($CoreIndex - 1)"!]_256</SHORT-NAME>
                                        <ALIGNMENT>256</ALIGNMENT>
                                        <SW-ADDRMETHOD-REF DEST="SW-ADDR-METHOD">/AUTOSAR_MemMap/SwAddrMethods/VAR</SW-ADDRMETHOD-REF>
                                    </MEMORY-SECTION>
                                    <MEMORY-SECTION>
                                        <SHORT-NAME>CONFIG_DATA_ASIL_B_CORE[!"num:i($CoreIndex - 1)"!]_32</SHORT-NAME>
                                        <ALIGNMENT>32</ALIGNMENT>
                                        <SW-ADDRMETHOD-REF DEST="SW-ADDR-METHOD">/AUTOSAR_MemMap/SwAddrMethods/CONFIG_DATA</SW-ADDRMETHOD-REF>
                                    </MEMORY-SECTION>
[!ENDIF!][!//
[!ENDFOR!][!//
                                    <MEMORY-SECTION>
                                        <SHORT-NAME>CONFIG_DATA_ASIL_B_GLOBAL_32</SHORT-NAME>
                                        <ALIGNMENT>32</ALIGNMENT>
                                        <SW-ADDRMETHOD-REF DEST="SW-ADDR-METHOD">/AUTOSAR_MemMap/SwAddrMethods/CONFIG_DATA</SW-ADDRMETHOD-REF>
                                    </MEMORY-SECTION>
                                    <MEMORY-SECTION>
                                        <SHORT-NAME>CONFIG_DATA_ASIL_B_GLOBAL_UNSPECIFIED</SHORT-NAME>
                                        <ALIGNMENT>UNSPECIFIED</ALIGNMENT>
                                        <SW-ADDRMETHOD-REF DEST="SW-ADDR-METHOD">/AUTOSAR_MemMap/SwAddrMethods/CONFIG_DATA</SW-ADDRMETHOD-REF>
                                    </MEMORY-SECTION>
                                    <MEMORY-SECTION>
                                        <SHORT-NAME>VAR_CLEARED_ASIL_B_GLOBAL_32</SHORT-NAME>
                                        <ALIGNMENT>32</ALIGNMENT>
                                        <SW-ADDRMETHOD-REF DEST="SW-ADDR-METHOD">/AUTOSAR_MemMap/SwAddrMethods/VAR</SW-ADDRMETHOD-REF>
                                    </MEMORY-SECTION>
                                    <MEMORY-SECTION>
                                        <SHORT-NAME>CODE_ASIL_B_GLOBAL</SHORT-NAME>
                                        <ALIGNMENT>UNSPECIFIED</ALIGNMENT>
                                        <SW-ADDRMETHOD-REF DEST="SW-ADDR-METHOD">/AUTOSAR_MemMap/SwAddrMethods/CODE</SW-ADDRMETHOD-REF>
                                    </MEMORY-SECTION>
                                </MEMORY-SECTIONS>
                                <SECTION-NAME-PREFIXS>
                                    <SECTION-NAME-PREFIX>
                                        <SHORT-NAME>SPI</SHORT-NAME>
                                        <SYMBOL>SPI</SYMBOL>
                                    </SECTION-NAME-PREFIX>
                                </SECTION-NAME-PREFIXS>
                        </RESOURCE-CONSUMPTION>
                        <SW-VERSION>1.0.0</SW-VERSION>
                        <VENDOR-ID>17</VENDOR-ID>
                        <AR-RELEASE-VERSION>4.2.2</AR-RELEASE-VERSION>
                        <BEHAVIOR-REF DEST="BSW-INTERNAL-BEHAVIOR">/AUTOSAR_Spi/BswModuleDescriptions/Spi/SpiBehavior</BEHAVIOR-REF>
                        <VENDOR-SPECIFIC-MODULE-DEF-REFS>
                                <VENDOR-SPECIFIC-MODULE-DEF-REF DEST="ECUC-MODULE-DEF">/AURIX2G/EcucDefs/Spi</VENDOR-SPECIFIC-MODULE-DEF-REF>
                        </VENDOR-SPECIFIC-MODULE-DEF-REFS>
                    </BSW-IMPLEMENTATION>
                </ELEMENTS>
            </AR-PACKAGE>
            <AR-PACKAGE>
    <SHORT-NAME>ImplementationDataTypes</SHORT-NAME>
    <CATEGORY>STANDARD</CATEGORY>
    <ELEMENTS>
[!IF "$Spi_LevelDelivered = 2"!][!//
        <IMPLEMENTATION-DATA-TYPE>
            <SHORT-NAME>Spi_AsyncModeType</SHORT-NAME>
            <CATEGORY>TYPE_REFERENCE</CATEGORY>
            <SW-DATA-DEF-PROPS>
                <SW-DATA-DEF-PROPS-VARIANTS>
                    <SW-DATA-DEF-PROPS-CONDITIONAL>
                        <COMPU-METHOD-REF DEST="COMPU-METHOD">/AUTOSAR_Spi/CompuMethods/Spi_AsyncModeType</COMPU-METHOD-REF>
                        <IMPLEMENTATION-DATA-TYPE-REF DEST="IMPLEMENTATION-DATA-TYPE">/AUTOSAR_Platform/ImplementationDataTypes/uint32</IMPLEMENTATION-DATA-TYPE-REF>
                        <SW-IMPL-POLICY>STANDARD</SW-IMPL-POLICY>
                        <ADDITIONAL-NATIVE-TYPE-QUALIFIER>enum</ADDITIONAL-NATIVE-TYPE-QUALIFIER>
                    </SW-DATA-DEF-PROPS-CONDITIONAL>
                </SW-DATA-DEF-PROPS-VARIANTS>
            </SW-DATA-DEF-PROPS>
            <TYPE-EMITTER>BSW</TYPE-EMITTER>
        </IMPLEMENTATION-DATA-TYPE>
[!ENDIF!][!//
        <IMPLEMENTATION-DATA-TYPE>
            <SHORT-NAME>Spi_JobEndNotification</SHORT-NAME>
            <CATEGORY>DATA_REFERENCE</CATEGORY>
            <INTRODUCTION>
                <NOTE SI="This data type is for a function pointer type pointing to the callback-notification function. The referred function should be implemented by user of the driver" NOTE-TYPE="HINT"/>
            </INTRODUCTION>
            <SW-DATA-DEF-PROPS>
                <SW-DATA-DEF-PROPS-VARIANTS>
                    <SW-DATA-DEF-PROPS-CONDITIONAL>
                        <SW-POINTER-TARGET-PROPS>
                            <TARGET-CATEGORY>FUNCTION_REFERENCE</TARGET-CATEGORY>
                            <FUNCTION-POINTER-SIGNATURE-REF DEST="BSW-MODULE-ENTRY">/AUTOSAR_Stub/BswModuleEntrys/Spi_JobEndCallback</FUNCTION-POINTER-SIGNATURE-REF>
                        </SW-POINTER-TARGET-PROPS>
                    </SW-DATA-DEF-PROPS-CONDITIONAL>
                </SW-DATA-DEF-PROPS-VARIANTS>
            </SW-DATA-DEF-PROPS>
        </IMPLEMENTATION-DATA-TYPE>
        <IMPLEMENTATION-DATA-TYPE>
            <SHORT-NAME>Spi_JobResultType</SHORT-NAME>
            <CATEGORY>TYPE_REFERENCE</CATEGORY>
            <SW-DATA-DEF-PROPS>
                <SW-DATA-DEF-PROPS-VARIANTS>
                    <SW-DATA-DEF-PROPS-CONDITIONAL>
                        <COMPU-METHOD-REF DEST="COMPU-METHOD">/AUTOSAR_Spi/CompuMethods/Spi_JobResultType</COMPU-METHOD-REF>
                        <IMPLEMENTATION-DATA-TYPE-REF DEST="IMPLEMENTATION-DATA-TYPE">/AUTOSAR_Platform/ImplementationDataTypes/uint32</IMPLEMENTATION-DATA-TYPE-REF>
                        <SW-IMPL-POLICY>STANDARD</SW-IMPL-POLICY>
                        <ADDITIONAL-NATIVE-TYPE-QUALIFIER>enum</ADDITIONAL-NATIVE-TYPE-QUALIFIER>
                    </SW-DATA-DEF-PROPS-CONDITIONAL>
                </SW-DATA-DEF-PROPS-VARIANTS>
            </SW-DATA-DEF-PROPS>
            <TYPE-EMITTER>BSW</TYPE-EMITTER>
        </IMPLEMENTATION-DATA-TYPE>
        <IMPLEMENTATION-DATA-TYPE>
            <SHORT-NAME>Spi_SeqEndNotification</SHORT-NAME>
            <CATEGORY>DATA_REFERENCE</CATEGORY>
            <INTRODUCTION>
                <NOTE SI="This data type is for a function pointer type pointing to the callback-notification function. The referred function should be implemented by user of the driver" NOTE-TYPE="HINT"/>
            </INTRODUCTION>
            <SW-DATA-DEF-PROPS>
                <SW-DATA-DEF-PROPS-VARIANTS>
                    <SW-DATA-DEF-PROPS-CONDITIONAL>
                        <SW-POINTER-TARGET-PROPS>
                            <TARGET-CATEGORY>FUNCTION_REFERENCE</TARGET-CATEGORY>
                            <FUNCTION-POINTER-SIGNATURE-REF DEST="BSW-MODULE-ENTRY">/AUTOSAR_Stub/BswModuleEntrys/Spi_SeqEndCallback</FUNCTION-POINTER-SIGNATURE-REF>
                        </SW-POINTER-TARGET-PROPS>
                    </SW-DATA-DEF-PROPS-CONDITIONAL>
                </SW-DATA-DEF-PROPS-VARIANTS>
            </SW-DATA-DEF-PROPS>
        </IMPLEMENTATION-DATA-TYPE>
        <IMPLEMENTATION-DATA-TYPE>
            <SHORT-NAME>Spi_SeqResultType</SHORT-NAME>
            <CATEGORY>TYPE_REFERENCE</CATEGORY>
            <SW-DATA-DEF-PROPS>
                <SW-DATA-DEF-PROPS-VARIANTS>
                    <SW-DATA-DEF-PROPS-CONDITIONAL>
                        <COMPU-METHOD-REF DEST="COMPU-METHOD">/AUTOSAR_Spi/CompuMethods/Spi_SeqResultType</COMPU-METHOD-REF>
                        <IMPLEMENTATION-DATA-TYPE-REF DEST="IMPLEMENTATION-DATA-TYPE">/AUTOSAR_Platform/ImplementationDataTypes/uint32</IMPLEMENTATION-DATA-TYPE-REF>
                        <SW-IMPL-POLICY>STANDARD</SW-IMPL-POLICY>
                        <ADDITIONAL-NATIVE-TYPE-QUALIFIER>enum</ADDITIONAL-NATIVE-TYPE-QUALIFIER>
                    </SW-DATA-DEF-PROPS-CONDITIONAL>
                </SW-DATA-DEF-PROPS-VARIANTS>
            </SW-DATA-DEF-PROPS>
            <TYPE-EMITTER>BSW</TYPE-EMITTER>
        </IMPLEMENTATION-DATA-TYPE>
        <IMPLEMENTATION-DATA-TYPE>
            <SHORT-NAME>Spi_StatusType</SHORT-NAME>
            <CATEGORY>TYPE_REFERENCE</CATEGORY>
            <SW-DATA-DEF-PROPS>
                <SW-DATA-DEF-PROPS-VARIANTS>
                    <SW-DATA-DEF-PROPS-CONDITIONAL>
                        <COMPU-METHOD-REF DEST="COMPU-METHOD">/AUTOSAR_Spi/CompuMethods/Spi_StatusType</COMPU-METHOD-REF>
                        <IMPLEMENTATION-DATA-TYPE-REF DEST="IMPLEMENTATION-DATA-TYPE">/AUTOSAR_Platform/ImplementationDataTypes/uint32</IMPLEMENTATION-DATA-TYPE-REF>
                        <SW-IMPL-POLICY>STANDARD</SW-IMPL-POLICY>
                        <ADDITIONAL-NATIVE-TYPE-QUALIFIER>enum</ADDITIONAL-NATIVE-TYPE-QUALIFIER>
                    </SW-DATA-DEF-PROPS-CONDITIONAL>
                </SW-DATA-DEF-PROPS-VARIANTS>
            </SW-DATA-DEF-PROPS>
            <TYPE-EMITTER>BSW</TYPE-EMITTER>
        </IMPLEMENTATION-DATA-TYPE>
        <IMPLEMENTATION-DATA-TYPE>
            <SHORT-NAME>Spi_DataBufferType</SHORT-NAME>
            <CATEGORY>TYPE_REFERENCE</CATEGORY>
            <SW-DATA-DEF-PROPS>
                <SW-DATA-DEF-PROPS-VARIANTS>
                    <SW-DATA-DEF-PROPS-CONDITIONAL>
                        <IMPLEMENTATION-DATA-TYPE-REF DEST="IMPLEMENTATION-DATA-TYPE">/AUTOSAR_Platform/ImplementationDataTypes/uint8</IMPLEMENTATION-DATA-TYPE-REF>
                        <SW-IMPL-POLICY>STANDARD</SW-IMPL-POLICY>
                    </SW-DATA-DEF-PROPS-CONDITIONAL>
                </SW-DATA-DEF-PROPS-VARIANTS>
            </SW-DATA-DEF-PROPS>
            <TYPE-EMITTER>BSW</TYPE-EMITTER>
        </IMPLEMENTATION-DATA-TYPE>
        <IMPLEMENTATION-DATA-TYPE>
            <SHORT-NAME>Spi_NumberOfDataType</SHORT-NAME>
            <CATEGORY>TYPE_REFERENCE</CATEGORY>
            <SW-DATA-DEF-PROPS>
                <SW-DATA-DEF-PROPS-VARIANTS>
                    <SW-DATA-DEF-PROPS-CONDITIONAL>
                        <IMPLEMENTATION-DATA-TYPE-REF DEST="IMPLEMENTATION-DATA-TYPE">/AUTOSAR_Platform/ImplementationDataTypes/uint16</IMPLEMENTATION-DATA-TYPE-REF>
                        <SW-IMPL-POLICY>STANDARD</SW-IMPL-POLICY>
                    </SW-DATA-DEF-PROPS-CONDITIONAL>
                </SW-DATA-DEF-PROPS-VARIANTS>
            </SW-DATA-DEF-PROPS>
            <TYPE-EMITTER>BSW</TYPE-EMITTER>
        </IMPLEMENTATION-DATA-TYPE>
        <IMPLEMENTATION-DATA-TYPE>
            <SHORT-NAME>Spi_ChannelType</SHORT-NAME>
            <CATEGORY>TYPE_REFERENCE</CATEGORY>
            <SW-DATA-DEF-PROPS>
                <SW-DATA-DEF-PROPS-VARIANTS>
                    <SW-DATA-DEF-PROPS-CONDITIONAL>
                        <IMPLEMENTATION-DATA-TYPE-REF DEST="IMPLEMENTATION-DATA-TYPE">/AUTOSAR_Platform/ImplementationDataTypes/uint8</IMPLEMENTATION-DATA-TYPE-REF>
                        <SW-IMPL-POLICY>STANDARD</SW-IMPL-POLICY>
                    </SW-DATA-DEF-PROPS-CONDITIONAL>
                </SW-DATA-DEF-PROPS-VARIANTS>
            </SW-DATA-DEF-PROPS>
            <TYPE-EMITTER>BSW</TYPE-EMITTER>
        </IMPLEMENTATION-DATA-TYPE>
        <IMPLEMENTATION-DATA-TYPE>
            <SHORT-NAME>Spi_JobType</SHORT-NAME>
            <CATEGORY>TYPE_REFERENCE</CATEGORY>
            <SW-DATA-DEF-PROPS>
                <SW-DATA-DEF-PROPS-VARIANTS>
                    <SW-DATA-DEF-PROPS-CONDITIONAL>
                        <IMPLEMENTATION-DATA-TYPE-REF DEST="IMPLEMENTATION-DATA-TYPE">/AUTOSAR_Platform/ImplementationDataTypes/uint16</IMPLEMENTATION-DATA-TYPE-REF>
                        <SW-IMPL-POLICY>STANDARD</SW-IMPL-POLICY>
                    </SW-DATA-DEF-PROPS-CONDITIONAL>
                </SW-DATA-DEF-PROPS-VARIANTS>
            </SW-DATA-DEF-PROPS>
            <TYPE-EMITTER>BSW</TYPE-EMITTER>
        </IMPLEMENTATION-DATA-TYPE>
        <IMPLEMENTATION-DATA-TYPE>
            <SHORT-NAME>Spi_SequenceType</SHORT-NAME>
            <CATEGORY>TYPE_REFERENCE</CATEGORY>
            <SW-DATA-DEF-PROPS>
                <SW-DATA-DEF-PROPS-VARIANTS>
                    <SW-DATA-DEF-PROPS-CONDITIONAL>
                        <IMPLEMENTATION-DATA-TYPE-REF DEST="IMPLEMENTATION-DATA-TYPE">/AUTOSAR_Platform/ImplementationDataTypes/uint8</IMPLEMENTATION-DATA-TYPE-REF>
                        <SW-IMPL-POLICY>STANDARD</SW-IMPL-POLICY>
                    </SW-DATA-DEF-PROPS-CONDITIONAL>
                </SW-DATA-DEF-PROPS-VARIANTS>
            </SW-DATA-DEF-PROPS>
            <TYPE-EMITTER>BSW</TYPE-EMITTER>
        </IMPLEMENTATION-DATA-TYPE>
        <IMPLEMENTATION-DATA-TYPE>
            <SHORT-NAME>Spi_HWUnitType</SHORT-NAME>
            <CATEGORY>TYPE_REFERENCE</CATEGORY>
            <SW-DATA-DEF-PROPS>
                <SW-DATA-DEF-PROPS-VARIANTS>
                    <SW-DATA-DEF-PROPS-CONDITIONAL>
                        <IMPLEMENTATION-DATA-TYPE-REF DEST="IMPLEMENTATION-DATA-TYPE">/AUTOSAR_Platform/ImplementationDataTypes/uint8</IMPLEMENTATION-DATA-TYPE-REF>
                        <SW-IMPL-POLICY>STANDARD</SW-IMPL-POLICY>
                    </SW-DATA-DEF-PROPS-CONDITIONAL>
                </SW-DATA-DEF-PROPS-VARIANTS>
            </SW-DATA-DEF-PROPS>
            <TYPE-EMITTER>BSW</TYPE-EMITTER>
        </IMPLEMENTATION-DATA-TYPE>
        <IMPLEMENTATION-DATA-TYPE>
            <SHORT-NAME>Spi_QSPIHwMapConfigType</SHORT-NAME>
            <CATEGORY>TYPE_REFERENCE</CATEGORY>
            <SW-DATA-DEF-PROPS>
                <SW-DATA-DEF-PROPS-VARIANTS>
                    <SW-DATA-DEF-PROPS-CONDITIONAL>
                        <IMPLEMENTATION-DATA-TYPE-REF DEST="IMPLEMENTATION-DATA-TYPE">/AUTOSAR_Platform/ImplementationDataTypes/uint32</IMPLEMENTATION-DATA-TYPE-REF>
                        <SW-IMPL-POLICY>STANDARD</SW-IMPL-POLICY>
                    </SW-DATA-DEF-PROPS-CONDITIONAL>
                </SW-DATA-DEF-PROPS-VARIANTS>
            </SW-DATA-DEF-PROPS>
            <TYPE-EMITTER>BSW</TYPE-EMITTER>
        </IMPLEMENTATION-DATA-TYPE>
        <IMPLEMENTATION-DATA-TYPE>
            <SHORT-NAME>Spi_ChannelConfigType</SHORT-NAME>
            <CATEGORY>STRUCTURE</CATEGORY>
            <SUB-ELEMENTS>
                <IMPLEMENTATION-DATA-TYPE-ELEMENT>
                    <SHORT-NAME>Defaultdata</SHORT-NAME>
                    <CATEGORY>TYPE_REFERENCE</CATEGORY>
                    <SW-DATA-DEF-PROPS>
                        <SW-DATA-DEF-PROPS-VARIANTS>
                            <SW-DATA-DEF-PROPS-CONDITIONAL>
                                <IMPLEMENTATION-DATA-TYPE-REF DEST="IMPLEMENTATION-DATA-TYPE">/AUTOSAR_Platform/ImplementationDataTypes/uint32</IMPLEMENTATION-DATA-TYPE-REF>
                            </SW-DATA-DEF-PROPS-CONDITIONAL>
                        </SW-DATA-DEF-PROPS-VARIANTS>
                    </SW-DATA-DEF-PROPS>
                </IMPLEMENTATION-DATA-TYPE-ELEMENT>
                <IMPLEMENTATION-DATA-TYPE-ELEMENT>
                    <SHORT-NAME>NoOfDataElements</SHORT-NAME>
                    <CATEGORY>TYPE_REFERENCE</CATEGORY>
                    <SW-DATA-DEF-PROPS>
                        <SW-DATA-DEF-PROPS-VARIANTS>
                            <SW-DATA-DEF-PROPS-CONDITIONAL>
                                <IMPLEMENTATION-DATA-TYPE-REF DEST="IMPLEMENTATION-DATA-TYPE">/AUTOSAR_Platform/ImplementationDataTypes/uint16</IMPLEMENTATION-DATA-TYPE-REF>
                            </SW-DATA-DEF-PROPS-CONDITIONAL>
                        </SW-DATA-DEF-PROPS-VARIANTS>
                    </SW-DATA-DEF-PROPS>
                </IMPLEMENTATION-DATA-TYPE-ELEMENT>
                <IMPLEMENTATION-DATA-TYPE-ELEMENT>
                    <SHORT-NAME>ChannelType</SHORT-NAME>
                    <CATEGORY>TYPE_REFERENCE</CATEGORY>
                    <SW-DATA-DEF-PROPS>
                        <SW-DATA-DEF-PROPS-VARIANTS>
                            <SW-DATA-DEF-PROPS-CONDITIONAL>
                                <IMPLEMENTATION-DATA-TYPE-REF DEST="IMPLEMENTATION-DATA-TYPE">/AUTOSAR_Platform/ImplementationDataTypes/uint8</IMPLEMENTATION-DATA-TYPE-REF>
                            </SW-DATA-DEF-PROPS-CONDITIONAL>
                        </SW-DATA-DEF-PROPS-VARIANTS>
                    </SW-DATA-DEF-PROPS>
                </IMPLEMENTATION-DATA-TYPE-ELEMENT>
[!IF "$Spi_ChannelBuffersAllowed = 0 or $Spi_ChannelBuffersAllowed = 2"!][!//
                <IMPLEMENTATION-DATA-TYPE-ELEMENT>
                    <SHORT-NAME>QSPIHwUnit</SHORT-NAME>
                    <CATEGORY>TYPE_REFERENCE</CATEGORY>
                    <SW-DATA-DEF-PROPS>
                        <SW-DATA-DEF-PROPS-VARIANTS>
                            <SW-DATA-DEF-PROPS-CONDITIONAL>
                                <IMPLEMENTATION-DATA-TYPE-REF DEST="IMPLEMENTATION-DATA-TYPE">/AUTOSAR_Platform/ImplementationDataTypes/uint8</IMPLEMENTATION-DATA-TYPE-REF>
                            </SW-DATA-DEF-PROPS-CONDITIONAL>
                        </SW-DATA-DEF-PROPS-VARIANTS>
                    </SW-DATA-DEF-PROPS>
                </IMPLEMENTATION-DATA-TYPE-ELEMENT>
[!ENDIF!][!//
                <IMPLEMENTATION-DATA-TYPE-ELEMENT>
                    <SHORT-NAME>DataConfig</SHORT-NAME>
                    <CATEGORY>TYPE_REFERENCE</CATEGORY>
                    <SW-DATA-DEF-PROPS>
                        <SW-DATA-DEF-PROPS-VARIANTS>
                            <SW-DATA-DEF-PROPS-CONDITIONAL>
                                <IMPLEMENTATION-DATA-TYPE-REF DEST="IMPLEMENTATION-DATA-TYPE">/AUTOSAR_Platform/ImplementationDataTypes/uint8</IMPLEMENTATION-DATA-TYPE-REF>
                            </SW-DATA-DEF-PROPS-CONDITIONAL>
                        </SW-DATA-DEF-PROPS-VARIANTS>
                    </SW-DATA-DEF-PROPS>
                </IMPLEMENTATION-DATA-TYPE-ELEMENT>
                <IMPLEMENTATION-DATA-TYPE-ELEMENT>
                    <SHORT-NAME>ChannelId</SHORT-NAME>
                    <CATEGORY>TYPE_REFERENCE</CATEGORY>
                    <SW-DATA-DEF-PROPS>
                        <SW-DATA-DEF-PROPS-VARIANTS>
                            <SW-DATA-DEF-PROPS-CONDITIONAL>
                                <IMPLEMENTATION-DATA-TYPE-REF DEST="IMPLEMENTATION-DATA-TYPE">/AUTOSAR_Spi/ImplementationDataTypes/Spi_ChannelType</IMPLEMENTATION-DATA-TYPE-REF>
                            </SW-DATA-DEF-PROPS-CONDITIONAL>
                        </SW-DATA-DEF-PROPS-VARIANTS>
                    </SW-DATA-DEF-PROPS>
                </IMPLEMENTATION-DATA-TYPE-ELEMENT>
            </SUB-ELEMENTS>
        </IMPLEMENTATION-DATA-TYPE>
        <IMPLEMENTATION-DATA-TYPE>
            <SHORT-NAME>Spi_ConfigType</SHORT-NAME>
            <CATEGORY>STRUCTURE</CATEGORY>
            <SUB-ELEMENTS>
                <IMPLEMENTATION-DATA-TYPE-ELEMENT>
                    <SHORT-NAME>CoreConfigPtr</SHORT-NAME>
                    <CATEGORY>DATA_REFERENCE</CATEGORY>
                    <SW-DATA-DEF-PROPS>
                        <SW-DATA-DEF-PROPS-VARIANTS>
                            <SW-DATA-DEF-PROPS-CONDITIONAL>
                                <SW-POINTER-TARGET-PROPS>
                                    <TARGET-CATEGORY>TYPE_REFERENCE</TARGET-CATEGORY>
                                    <SW-DATA-DEF-PROPS>
                                        <SW-DATA-DEF-PROPS-VARIANTS>
                                            <SW-DATA-DEF-PROPS-CONDITIONAL>
                                                <IMPLEMENTATION-DATA-TYPE-REF DEST="IMPLEMENTATION-DATA-TYPE">/AUTOSAR_Spi/ImplementationDataTypes/Spi_CoreConfigType</IMPLEMENTATION-DATA-TYPE-REF>
                                            </SW-DATA-DEF-PROPS-CONDITIONAL>
                                        </SW-DATA-DEF-PROPS-VARIANTS>
                                    </SW-DATA-DEF-PROPS>
                                </SW-POINTER-TARGET-PROPS>
                            </SW-DATA-DEF-PROPS-CONDITIONAL>
                        </SW-DATA-DEF-PROPS-VARIANTS>
                    </SW-DATA-DEF-PROPS>
                </IMPLEMENTATION-DATA-TYPE-ELEMENT>
                <IMPLEMENTATION-DATA-TYPE-ELEMENT>
                    <SHORT-NAME>SequenceLookup</SHORT-NAME>
                    <CATEGORY>DATA_REFERENCE</CATEGORY>
                    <SW-DATA-DEF-PROPS>
                        <SW-DATA-DEF-PROPS-VARIANTS>
                            <SW-DATA-DEF-PROPS-CONDITIONAL>
                                <SW-POINTER-TARGET-PROPS>
                                    <TARGET-CATEGORY>TYPE_REFERENCE</TARGET-CATEGORY>
                                    <SW-DATA-DEF-PROPS>
                                        <SW-DATA-DEF-PROPS-VARIANTS>
                                            <SW-DATA-DEF-PROPS-CONDITIONAL>
                                                <IMPLEMENTATION-DATA-TYPE-REF DEST="IMPLEMENTATION-DATA-TYPE">/AUTOSAR_Platform/ImplementationDataTypes/uint8</IMPLEMENTATION-DATA-TYPE-REF>
                                            </SW-DATA-DEF-PROPS-CONDITIONAL>
                                        </SW-DATA-DEF-PROPS-VARIANTS>
                                    </SW-DATA-DEF-PROPS>
                                </SW-POINTER-TARGET-PROPS>
                            </SW-DATA-DEF-PROPS-CONDITIONAL>
                        </SW-DATA-DEF-PROPS-VARIANTS>
                    </SW-DATA-DEF-PROPS>
                </IMPLEMENTATION-DATA-TYPE-ELEMENT>
                <IMPLEMENTATION-DATA-TYPE-ELEMENT>
                    <SHORT-NAME>JobLookup</SHORT-NAME>
                    <CATEGORY>DATA_REFERENCE</CATEGORY>
                    <SW-DATA-DEF-PROPS>
                        <SW-DATA-DEF-PROPS-VARIANTS>
                            <SW-DATA-DEF-PROPS-CONDITIONAL>
                                <SW-POINTER-TARGET-PROPS>
                                    <TARGET-CATEGORY>TYPE_REFERENCE</TARGET-CATEGORY>
                                    <SW-DATA-DEF-PROPS>
                                        <SW-DATA-DEF-PROPS-VARIANTS>
                                            <SW-DATA-DEF-PROPS-CONDITIONAL>
                                                <IMPLEMENTATION-DATA-TYPE-REF DEST="IMPLEMENTATION-DATA-TYPE">/AUTOSAR_Platform/ImplementationDataTypes/uint16</IMPLEMENTATION-DATA-TYPE-REF>
                                            </SW-DATA-DEF-PROPS-CONDITIONAL>
                                        </SW-DATA-DEF-PROPS-VARIANTS>
                                    </SW-DATA-DEF-PROPS>
                                </SW-POINTER-TARGET-PROPS>
                            </SW-DATA-DEF-PROPS-CONDITIONAL>
                        </SW-DATA-DEF-PROPS-VARIANTS>
                    </SW-DATA-DEF-PROPS>
                </IMPLEMENTATION-DATA-TYPE-ELEMENT>
                <IMPLEMENTATION-DATA-TYPE-ELEMENT>
                    <SHORT-NAME>ChannelLookup</SHORT-NAME>
                    <CATEGORY>DATA_REFERENCE</CATEGORY>
                    <SW-DATA-DEF-PROPS>
                        <SW-DATA-DEF-PROPS-VARIANTS>
                            <SW-DATA-DEF-PROPS-CONDITIONAL>
                                <SW-POINTER-TARGET-PROPS>
                                    <TARGET-CATEGORY>TYPE_REFERENCE</TARGET-CATEGORY>
                                    <SW-DATA-DEF-PROPS>
                                        <SW-DATA-DEF-PROPS-VARIANTS>
                                            <SW-DATA-DEF-PROPS-CONDITIONAL>
                                                <IMPLEMENTATION-DATA-TYPE-REF DEST="IMPLEMENTATION-DATA-TYPE">/AUTOSAR_Platform/ImplementationDataTypes/uint8</IMPLEMENTATION-DATA-TYPE-REF>
                                            </SW-DATA-DEF-PROPS-CONDITIONAL>
                                        </SW-DATA-DEF-PROPS-VARIANTS>
                                    </SW-DATA-DEF-PROPS>
                                </SW-POINTER-TARGET-PROPS>
                            </SW-DATA-DEF-PROPS-CONDITIONAL>
                        </SW-DATA-DEF-PROPS-VARIANTS>
                    </SW-DATA-DEF-PROPS>
                </IMPLEMENTATION-DATA-TYPE-ELEMENT>
                <IMPLEMENTATION-DATA-TYPE-ELEMENT>
                    <SHORT-NAME>NoOfSequences</SHORT-NAME>
                    <CATEGORY>TYPE_REFERENCE</CATEGORY>
                    <SW-DATA-DEF-PROPS>
                        <SW-DATA-DEF-PROPS-VARIANTS>
                            <SW-DATA-DEF-PROPS-CONDITIONAL>
                                <IMPLEMENTATION-DATA-TYPE-REF DEST="IMPLEMENTATION-DATA-TYPE">/AUTOSAR_Spi/ImplementationDataTypes/Spi_SequenceType</IMPLEMENTATION-DATA-TYPE-REF>
                            </SW-DATA-DEF-PROPS-CONDITIONAL>
                        </SW-DATA-DEF-PROPS-VARIANTS>
                    </SW-DATA-DEF-PROPS>
                </IMPLEMENTATION-DATA-TYPE-ELEMENT>
                <IMPLEMENTATION-DATA-TYPE-ELEMENT>
                    <SHORT-NAME>NoOfJobs</SHORT-NAME>
                    <CATEGORY>TYPE_REFERENCE</CATEGORY>
                    <SW-DATA-DEF-PROPS>
                        <SW-DATA-DEF-PROPS-VARIANTS>
                            <SW-DATA-DEF-PROPS-CONDITIONAL>
                                <IMPLEMENTATION-DATA-TYPE-REF DEST="IMPLEMENTATION-DATA-TYPE">/AUTOSAR_Spi/ImplementationDataTypes/Spi_JobType</IMPLEMENTATION-DATA-TYPE-REF>
                            </SW-DATA-DEF-PROPS-CONDITIONAL>
                        </SW-DATA-DEF-PROPS-VARIANTS>
                    </SW-DATA-DEF-PROPS>
                </IMPLEMENTATION-DATA-TYPE-ELEMENT>
                <IMPLEMENTATION-DATA-TYPE-ELEMENT>
                    <SHORT-NAME>NoOfChannels</SHORT-NAME>
                    <CATEGORY>TYPE_REFERENCE</CATEGORY>
                    <SW-DATA-DEF-PROPS>
                        <SW-DATA-DEF-PROPS-VARIANTS>
                            <SW-DATA-DEF-PROPS-CONDITIONAL>
                                <IMPLEMENTATION-DATA-TYPE-REF DEST="IMPLEMENTATION-DATA-TYPE">/AUTOSAR_Spi/ImplementationDataTypes/Spi_ChannelType</IMPLEMENTATION-DATA-TYPE-REF>
                            </SW-DATA-DEF-PROPS-CONDITIONAL>
                        </SW-DATA-DEF-PROPS-VARIANTS>
                    </SW-DATA-DEF-PROPS>
                </IMPLEMENTATION-DATA-TYPE-ELEMENT>
                <IMPLEMENTATION-DATA-TYPE-ELEMENT>
                    <SHORT-NAME>SyncTimeout</SHORT-NAME>
                    <CATEGORY>TYPE_REFERENCE</CATEGORY>
                    <SW-DATA-DEF-PROPS>
                        <SW-DATA-DEF-PROPS-VARIANTS>
                            <SW-DATA-DEF-PROPS-CONDITIONAL>
                                <IMPLEMENTATION-DATA-TYPE-REF DEST="IMPLEMENTATION-DATA-TYPE">/AUTOSAR_Platform/ImplementationDataTypes/uint32</IMPLEMENTATION-DATA-TYPE-REF>
                            </SW-DATA-DEF-PROPS-CONDITIONAL>
                        </SW-DATA-DEF-PROPS-VARIANTS>
                    </SW-DATA-DEF-PROPS>
                </IMPLEMENTATION-DATA-TYPE-ELEMENT>
            </SUB-ELEMENTS>
        </IMPLEMENTATION-DATA-TYPE>
        <IMPLEMENTATION-DATA-TYPE>
            <SHORT-NAME>Spi_CoreChannelOffsetType</SHORT-NAME>
            <CATEGORY>STRUCTURE</CATEGORY>
            <SUB-ELEMENTS>
                <IMPLEMENTATION-DATA-TYPE-ELEMENT>
                    <SHORT-NAME>ChannelOffset</SHORT-NAME>
                    <CATEGORY>TYPE_REFERENCE</CATEGORY>
                    <SW-DATA-DEF-PROPS>
                        <SW-DATA-DEF-PROPS-VARIANTS>
                            <SW-DATA-DEF-PROPS-CONDITIONAL>
                                <IMPLEMENTATION-DATA-TYPE-REF DEST="IMPLEMENTATION-DATA-TYPE">/AUTOSAR_Platform/ImplementationDataTypes/uint16</IMPLEMENTATION-DATA-TYPE-REF>
                            </SW-DATA-DEF-PROPS-CONDITIONAL>
                        </SW-DATA-DEF-PROPS-VARIANTS>
                    </SW-DATA-DEF-PROPS>
                </IMPLEMENTATION-DATA-TYPE-ELEMENT>
                <IMPLEMENTATION-DATA-TYPE-ELEMENT>
                    <SHORT-NAME>DataTransferLength</SHORT-NAME>
                    <CATEGORY>TYPE_REFERENCE</CATEGORY>
                    <SW-DATA-DEF-PROPS>
                        <SW-DATA-DEF-PROPS-VARIANTS>
                            <SW-DATA-DEF-PROPS-CONDITIONAL>
                                <IMPLEMENTATION-DATA-TYPE-REF DEST="IMPLEMENTATION-DATA-TYPE">/AUTOSAR_Platform/ImplementationDataTypes/uint16</IMPLEMENTATION-DATA-TYPE-REF>
                            </SW-DATA-DEF-PROPS-CONDITIONAL>
                        </SW-DATA-DEF-PROPS-VARIANTS>
                    </SW-DATA-DEF-PROPS>
                </IMPLEMENTATION-DATA-TYPE-ELEMENT>
            </SUB-ELEMENTS>
        </IMPLEMENTATION-DATA-TYPE>
        <IMPLEMENTATION-DATA-TYPE>
            <SHORT-NAME>Spi_CoreConfigType</SHORT-NAME>
            <CATEGORY>STRUCTURE</CATEGORY>
            <SUB-ELEMENTS>
                <IMPLEMENTATION-DATA-TYPE-ELEMENT>
                    <SHORT-NAME>SequenceConfigPtr</SHORT-NAME>
                    <CATEGORY>DATA_REFERENCE</CATEGORY>
                    <SW-DATA-DEF-PROPS>
                        <SW-DATA-DEF-PROPS-VARIANTS>
                            <SW-DATA-DEF-PROPS-CONDITIONAL>
                                <SW-POINTER-TARGET-PROPS>
                                    <TARGET-CATEGORY>TYPE_REFERENCE</TARGET-CATEGORY>
                                    <SW-DATA-DEF-PROPS>
                                        <SW-DATA-DEF-PROPS-VARIANTS>
                                            <SW-DATA-DEF-PROPS-CONDITIONAL>
                                                <IMPLEMENTATION-DATA-TYPE-REF DEST="IMPLEMENTATION-DATA-TYPE">/AUTOSAR_Spi/ImplementationDataTypes/Spi_SequenceConfigType</IMPLEMENTATION-DATA-TYPE-REF>
                                            </SW-DATA-DEF-PROPS-CONDITIONAL>
                                        </SW-DATA-DEF-PROPS-VARIANTS>
                                    </SW-DATA-DEF-PROPS>
                                </SW-POINTER-TARGET-PROPS>
                            </SW-DATA-DEF-PROPS-CONDITIONAL>
                        </SW-DATA-DEF-PROPS-VARIANTS>
                    </SW-DATA-DEF-PROPS>
                </IMPLEMENTATION-DATA-TYPE-ELEMENT>
                <IMPLEMENTATION-DATA-TYPE-ELEMENT>
                    <SHORT-NAME>JobConfigPtr</SHORT-NAME>
                    <CATEGORY>DATA_REFERENCE</CATEGORY>
                    <SW-DATA-DEF-PROPS>
                        <SW-DATA-DEF-PROPS-VARIANTS>
                            <SW-DATA-DEF-PROPS-CONDITIONAL>
                                <SW-POINTER-TARGET-PROPS>
                                    <TARGET-CATEGORY>TYPE_REFERENCE</TARGET-CATEGORY>
                                    <SW-DATA-DEF-PROPS>
                                        <SW-DATA-DEF-PROPS-VARIANTS>
                                            <SW-DATA-DEF-PROPS-CONDITIONAL>
                                                <IMPLEMENTATION-DATA-TYPE-REF DEST="IMPLEMENTATION-DATA-TYPE">/AUTOSAR_Spi/ImplementationDataTypes/Spi_JobConfigType</IMPLEMENTATION-DATA-TYPE-REF>
                                            </SW-DATA-DEF-PROPS-CONDITIONAL>
                                        </SW-DATA-DEF-PROPS-VARIANTS>
                                    </SW-DATA-DEF-PROPS>
                                </SW-POINTER-TARGET-PROPS>
                            </SW-DATA-DEF-PROPS-CONDITIONAL>
                        </SW-DATA-DEF-PROPS-VARIANTS>
                    </SW-DATA-DEF-PROPS>
                </IMPLEMENTATION-DATA-TYPE-ELEMENT>
                <IMPLEMENTATION-DATA-TYPE-ELEMENT>
                    <SHORT-NAME>ChannelConfigPtr</SHORT-NAME>
                    <CATEGORY>DATA_REFERENCE</CATEGORY>
                    <SW-DATA-DEF-PROPS>
                        <SW-DATA-DEF-PROPS-VARIANTS>
                            <SW-DATA-DEF-PROPS-CONDITIONAL>
                                <SW-POINTER-TARGET-PROPS>
                                    <TARGET-CATEGORY>TYPE_REFERENCE</TARGET-CATEGORY>
                                    <SW-DATA-DEF-PROPS>
                                        <SW-DATA-DEF-PROPS-VARIANTS>
                                            <SW-DATA-DEF-PROPS-CONDITIONAL>
                                                <IMPLEMENTATION-DATA-TYPE-REF DEST="IMPLEMENTATION-DATA-TYPE">/AUTOSAR_Spi/ImplementationDataTypes/Spi_ChannelConfigType</IMPLEMENTATION-DATA-TYPE-REF>
                                            </SW-DATA-DEF-PROPS-CONDITIONAL>
                                        </SW-DATA-DEF-PROPS-VARIANTS>
                                    </SW-DATA-DEF-PROPS>
                                </SW-POINTER-TARGET-PROPS>
                            </SW-DATA-DEF-PROPS-CONDITIONAL>
                        </SW-DATA-DEF-PROPS-VARIANTS>
                    </SW-DATA-DEF-PROPS>
                </IMPLEMENTATION-DATA-TYPE-ELEMENT>
                <IMPLEMENTATION-DATA-TYPE-ELEMENT>
                    <SHORT-NAME>ChannelOffsetInfo</SHORT-NAME>
                    <CATEGORY>TYPE_REFERENCE</CATEGORY>
                    <SW-DATA-DEF-PROPS>
                        <SW-DATA-DEF-PROPS-VARIANTS>
                            <SW-DATA-DEF-PROPS-CONDITIONAL>
                                <IMPLEMENTATION-DATA-TYPE-REF DEST="IMPLEMENTATION-DATA-TYPE">/AUTOSAR_Spi/ImplementationDataTypes/Spi_CoreChannelOffsetType</IMPLEMENTATION-DATA-TYPE-REF>
                            </SW-DATA-DEF-PROPS-CONDITIONAL>
                        </SW-DATA-DEF-PROPS-VARIANTS>
                    </SW-DATA-DEF-PROPS>
                </IMPLEMENTATION-DATA-TYPE-ELEMENT>
                <IMPLEMENTATION-DATA-TYPE-ELEMENT>
                    <SHORT-NAME>QSPIHwConfigPtr</SHORT-NAME>
                    <CATEGORY>DATA_REFERENCE</CATEGORY>
                    <SW-DATA-DEF-PROPS>
                        <SW-DATA-DEF-PROPS-VARIANTS>
                            <SW-DATA-DEF-PROPS-CONDITIONAL>
                                <SW-POINTER-TARGET-PROPS>
                                    <TARGET-CATEGORY>TYPE_REFERENCE</TARGET-CATEGORY>
                                    <SW-DATA-DEF-PROPS>
                                        <SW-DATA-DEF-PROPS-VARIANTS>
                                            <SW-DATA-DEF-PROPS-CONDITIONAL>
                                                <IMPLEMENTATION-DATA-TYPE-REF DEST="IMPLEMENTATION-DATA-TYPE">/AUTOSAR_Spi/ImplementationDataTypes/Spi_QspiHwConfigType</IMPLEMENTATION-DATA-TYPE-REF>
                                            </SW-DATA-DEF-PROPS-CONDITIONAL>
                                        </SW-DATA-DEF-PROPS-VARIANTS>
                                    </SW-DATA-DEF-PROPS>
                                </SW-POINTER-TARGET-PROPS>
                            </SW-DATA-DEF-PROPS-CONDITIONAL>
                        </SW-DATA-DEF-PROPS-VARIANTS>
                    </SW-DATA-DEF-PROPS>
                </IMPLEMENTATION-DATA-TYPE-ELEMENT>
                <IMPLEMENTATION-DATA-TYPE-ELEMENT>
                    <SHORT-NAME>QSPIHwMap</SHORT-NAME>
                    <CATEGORY>DATA_REFERENCE</CATEGORY>
                    <SW-DATA-DEF-PROPS>
                        <SW-DATA-DEF-PROPS-VARIANTS>
                            <SW-DATA-DEF-PROPS-CONDITIONAL>
                                <SW-POINTER-TARGET-PROPS>
                                    <TARGET-CATEGORY>TYPE_REFERENCE</TARGET-CATEGORY>
                                    <SW-DATA-DEF-PROPS>
                                        <SW-DATA-DEF-PROPS-VARIANTS>
                                            <SW-DATA-DEF-PROPS-CONDITIONAL>
                                                <IMPLEMENTATION-DATA-TYPE-REF DEST="IMPLEMENTATION-DATA-TYPE">/AUTOSAR_Spi/ImplementationDataTypes/Spi_QSPIHwMapConfigType</IMPLEMENTATION-DATA-TYPE-REF>
                                            </SW-DATA-DEF-PROPS-CONDITIONAL>
                                        </SW-DATA-DEF-PROPS-VARIANTS>
                                    </SW-DATA-DEF-PROPS>
                                </SW-POINTER-TARGET-PROPS>
                            </SW-DATA-DEF-PROPS-CONDITIONAL>
                        </SW-DATA-DEF-PROPS-VARIANTS>
                    </SW-DATA-DEF-PROPS>
                </IMPLEMENTATION-DATA-TYPE-ELEMENT>
                <IMPLEMENTATION-DATA-TYPE-ELEMENT>
                    <SHORT-NAME>NoOfSequences</SHORT-NAME>
                    <CATEGORY>TYPE_REFERENCE</CATEGORY>
                    <SW-DATA-DEF-PROPS>
                        <SW-DATA-DEF-PROPS-VARIANTS>
                            <SW-DATA-DEF-PROPS-CONDITIONAL>
                                <IMPLEMENTATION-DATA-TYPE-REF DEST="IMPLEMENTATION-DATA-TYPE">/AUTOSAR_Spi/ImplementationDataTypes/Spi_SequenceType</IMPLEMENTATION-DATA-TYPE-REF>
                            </SW-DATA-DEF-PROPS-CONDITIONAL>
                        </SW-DATA-DEF-PROPS-VARIANTS>
                    </SW-DATA-DEF-PROPS>
                </IMPLEMENTATION-DATA-TYPE-ELEMENT>
                <IMPLEMENTATION-DATA-TYPE-ELEMENT>
                    <SHORT-NAME>NoOfJobs</SHORT-NAME>
                    <CATEGORY>TYPE_REFERENCE</CATEGORY>
                    <SW-DATA-DEF-PROPS>
                        <SW-DATA-DEF-PROPS-VARIANTS>
                            <SW-DATA-DEF-PROPS-CONDITIONAL>
                                <IMPLEMENTATION-DATA-TYPE-REF DEST="IMPLEMENTATION-DATA-TYPE">/AUTOSAR_Spi/ImplementationDataTypes/Spi_JobType</IMPLEMENTATION-DATA-TYPE-REF>
                            </SW-DATA-DEF-PROPS-CONDITIONAL>
                        </SW-DATA-DEF-PROPS-VARIANTS>
                    </SW-DATA-DEF-PROPS>
                </IMPLEMENTATION-DATA-TYPE-ELEMENT>
                <IMPLEMENTATION-DATA-TYPE-ELEMENT>
                    <SHORT-NAME>NoOfChannels</SHORT-NAME>
                    <CATEGORY>TYPE_REFERENCE</CATEGORY>
                    <SW-DATA-DEF-PROPS>
                        <SW-DATA-DEF-PROPS-VARIANTS>
                            <SW-DATA-DEF-PROPS-CONDITIONAL>
                                <IMPLEMENTATION-DATA-TYPE-REF DEST="IMPLEMENTATION-DATA-TYPE">/AUTOSAR_Spi/ImplementationDataTypes/Spi_ChannelType</IMPLEMENTATION-DATA-TYPE-REF>
                            </SW-DATA-DEF-PROPS-CONDITIONAL>
                        </SW-DATA-DEF-PROPS-VARIANTS>
                    </SW-DATA-DEF-PROPS>
                </IMPLEMENTATION-DATA-TYPE-ELEMENT>
            </SUB-ELEMENTS>
        </IMPLEMENTATION-DATA-TYPE>
        <IMPLEMENTATION-DATA-TYPE>
            <SHORT-NAME>Spi_JobConfigType</SHORT-NAME>
            <CATEGORY>STRUCTURE</CATEGORY>
            <SUB-ELEMENTS>
                <IMPLEMENTATION-DATA-TYPE-ELEMENT>
                    <SHORT-NAME>JobId</SHORT-NAME>
                    <CATEGORY>TYPE_REFERENCE</CATEGORY>
                    <SW-DATA-DEF-PROPS>
                        <SW-DATA-DEF-PROPS-VARIANTS>
                            <SW-DATA-DEF-PROPS-CONDITIONAL>
                                <IMPLEMENTATION-DATA-TYPE-REF DEST="IMPLEMENTATION-DATA-TYPE">/AUTOSAR_Spi/ImplementationDataTypes/Spi_JobType</IMPLEMENTATION-DATA-TYPE-REF>
                            </SW-DATA-DEF-PROPS-CONDITIONAL>
                        </SW-DATA-DEF-PROPS-VARIANTS>
                    </SW-DATA-DEF-PROPS>
                </IMPLEMENTATION-DATA-TYPE-ELEMENT>
[!IF "$Spi_LevelDelivered = 1 or $Spi_LevelDelivered = 2"!][!//
                <IMPLEMENTATION-DATA-TYPE-ELEMENT>
                    <SHORT-NAME>JobNotification</SHORT-NAME>
                    <CATEGORY>TYPE_REFERENCE</CATEGORY>
                    <SW-DATA-DEF-PROPS>
                        <SW-DATA-DEF-PROPS-VARIANTS>
                            <SW-DATA-DEF-PROPS-CONDITIONAL>
                                <IMPLEMENTATION-DATA-TYPE-REF DEST="IMPLEMENTATION-DATA-TYPE">/AUTOSAR_Spi/ImplementationDataTypes/Spi_JobEndNotification</IMPLEMENTATION-DATA-TYPE-REF>
                            </SW-DATA-DEF-PROPS-CONDITIONAL>
                        </SW-DATA-DEF-PROPS-VARIANTS>
                    </SW-DATA-DEF-PROPS>
                </IMPLEMENTATION-DATA-TYPE-ELEMENT>
[!ENDIF!][!//
                <IMPLEMENTATION-DATA-TYPE-ELEMENT>
                    <SHORT-NAME>BaudRateAndClockParam</SHORT-NAME>
                    <CATEGORY>TYPE_REFERENCE</CATEGORY>
                    <SW-DATA-DEF-PROPS>
                        <SW-DATA-DEF-PROPS-VARIANTS>
                            <SW-DATA-DEF-PROPS-CONDITIONAL>
                                <IMPLEMENTATION-DATA-TYPE-REF DEST="IMPLEMENTATION-DATA-TYPE">/AUTOSAR_Platform/ImplementationDataTypes/uint32</IMPLEMENTATION-DATA-TYPE-REF>
                            </SW-DATA-DEF-PROPS-CONDITIONAL>
                        </SW-DATA-DEF-PROPS-VARIANTS>
                    </SW-DATA-DEF-PROPS>
                </IMPLEMENTATION-DATA-TYPE-ELEMENT>
                <IMPLEMENTATION-DATA-TYPE-ELEMENT>
                    <SHORT-NAME>IdleLeadTrailDelay</SHORT-NAME>
                    <CATEGORY>TYPE_REFERENCE</CATEGORY>
                    <SW-DATA-DEF-PROPS>
                        <SW-DATA-DEF-PROPS-VARIANTS>
                            <SW-DATA-DEF-PROPS-CONDITIONAL>
                                <IMPLEMENTATION-DATA-TYPE-REF DEST="IMPLEMENTATION-DATA-TYPE">/AUTOSAR_Platform/ImplementationDataTypes/uint32</IMPLEMENTATION-DATA-TYPE-REF>
                            </SW-DATA-DEF-PROPS-CONDITIONAL>
                        </SW-DATA-DEF-PROPS-VARIANTS>
                    </SW-DATA-DEF-PROPS>
                </IMPLEMENTATION-DATA-TYPE-ELEMENT>
                <IMPLEMENTATION-DATA-TYPE-ELEMENT>
                    <SHORT-NAME>ChnlLinkPtrPhysical</SHORT-NAME>
                    <CATEGORY>DATA_REFERENCE</CATEGORY>
                    <SW-DATA-DEF-PROPS>
                        <SW-DATA-DEF-PROPS-VARIANTS>
                            <SW-DATA-DEF-PROPS-CONDITIONAL>
                                <SW-POINTER-TARGET-PROPS>
                                    <TARGET-CATEGORY>TYPE_REFERENCE</TARGET-CATEGORY>
                                    <SW-DATA-DEF-PROPS>
                                        <SW-DATA-DEF-PROPS-VARIANTS>
                                            <SW-DATA-DEF-PROPS-CONDITIONAL>
                                                <IMPLEMENTATION-DATA-TYPE-REF DEST="IMPLEMENTATION-DATA-TYPE">/AUTOSAR_Spi/ImplementationDataTypes/Spi_ChannelType</IMPLEMENTATION-DATA-TYPE-REF>
                                            </SW-DATA-DEF-PROPS-CONDITIONAL>
                                        </SW-DATA-DEF-PROPS-VARIANTS>
                                    </SW-DATA-DEF-PROPS>
                                </SW-POINTER-TARGET-PROPS>
                            </SW-DATA-DEF-PROPS-CONDITIONAL>
                        </SW-DATA-DEF-PROPS-VARIANTS>
                    </SW-DATA-DEF-PROPS>
                </IMPLEMENTATION-DATA-TYPE-ELEMENT>
                <IMPLEMENTATION-DATA-TYPE-ELEMENT>
                    <SHORT-NAME>CSPortPin</SHORT-NAME>
                    <CATEGORY>TYPE_REFERENCE</CATEGORY>
                    <SW-DATA-DEF-PROPS>
                        <SW-DATA-DEF-PROPS-VARIANTS>
                            <SW-DATA-DEF-PROPS-CONDITIONAL>
                                <IMPLEMENTATION-DATA-TYPE-REF DEST="IMPLEMENTATION-DATA-TYPE">/AUTOSAR_Platform/ImplementationDataTypes/uint16</IMPLEMENTATION-DATA-TYPE-REF>
                            </SW-DATA-DEF-PROPS-CONDITIONAL>
                        </SW-DATA-DEF-PROPS-VARIANTS>
                    </SW-DATA-DEF-PROPS>
                </IMPLEMENTATION-DATA-TYPE-ELEMENT>
                <IMPLEMENTATION-DATA-TYPE-ELEMENT>
                    <SHORT-NAME>JobPriority</SHORT-NAME>
                    <CATEGORY>TYPE_REFERENCE</CATEGORY>
                    <SW-DATA-DEF-PROPS>
                        <SW-DATA-DEF-PROPS-VARIANTS>
                            <SW-DATA-DEF-PROPS-CONDITIONAL>
                                <IMPLEMENTATION-DATA-TYPE-REF DEST="IMPLEMENTATION-DATA-TYPE">/AUTOSAR_Platform/ImplementationDataTypes/uint8</IMPLEMENTATION-DATA-TYPE-REF>
                            </SW-DATA-DEF-PROPS-CONDITIONAL>
                        </SW-DATA-DEF-PROPS-VARIANTS>
                    </SW-DATA-DEF-PROPS>
                </IMPLEMENTATION-DATA-TYPE-ELEMENT>
                <IMPLEMENTATION-DATA-TYPE-ELEMENT>
                    <SHORT-NAME>CsPolarity</SHORT-NAME>
                    <CATEGORY>TYPE_REFERENCE</CATEGORY>
                    <SW-DATA-DEF-PROPS>
                        <SW-DATA-DEF-PROPS-VARIANTS>
                            <SW-DATA-DEF-PROPS-CONDITIONAL>
                                <IMPLEMENTATION-DATA-TYPE-REF DEST="IMPLEMENTATION-DATA-TYPE">/AUTOSAR_Platform/ImplementationDataTypes/uint8</IMPLEMENTATION-DATA-TYPE-REF>
                            </SW-DATA-DEF-PROPS-CONDITIONAL>
                        </SW-DATA-DEF-PROPS-VARIANTS>
                    </SW-DATA-DEF-PROPS>
                </IMPLEMENTATION-DATA-TYPE-ELEMENT>
                <IMPLEMENTATION-DATA-TYPE-ELEMENT>
                    <SHORT-NAME>HwUnit</SHORT-NAME>
                    <CATEGORY>TYPE_REFERENCE</CATEGORY>
                    <SW-DATA-DEF-PROPS>
                        <SW-DATA-DEF-PROPS-VARIANTS>
                            <SW-DATA-DEF-PROPS-CONDITIONAL>
                                <IMPLEMENTATION-DATA-TYPE-REF DEST="IMPLEMENTATION-DATA-TYPE">/AUTOSAR_Spi/ImplementationDataTypes/Spi_HWUnitType</IMPLEMENTATION-DATA-TYPE-REF>
                            </SW-DATA-DEF-PROPS-CONDITIONAL>
                        </SW-DATA-DEF-PROPS-VARIANTS>
                    </SW-DATA-DEF-PROPS>
                </IMPLEMENTATION-DATA-TYPE-ELEMENT>
                <IMPLEMENTATION-DATA-TYPE-ELEMENT>
                    <SHORT-NAME>ParitySupport</SHORT-NAME>
                    <CATEGORY>TYPE_REFERENCE</CATEGORY>
                    <SW-DATA-DEF-PROPS>
                        <SW-DATA-DEF-PROPS-VARIANTS>
                            <SW-DATA-DEF-PROPS-CONDITIONAL>
                                <IMPLEMENTATION-DATA-TYPE-REF DEST="IMPLEMENTATION-DATA-TYPE">/AUTOSAR_Platform/ImplementationDataTypes/uint8</IMPLEMENTATION-DATA-TYPE-REF>
                            </SW-DATA-DEF-PROPS-CONDITIONAL>
                        </SW-DATA-DEF-PROPS-VARIANTS>
                    </SW-DATA-DEF-PROPS>
                </IMPLEMENTATION-DATA-TYPE-ELEMENT>
                <IMPLEMENTATION-DATA-TYPE-ELEMENT>
                    <SHORT-NAME>FramebasedCs</SHORT-NAME>
                    <CATEGORY>TYPE_REFERENCE</CATEGORY>
                    <SW-DATA-DEF-PROPS>
                        <SW-DATA-DEF-PROPS-VARIANTS>
                            <SW-DATA-DEF-PROPS-CONDITIONAL>
                                <IMPLEMENTATION-DATA-TYPE-REF DEST="IMPLEMENTATION-DATA-TYPE">/AUTOSAR_Platform/ImplementationDataTypes/uint8</IMPLEMENTATION-DATA-TYPE-REF>
                            </SW-DATA-DEF-PROPS-CONDITIONAL>
                        </SW-DATA-DEF-PROPS-VARIANTS>
                    </SW-DATA-DEF-PROPS>
                </IMPLEMENTATION-DATA-TYPE-ELEMENT>
            </SUB-ELEMENTS>
        </IMPLEMENTATION-DATA-TYPE>
        <IMPLEMENTATION-DATA-TYPE>
            <SHORT-NAME>Spi_QspiHwConfigType</SHORT-NAME>
            <CATEGORY>STRUCTURE</CATEGORY>
            <SUB-ELEMENTS>
                <IMPLEMENTATION-DATA-TYPE-ELEMENT>
                    <SHORT-NAME>ActiveChipSelectLevel</SHORT-NAME>
                    <CATEGORY>TYPE_REFERENCE</CATEGORY>
                    <SW-DATA-DEF-PROPS>
                        <SW-DATA-DEF-PROPS-VARIANTS>
                            <SW-DATA-DEF-PROPS-CONDITIONAL>
                                <IMPLEMENTATION-DATA-TYPE-REF DEST="IMPLEMENTATION-DATA-TYPE">/AUTOSAR_Platform/ImplementationDataTypes/uint32</IMPLEMENTATION-DATA-TYPE-REF>
                            </SW-DATA-DEF-PROPS-CONDITIONAL>
                        </SW-DATA-DEF-PROPS-VARIANTS>
                    </SW-DATA-DEF-PROPS>
                </IMPLEMENTATION-DATA-TYPE-ELEMENT>
                <IMPLEMENTATION-DATA-TYPE-ELEMENT>
                    <SHORT-NAME>IBBufferSize</SHORT-NAME>
                    <CATEGORY>TYPE_REFERENCE</CATEGORY>
                    <SW-DATA-DEF-PROPS>
                        <SW-DATA-DEF-PROPS-VARIANTS>
                            <SW-DATA-DEF-PROPS-CONDITIONAL>
                                <IMPLEMENTATION-DATA-TYPE-REF DEST="IMPLEMENTATION-DATA-TYPE">/AUTOSAR_Platform/ImplementationDataTypes/uint32</IMPLEMENTATION-DATA-TYPE-REF>
                            </SW-DATA-DEF-PROPS-CONDITIONAL>
                        </SW-DATA-DEF-PROPS-VARIANTS>
                    </SW-DATA-DEF-PROPS>
                </IMPLEMENTATION-DATA-TYPE-ELEMENT>
                <IMPLEMENTATION-DATA-TYPE-ELEMENT>
                    <SHORT-NAME>JobQueueLength</SHORT-NAME>
                    <CATEGORY>TYPE_REFERENCE</CATEGORY>
                    <SW-DATA-DEF-PROPS>
                        <SW-DATA-DEF-PROPS-VARIANTS>
                            <SW-DATA-DEF-PROPS-CONDITIONAL>
                                <IMPLEMENTATION-DATA-TYPE-REF DEST="IMPLEMENTATION-DATA-TYPE">/AUTOSAR_Platform/ImplementationDataTypes/uint16</IMPLEMENTATION-DATA-TYPE-REF>
                            </SW-DATA-DEF-PROPS-CONDITIONAL>
                        </SW-DATA-DEF-PROPS-VARIANTS>
                    </SW-DATA-DEF-PROPS>
                </IMPLEMENTATION-DATA-TYPE-ELEMENT>
[!IF "$Spi_LevelDelivered = 1 or $Spi_LevelDelivered = 2"!][!//
                <IMPLEMENTATION-DATA-TYPE-ELEMENT>
                    <SHORT-NAME>DMARxChannel</SHORT-NAME>
                    <CATEGORY>TYPE_REFERENCE</CATEGORY>
                    <SW-DATA-DEF-PROPS>
                        <SW-DATA-DEF-PROPS-VARIANTS>
                            <SW-DATA-DEF-PROPS-CONDITIONAL>
                                <IMPLEMENTATION-DATA-TYPE-REF DEST="IMPLEMENTATION-DATA-TYPE">/AUTOSAR_Platform/ImplementationDataTypes/uint8</IMPLEMENTATION-DATA-TYPE-REF>
                            </SW-DATA-DEF-PROPS-CONDITIONAL>
                        </SW-DATA-DEF-PROPS-VARIANTS>
                    </SW-DATA-DEF-PROPS>
                </IMPLEMENTATION-DATA-TYPE-ELEMENT>
                <IMPLEMENTATION-DATA-TYPE-ELEMENT>
                    <SHORT-NAME>DMATxChannel</SHORT-NAME>
                    <CATEGORY>TYPE_REFERENCE</CATEGORY>
                    <SW-DATA-DEF-PROPS>
                        <SW-DATA-DEF-PROPS-VARIANTS>
                            <SW-DATA-DEF-PROPS-CONDITIONAL>
                                <IMPLEMENTATION-DATA-TYPE-REF DEST="IMPLEMENTATION-DATA-TYPE">/AUTOSAR_Platform/ImplementationDataTypes/uint8</IMPLEMENTATION-DATA-TYPE-REF>
                            </SW-DATA-DEF-PROPS-CONDITIONAL>
                        </SW-DATA-DEF-PROPS-VARIANTS>
                    </SW-DATA-DEF-PROPS>
                </IMPLEMENTATION-DATA-TYPE-ELEMENT>
                <IMPLEMENTATION-DATA-TYPE-ELEMENT>
                    <SHORT-NAME>DMATCSCount</SHORT-NAME>
                    <CATEGORY>TYPE_REFERENCE</CATEGORY>
                    <SW-DATA-DEF-PROPS>
                        <SW-DATA-DEF-PROPS-VARIANTS>
                            <SW-DATA-DEF-PROPS-CONDITIONAL>
                                <IMPLEMENTATION-DATA-TYPE-REF DEST="IMPLEMENTATION-DATA-TYPE">/AUTOSAR_Platform/ImplementationDataTypes/uint8</IMPLEMENTATION-DATA-TYPE-REF>
                            </SW-DATA-DEF-PROPS-CONDITIONAL>
                        </SW-DATA-DEF-PROPS-VARIANTS>
                    </SW-DATA-DEF-PROPS>
                </IMPLEMENTATION-DATA-TYPE-ELEMENT>
[!ENDIF!][!//
                <IMPLEMENTATION-DATA-TYPE-ELEMENT>
                    <SHORT-NAME>ClockSetting</SHORT-NAME>
                    <CATEGORY>TYPE_REFERENCE</CATEGORY>
                    <SW-DATA-DEF-PROPS>
                        <SW-DATA-DEF-PROPS-VARIANTS>
                            <SW-DATA-DEF-PROPS-CONDITIONAL>
                                <IMPLEMENTATION-DATA-TYPE-REF DEST="IMPLEMENTATION-DATA-TYPE">/AUTOSAR_Platform/ImplementationDataTypes/uint8</IMPLEMENTATION-DATA-TYPE-REF>
                            </SW-DATA-DEF-PROPS-CONDITIONAL>
                        </SW-DATA-DEF-PROPS-VARIANTS>
                    </SW-DATA-DEF-PROPS>
                </IMPLEMENTATION-DATA-TYPE-ELEMENT>
                <IMPLEMENTATION-DATA-TYPE-ELEMENT>
                    <SHORT-NAME>MasterReceivePortPin</SHORT-NAME>
                    <CATEGORY>TYPE_REFERENCE</CATEGORY>
                    <SW-DATA-DEF-PROPS>
                        <SW-DATA-DEF-PROPS-VARIANTS>
                            <SW-DATA-DEF-PROPS-CONDITIONAL>
                                <IMPLEMENTATION-DATA-TYPE-REF DEST="IMPLEMENTATION-DATA-TYPE">/AUTOSAR_Platform/ImplementationDataTypes/uint8</IMPLEMENTATION-DATA-TYPE-REF>
                            </SW-DATA-DEF-PROPS-CONDITIONAL>
                        </SW-DATA-DEF-PROPS-VARIANTS>
                    </SW-DATA-DEF-PROPS>
                </IMPLEMENTATION-DATA-TYPE-ELEMENT>
                <IMPLEMENTATION-DATA-TYPE-ELEMENT>
                    <SHORT-NAME>MaxSequence</SHORT-NAME>
                    <CATEGORY>TYPE_REFERENCE</CATEGORY>
                    <SW-DATA-DEF-PROPS>
                        <SW-DATA-DEF-PROPS-VARIANTS>
                            <SW-DATA-DEF-PROPS-CONDITIONAL>
                                <IMPLEMENTATION-DATA-TYPE-REF DEST="IMPLEMENTATION-DATA-TYPE">/AUTOSAR_Spi/ImplementationDataTypes/Spi_SequenceType</IMPLEMENTATION-DATA-TYPE-REF>
                            </SW-DATA-DEF-PROPS-CONDITIONAL>
                        </SW-DATA-DEF-PROPS-VARIANTS>
                    </SW-DATA-DEF-PROPS>
                </IMPLEMENTATION-DATA-TYPE-ELEMENT>
            </SUB-ELEMENTS>
        </IMPLEMENTATION-DATA-TYPE>
        <IMPLEMENTATION-DATA-TYPE>
            <SHORT-NAME>Spi_SequenceConfigType</SHORT-NAME>
            <CATEGORY>STRUCTURE</CATEGORY>
            <SUB-ELEMENTS>
                <IMPLEMENTATION-DATA-TYPE-ELEMENT>
                    <SHORT-NAME>SequenceId</SHORT-NAME>
                    <CATEGORY>TYPE_REFERENCE</CATEGORY>
                    <SW-DATA-DEF-PROPS>
                        <SW-DATA-DEF-PROPS-VARIANTS>
                            <SW-DATA-DEF-PROPS-CONDITIONAL>
                                <IMPLEMENTATION-DATA-TYPE-REF DEST="IMPLEMENTATION-DATA-TYPE">/AUTOSAR_Spi/ImplementationDataTypes/Spi_SequenceType</IMPLEMENTATION-DATA-TYPE-REF>
                            </SW-DATA-DEF-PROPS-CONDITIONAL>
                        </SW-DATA-DEF-PROPS-VARIANTS>
                    </SW-DATA-DEF-PROPS>
                </IMPLEMENTATION-DATA-TYPE-ELEMENT>
[!IF "$Spi_LevelDelivered = 1 or $Spi_LevelDelivered = 2"!][!//
                <IMPLEMENTATION-DATA-TYPE-ELEMENT>
                    <SHORT-NAME>SeqNotification</SHORT-NAME>
                    <CATEGORY>TYPE_REFERENCE</CATEGORY>
                    <SW-DATA-DEF-PROPS>
                        <SW-DATA-DEF-PROPS-VARIANTS>
                            <SW-DATA-DEF-PROPS-CONDITIONAL>
                                <IMPLEMENTATION-DATA-TYPE-REF DEST="IMPLEMENTATION-DATA-TYPE">/AUTOSAR_Spi/ImplementationDataTypes/Spi_SeqEndNotification</IMPLEMENTATION-DATA-TYPE-REF>
                            </SW-DATA-DEF-PROPS-CONDITIONAL>
                        </SW-DATA-DEF-PROPS-VARIANTS>
                    </SW-DATA-DEF-PROPS>
                </IMPLEMENTATION-DATA-TYPE-ELEMENT>
[!ENDIF!][!//
                <IMPLEMENTATION-DATA-TYPE-ELEMENT>
                    <SHORT-NAME>JobLinkPtrPhysical</SHORT-NAME>
                    <CATEGORY>DATA_REFERENCE</CATEGORY>
                    <SW-DATA-DEF-PROPS>
                        <SW-DATA-DEF-PROPS-VARIANTS>
                            <SW-DATA-DEF-PROPS-CONDITIONAL>
                                <SW-POINTER-TARGET-PROPS>
                                    <TARGET-CATEGORY>TYPE_REFERENCE</TARGET-CATEGORY>
                                    <SW-DATA-DEF-PROPS>
                                        <SW-DATA-DEF-PROPS-VARIANTS>
                                            <SW-DATA-DEF-PROPS-CONDITIONAL>
                                                <IMPLEMENTATION-DATA-TYPE-REF DEST="IMPLEMENTATION-DATA-TYPE">/AUTOSAR_Spi/ImplementationDataTypes/Spi_JobType</IMPLEMENTATION-DATA-TYPE-REF>
                                            </SW-DATA-DEF-PROPS-CONDITIONAL>
                                        </SW-DATA-DEF-PROPS-VARIANTS>
                                    </SW-DATA-DEF-PROPS>
                                </SW-POINTER-TARGET-PROPS>
                            </SW-DATA-DEF-PROPS-CONDITIONAL>
                        </SW-DATA-DEF-PROPS-VARIANTS>
                    </SW-DATA-DEF-PROPS>
                </IMPLEMENTATION-DATA-TYPE-ELEMENT>
[!IF "$Spi_LevelDelivered = 1 or $Spi_LevelDelivered = 2"!][!//
                <IMPLEMENTATION-DATA-TYPE-ELEMENT>
                    <SHORT-NAME>SeqSharePtr</SHORT-NAME>
                    <CATEGORY>DATA_REFERENCE</CATEGORY>
                    <SW-DATA-DEF-PROPS>
                        <SW-DATA-DEF-PROPS-VARIANTS>
                            <SW-DATA-DEF-PROPS-CONDITIONAL>
                                <SW-POINTER-TARGET-PROPS>
                                    <TARGET-CATEGORY>TYPE_REFERENCE</TARGET-CATEGORY>
                                    <SW-DATA-DEF-PROPS>
                                        <SW-DATA-DEF-PROPS-VARIANTS>
                                            <SW-DATA-DEF-PROPS-CONDITIONAL>
                                                <IMPLEMENTATION-DATA-TYPE-REF DEST="IMPLEMENTATION-DATA-TYPE">/AUTOSAR_Platform/ImplementationDataTypes/uint8</IMPLEMENTATION-DATA-TYPE-REF>
                                            </SW-DATA-DEF-PROPS-CONDITIONAL>
                                        </SW-DATA-DEF-PROPS-VARIANTS>
                                    </SW-DATA-DEF-PROPS>
                                </SW-POINTER-TARGET-PROPS>
                            </SW-DATA-DEF-PROPS-CONDITIONAL>
                        </SW-DATA-DEF-PROPS-VARIANTS>
                    </SW-DATA-DEF-PROPS>
                </IMPLEMENTATION-DATA-TYPE-ELEMENT>
[!ENDIF!][!//
                <IMPLEMENTATION-DATA-TYPE-ELEMENT>
                    <SHORT-NAME>NoOfJobInSeq</SHORT-NAME>
                    <CATEGORY>TYPE_REFERENCE</CATEGORY>
                    <SW-DATA-DEF-PROPS>
                        <SW-DATA-DEF-PROPS-VARIANTS>
                            <SW-DATA-DEF-PROPS-CONDITIONAL>
                                <IMPLEMENTATION-DATA-TYPE-REF DEST="IMPLEMENTATION-DATA-TYPE">/AUTOSAR_Platform/ImplementationDataTypes/uint16</IMPLEMENTATION-DATA-TYPE-REF>
                            </SW-DATA-DEF-PROPS-CONDITIONAL>
                        </SW-DATA-DEF-PROPS-VARIANTS>
                    </SW-DATA-DEF-PROPS>
                </IMPLEMENTATION-DATA-TYPE-ELEMENT>
[!IF "(SpiGeneral/SpiLevelDelivered != num:i(0)) and (SpiGeneral/SpiInterruptibleSeqAllowed = 'true')"!][!//
                <IMPLEMENTATION-DATA-TYPE-ELEMENT>
                    <SHORT-NAME>SeqInterruptible</SHORT-NAME>
                    <CATEGORY>TYPE_REFERENCE</CATEGORY>
                    <SW-DATA-DEF-PROPS>
                        <SW-DATA-DEF-PROPS-VARIANTS>
                            <SW-DATA-DEF-PROPS-CONDITIONAL>
                                <IMPLEMENTATION-DATA-TYPE-REF DEST="IMPLEMENTATION-DATA-TYPE">/AUTOSAR_Platform/ImplementationDataTypes/uint8</IMPLEMENTATION-DATA-TYPE-REF>
                            </SW-DATA-DEF-PROPS-CONDITIONAL>
                        </SW-DATA-DEF-PROPS-VARIANTS>
                    </SW-DATA-DEF-PROPS>
                </IMPLEMENTATION-DATA-TYPE-ELEMENT>
[!ENDIF!][!//
                <IMPLEMENTATION-DATA-TYPE-ELEMENT>
                    <SHORT-NAME>HwModuleUsed</SHORT-NAME>
                    <CATEGORY>TYPE_REFERENCE</CATEGORY>
                    <SW-DATA-DEF-PROPS>
                        <SW-DATA-DEF-PROPS-VARIANTS>
                            <SW-DATA-DEF-PROPS-CONDITIONAL>
                                <IMPLEMENTATION-DATA-TYPE-REF DEST="IMPLEMENTATION-DATA-TYPE">/AUTOSAR_Platform/ImplementationDataTypes/uint8</IMPLEMENTATION-DATA-TYPE-REF>
                            </SW-DATA-DEF-PROPS-CONDITIONAL>
                        </SW-DATA-DEF-PROPS-VARIANTS>
                    </SW-DATA-DEF-PROPS>
                </IMPLEMENTATION-DATA-TYPE-ELEMENT>
                <IMPLEMENTATION-DATA-TYPE-ELEMENT>
                    <SHORT-NAME>u8Comm</SHORT-NAME>
                    <CATEGORY>TYPE_REFERENCE</CATEGORY>
                    <SW-DATA-DEF-PROPS>
                        <SW-DATA-DEF-PROPS-VARIANTS>
                            <SW-DATA-DEF-PROPS-CONDITIONAL>
                                <IMPLEMENTATION-DATA-TYPE-REF DEST="IMPLEMENTATION-DATA-TYPE">/AUTOSAR_Platform/ImplementationDataTypes/uint8</IMPLEMENTATION-DATA-TYPE-REF>
                            </SW-DATA-DEF-PROPS-CONDITIONAL>
                        </SW-DATA-DEF-PROPS-VARIANTS>
                    </SW-DATA-DEF-PROPS>
                </IMPLEMENTATION-DATA-TYPE-ELEMENT>
            </SUB-ELEMENTS>
        </IMPLEMENTATION-DATA-TYPE>
    </ELEMENTS>
</AR-PACKAGE>
            <AR-PACKAGE>
    <SHORT-NAME>CompuMethods</SHORT-NAME>
    <CATEGORY>STANDARD</CATEGORY>
    <ELEMENTS>
[!IF "$Spi_LevelDelivered = 2"!][!//
        <COMPU-METHOD>
            <SHORT-NAME>Spi_AsyncModeType</SHORT-NAME>
            <CATEGORY>TEXTTABLE</CATEGORY>
            <COMPU-INTERNAL-TO-PHYS>
                <COMPU-SCALES>
                    <COMPU-SCALE>
                        <LOWER-LIMIT INTERVAL-TYPE="CLOSED">0</LOWER-LIMIT>
                        <UPPER-LIMIT INTERVAL-TYPE="CLOSED">0</UPPER-LIMIT>
                        <COMPU-CONST>
                            <VT>SPI_POLLING_MODE</VT>
                        </COMPU-CONST>
                    </COMPU-SCALE>
                    <COMPU-SCALE>
                        <LOWER-LIMIT INTERVAL-TYPE="CLOSED">1</LOWER-LIMIT>
                        <UPPER-LIMIT INTERVAL-TYPE="CLOSED">1</UPPER-LIMIT>
                        <COMPU-CONST>
                            <VT>SPI_INTERRUPT_MODE</VT>
                        </COMPU-CONST>
                    </COMPU-SCALE>
                </COMPU-SCALES>
            </COMPU-INTERNAL-TO-PHYS>
        </COMPU-METHOD>
[!ENDIF!][!//
        <COMPU-METHOD>
            <SHORT-NAME>Spi_JobResultType</SHORT-NAME>
            <CATEGORY>TEXTTABLE</CATEGORY>
            <COMPU-INTERNAL-TO-PHYS>
                <COMPU-SCALES>
                    <COMPU-SCALE>
                        <LOWER-LIMIT INTERVAL-TYPE="CLOSED">0</LOWER-LIMIT>
                        <UPPER-LIMIT INTERVAL-TYPE="CLOSED">0</UPPER-LIMIT>
                        <COMPU-CONST>
                            <VT>SPI_JOB_OK</VT>
                        </COMPU-CONST>
                    </COMPU-SCALE>
                    <COMPU-SCALE>
                        <LOWER-LIMIT INTERVAL-TYPE="CLOSED">1</LOWER-LIMIT>
                        <UPPER-LIMIT INTERVAL-TYPE="CLOSED">1</UPPER-LIMIT>
                        <COMPU-CONST>
                            <VT>SPI_JOB_PENDING</VT>
                        </COMPU-CONST>
                    </COMPU-SCALE>
                    <COMPU-SCALE>
                        <LOWER-LIMIT INTERVAL-TYPE="CLOSED">2</LOWER-LIMIT>
                        <UPPER-LIMIT INTERVAL-TYPE="CLOSED">2</UPPER-LIMIT>
                        <COMPU-CONST>
                            <VT>SPI_JOB_FAILED</VT>
                        </COMPU-CONST>
                    </COMPU-SCALE>
                    <COMPU-SCALE>
                        <LOWER-LIMIT INTERVAL-TYPE="CLOSED">3</LOWER-LIMIT>
                        <UPPER-LIMIT INTERVAL-TYPE="CLOSED">3</UPPER-LIMIT>
                        <COMPU-CONST>
                            <VT>SPI_JOB_QUEUED</VT>
                        </COMPU-CONST>
                    </COMPU-SCALE>
                </COMPU-SCALES>
            </COMPU-INTERNAL-TO-PHYS>
        </COMPU-METHOD>
        <COMPU-METHOD>
            <SHORT-NAME>Spi_SeqResultType</SHORT-NAME>
            <CATEGORY>TEXTTABLE</CATEGORY>
            <COMPU-INTERNAL-TO-PHYS>
                <COMPU-SCALES>
                    <COMPU-SCALE>
                        <LOWER-LIMIT INTERVAL-TYPE="CLOSED">0</LOWER-LIMIT>
                        <UPPER-LIMIT INTERVAL-TYPE="CLOSED">0</UPPER-LIMIT>
                        <COMPU-CONST>
                            <VT>SPI_SEQ_OK</VT>
                        </COMPU-CONST>
                    </COMPU-SCALE>
                    <COMPU-SCALE>
                        <LOWER-LIMIT INTERVAL-TYPE="CLOSED">1</LOWER-LIMIT>
                        <UPPER-LIMIT INTERVAL-TYPE="CLOSED">1</UPPER-LIMIT>
                        <COMPU-CONST>
                            <VT>SPI_SEQ_PENDING</VT>
                        </COMPU-CONST>
                    </COMPU-SCALE>
                    <COMPU-SCALE>
                        <LOWER-LIMIT INTERVAL-TYPE="CLOSED">2</LOWER-LIMIT>
                        <UPPER-LIMIT INTERVAL-TYPE="CLOSED">2</UPPER-LIMIT>
                        <COMPU-CONST>
                            <VT>SPI_SEQ_FAILED</VT>
                        </COMPU-CONST>
                    </COMPU-SCALE>
                    <COMPU-SCALE>
                        <LOWER-LIMIT INTERVAL-TYPE="CLOSED">3</LOWER-LIMIT>
                        <UPPER-LIMIT INTERVAL-TYPE="CLOSED">3</UPPER-LIMIT>
                        <COMPU-CONST>
                            <VT>SPI_SEQ_CANCELLED</VT>
                        </COMPU-CONST>
                    </COMPU-SCALE>
                </COMPU-SCALES>
            </COMPU-INTERNAL-TO-PHYS>
        </COMPU-METHOD>
        <COMPU-METHOD>
            <SHORT-NAME>Spi_StatusType</SHORT-NAME>
            <CATEGORY>TEXTTABLE</CATEGORY>
            <COMPU-INTERNAL-TO-PHYS>
                <COMPU-SCALES>
                    <COMPU-SCALE>
                        <LOWER-LIMIT INTERVAL-TYPE="CLOSED">0</LOWER-LIMIT>
                        <UPPER-LIMIT INTERVAL-TYPE="CLOSED">0</UPPER-LIMIT>
                        <COMPU-CONST>
                            <VT>SPI_UNINIT</VT>
                        </COMPU-CONST>
                    </COMPU-SCALE>
                    <COMPU-SCALE>
                        <LOWER-LIMIT INTERVAL-TYPE="CLOSED">1</LOWER-LIMIT>
                        <UPPER-LIMIT INTERVAL-TYPE="CLOSED">1</UPPER-LIMIT>
                        <COMPU-CONST>
                            <VT>SPI_IDLE</VT>
                        </COMPU-CONST>
                    </COMPU-SCALE>
                    <COMPU-SCALE>
                        <LOWER-LIMIT INTERVAL-TYPE="CLOSED">2</LOWER-LIMIT>
                        <UPPER-LIMIT INTERVAL-TYPE="CLOSED">2</UPPER-LIMIT>
                        <COMPU-CONST>
                            <VT>SPI_BUSY</VT>
                        </COMPU-CONST>
                    </COMPU-SCALE>
                </COMPU-SCALES>
            </COMPU-INTERNAL-TO-PHYS>
        </COMPU-METHOD>
    </ELEMENTS>
</AR-PACKAGE>
</AR-PACKAGES>
    </AR-PACKAGE>
</AR-PACKAGES>
</AUTOSAR>
