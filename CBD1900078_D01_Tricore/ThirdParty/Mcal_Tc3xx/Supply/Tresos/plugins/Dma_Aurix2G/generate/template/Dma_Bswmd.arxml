<?xml version="1.0" encoding="UTF-8"?>
<!--
/*******************************************************************************
**                                                                            **
** Copyright (C) Infineon Technologies (2018)                                 **
**                                                                            **
** All rights reserved.                                                       **
**                                                                            **
** This document contains proprietary information belonging to Infineon       **
** Technologies. Passing on and copying of this document, and communication   **
** of its contents is not permitted without prior written authorization.      **
**                                                                            **
********************************************************************************
**                                                                            **
**  FILENAME  : Dma_Bswmd.arxml                                               **
**                                                                            **
**  VERSION   : 7.0.0                                                         **
**                                                                            **
**  DATE      : 2018-09-25                                                    **
**                                                                            **
**  VARIANT   : Variant PB                                                    **
**                                                                            **
**  PLATFORM  : Infineon AURIX2G                                              **
**                                                                            **
**  AUTHOR    : DL-AUTOSAR-Engineering                                        **
**                                                                            **
**  VENDOR    : Infineon Technologies                                         **
**                                                                            **
**  TRACEABILITY : [cover parentID={A36A6BFF-A2EC-4006-A9A4-33B08992D89B},    **
**                                 {8550B3E1-A196-41b9-B6F1-B247D4C45F0D},    **
**                                 {53E0D858-21DE-40cb-B7C9-BBEA798F1C6B}]    **
**                                                                            **
**  DESCRIPTION  : Basic Software Module Description for Dma driver           **
**                                                                            **
**  [/cover]                                                                  **
**                                                                            **
**  SPECIFICATION(S) : AURIX2G MCAL DMA Software Requirements Document        **
**                                                                            **
**  MAY BE CHANGED BY USER : no                                               **
**                                                                            **
*******************************************************************************/
-->
<AUTOSAR xmlns="http://autosar.org/schema/r4.0" xmlns:xsi="http://www.w3.org/2001/XMLSchema-instance" xsi:schemaLocation="http://autosar.org/schema/r4.0 AUTOSAR_4-2-2.xsd">
[!NOCODE!][!//
    [!INCLUDE "Dma.m"!][!//
[!ENDNOCODE!][!//

[!AUTOSPACING!][!//
[!NOCODE!][!//
    [!SELECT "as:modconf('Dma')[1]"!][!//
        [!VAR "Dma_HardwareTriggerApi_Xpath"="DmaGeneral/DmaTriggerApiConfiguration"!][!//
        [!VAR "Dma_DeinitApi_Xpath"="DmaGeneral/DmaDeinitApiConfiguration"!][!//
        [!VAR "Dma_SuspendApi_Xpath"="DmaGeneral/DmaSuspendApiConfiguration"!][!//
        [!VAR "Dma_PendingApi_Xpath"="DmaGeneral/DmaDataPendingApiConfiguration"!][!//
        [!VAR "Dma_BufferSwitchApi_Xpath"="DmaGeneral/DmaBufferSwitchApiConfiguration"!][!//
        [!VAR "Dma_VersionInfoApi_Xpath"="DmaGeneral/DmaVersionInfoApi"!][!//
        [!VAR "DmaSafetyEnable_Xpath"="DmaGeneral/DmaSafetyEnable"!][!//
        [!VAR "DmaInitCheckApi_Xpath"="DmaGeneral/DmaInitCheckApi"!][!//

        [!IF "ecu:has('Tasking.Version') and ecu:has('Tasking.Compiler.Options') and ecu:has('Tasking.Linker.Options')"!][!//
            [!VAR "TaskingCompilerOption" = "ecu:get('Tasking.Compiler.Options')"!][!//
            [!VAR "TaskingLinkerOption"   = "ecu:get('Tasking.Linker.Options')"!][!//
            [!VAR "TaskingVersion"        = "ecu:get('Tasking.Version')"!][!//
        [!ELSE!]
            [!ERROR!] Tasking Options not available in Property File[!ENDERROR!][!//
        [!ENDIF!]

        [!IF "ecu:has('Gnuc.Version') and ecu:has('Gnuc.Compiler.Options') and ecu:has('Gnuc.Linker.Options')"!][!//
            [!VAR "GnucCompilerOption" = "ecu:get('Gnuc.Compiler.Options')"!][!//
            [!VAR "GnucLinkerOption"   = "ecu:get('Gnuc.Linker.Options')"!][!//
            [!VAR "GnucVersion"        = "ecu:get('Gnuc.Version')"!][!//
        [!ELSE!]
            [!ERROR!] GNUC Options not available in Property File[!ENDERROR!][!//
        [!ENDIF!]

        [!IF "ecu:has('Ghs.Version') and ecu:has('Ghs.Compiler.Options') and ecu:has('Ghs.Linker.Options')"!][!//
            [!VAR "GhsCompilerOption" = "ecu:get('Ghs.Compiler.Options')"!][!//
            [!VAR "GhsLinkerOption"   = "ecu:get('Ghs.Linker.Options')"!][!//
            [!VAR "GhsVersion"        = "ecu:get('Ghs.Version')"!][!//
        [!ELSE!]
            [!ERROR!] GHS Options not available in Property File[!ENDERROR!][!//
        [!ENDIF!]

        [!IF "ecu:has('Dcc.Version') and ecu:has('Dcc.Compiler.Options') and ecu:has('Dcc.Linker.Options')"!][!//
            [!VAR "DccCompilerOption" = "ecu:get('Dcc.Compiler.Options')"!][!//
            [!VAR "DccLinkerOption"   = "ecu:get('Dcc.Linker.Options')"!][!//
            [!VAR "DccVersion"        = "ecu:get('Dcc.Version')"!][!//
        [!ELSE!]
            [!ERROR!] DCC Options not available in Property File[!ENDERROR!][!//
        [!ENDIF!]
        
        [!IF "ecu:has('McalLib.NoOfCoreAvailable') and ecu:has('Dma.MaxDmaChannel')"!][!//
            [!VAR "NoOfCores"       = "num:i(ecu:get('McalLib.NoOfCoreAvailable'))"!]
            [!VAR "NoOfDmaChannels" = "num:i(ecu:get('Dma.MaxDmaChannel'))"!]
        [!ELSE!]
            [!ERROR!] Number of Cores/Number of DMA channels not available in Property File[!ENDERROR!][!//
        [!ENDIF!]
        
    [!ENDSELECT!][!//
[!ENDNOCODE!][!//
<AR-PACKAGES>
    <AR-PACKAGE>
        <SHORT-NAME>AURIX2G_Dma</SHORT-NAME>
        <AR-PACKAGES>
            <AR-PACKAGE>
                <SHORT-NAME>BswModuleDescriptions</SHORT-NAME>
                <CATEGORY>STANDARD</CATEGORY>
                <ELEMENTS>
                    <BSW-MODULE-DESCRIPTION>
                        <SHORT-NAME>Dma</SHORT-NAME>
                        <LONG-NAME>
                            <L-4 L="EN">Direct Memory Access</L-4>
                        </LONG-NAME>
                        <CATEGORY>BSW_MODULE</CATEGORY>
                        <MODULE-ID>255</MODULE-ID>
                        <PROVIDED-ENTRYS>
                            <BSW-MODULE-ENTRY-REF-CONDITIONAL>
                                <BSW-MODULE-ENTRY-REF DEST="BSW-MODULE-ENTRY">/AURIX2G_Dma/BswModuleEntrys/Dma_Init</BSW-MODULE-ENTRY-REF>
                            </BSW-MODULE-ENTRY-REF-CONDITIONAL>
[!IF "$Dma_DeinitApi_Xpath = 'true'"!]
                            <BSW-MODULE-ENTRY-REF-CONDITIONAL>
                                <BSW-MODULE-ENTRY-REF DEST="BSW-MODULE-ENTRY">/AURIX2G_Dma/BswModuleEntrys/Dma_ChDeInit</BSW-MODULE-ENTRY-REF>
                            </BSW-MODULE-ENTRY-REF-CONDITIONAL>
[!ENDIF!][!//
                            <BSW-MODULE-ENTRY-REF-CONDITIONAL>
                                <BSW-MODULE-ENTRY-REF DEST="BSW-MODULE-ENTRY">/AURIX2G_Dma/BswModuleEntrys/Dma_IsInitDone</BSW-MODULE-ENTRY-REF>
                            </BSW-MODULE-ENTRY-REF-CONDITIONAL>
                            <BSW-MODULE-ENTRY-REF-CONDITIONAL>
                                <BSW-MODULE-ENTRY-REF DEST="BSW-MODULE-ENTRY">/AURIX2G_Dma/BswModuleEntrys/Dma_ChInit</BSW-MODULE-ENTRY-REF>
                            </BSW-MODULE-ENTRY-REF-CONDITIONAL>
                            <BSW-MODULE-ENTRY-REF-CONDITIONAL>
                                <BSW-MODULE-ENTRY-REF DEST="BSW-MODULE-ENTRY">/AURIX2G_Dma/BswModuleEntrys/Dma_ChUpdate</BSW-MODULE-ENTRY-REF>
                            </BSW-MODULE-ENTRY-REF-CONDITIONAL>
[!IF "$Dma_SuspendApi_Xpath = 'true'"!]
                            <BSW-MODULE-ENTRY-REF-CONDITIONAL>
                                <BSW-MODULE-ENTRY-REF DEST="BSW-MODULE-ENTRY">/AURIX2G_Dma/BswModuleEntrys/Dma_ChTransferFreeze</BSW-MODULE-ENTRY-REF>
                            </BSW-MODULE-ENTRY-REF-CONDITIONAL>
                            <BSW-MODULE-ENTRY-REF-CONDITIONAL>
                                <BSW-MODULE-ENTRY-REF DEST="BSW-MODULE-ENTRY">/AURIX2G_Dma/BswModuleEntrys/Dma_ChTransferResume</BSW-MODULE-ENTRY-REF>
                            </BSW-MODULE-ENTRY-REF-CONDITIONAL>
[!ENDIF!][!//
[!IF "$Dma_HardwareTriggerApi_Xpath = 'true'"!]
                            <BSW-MODULE-ENTRY-REF-CONDITIONAL>
                                <BSW-MODULE-ENTRY-REF DEST="BSW-MODULE-ENTRY">/AURIX2G_Dma/BswModuleEntrys/Dma_ChEnableHardwareTrigger</BSW-MODULE-ENTRY-REF>
                            </BSW-MODULE-ENTRY-REF-CONDITIONAL>
                            <BSW-MODULE-ENTRY-REF-CONDITIONAL>
                                <BSW-MODULE-ENTRY-REF DEST="BSW-MODULE-ENTRY">/AURIX2G_Dma/BswModuleEntrys/Dma_ChDisableHardwareTrigger</BSW-MODULE-ENTRY-REF>
                            </BSW-MODULE-ENTRY-REF-CONDITIONAL>
[!ENDIF!][!//
                            <BSW-MODULE-ENTRY-REF-CONDITIONAL>
                                <BSW-MODULE-ENTRY-REF DEST="BSW-MODULE-ENTRY">/AURIX2G_Dma/BswModuleEntrys/Dma_ChStartTransfer</BSW-MODULE-ENTRY-REF>
                            </BSW-MODULE-ENTRY-REF-CONDITIONAL>
                            <BSW-MODULE-ENTRY-REF-CONDITIONAL>
                                <BSW-MODULE-ENTRY-REF DEST="BSW-MODULE-ENTRY">/AURIX2G_Dma/BswModuleEntrys/Dma_ChStopTransfer</BSW-MODULE-ENTRY-REF>
                            </BSW-MODULE-ENTRY-REF-CONDITIONAL>
[!IF "$Dma_PendingApi_Xpath = 'true'"!]
                            <BSW-MODULE-ENTRY-REF-CONDITIONAL>
                                <BSW-MODULE-ENTRY-REF DEST="BSW-MODULE-ENTRY">/AURIX2G_Dma/BswModuleEntrys/Dma_ChGetRemainingData</BSW-MODULE-ENTRY-REF>
                            </BSW-MODULE-ENTRY-REF-CONDITIONAL>
[!ENDIF!][!//
[!IF "$Dma_BufferSwitchApi_Xpath = 'true'"!]
                            <BSW-MODULE-ENTRY-REF-CONDITIONAL>
                                <BSW-MODULE-ENTRY-REF DEST="BSW-MODULE-ENTRY">/AURIX2G_Dma/BswModuleEntrys/Dma_ChSwitchBuffer</BSW-MODULE-ENTRY-REF>
                            </BSW-MODULE-ENTRY-REF-CONDITIONAL>
[!ENDIF!][!//
                            <BSW-MODULE-ENTRY-REF-CONDITIONAL>
                                <BSW-MODULE-ENTRY-REF DEST="BSW-MODULE-ENTRY">/AURIX2G_Dma/BswModuleEntrys/Dma_ChIsStatusAsserted</BSW-MODULE-ENTRY-REF>
                            </BSW-MODULE-ENTRY-REF-CONDITIONAL>
                            <BSW-MODULE-ENTRY-REF-CONDITIONAL>
                                <BSW-MODULE-ENTRY-REF DEST="BSW-MODULE-ENTRY">/AURIX2G_Dma/BswModuleEntrys/Dma_ChStatusClear</BSW-MODULE-ENTRY-REF>
                            </BSW-MODULE-ENTRY-REF-CONDITIONAL>
                            <BSW-MODULE-ENTRY-REF-CONDITIONAL>
                                <BSW-MODULE-ENTRY-REF DEST="BSW-MODULE-ENTRY">/AURIX2G_Dma/BswModuleEntrys/Dma_ChInterruptEnable</BSW-MODULE-ENTRY-REF>
                            </BSW-MODULE-ENTRY-REF-CONDITIONAL>
                            <BSW-MODULE-ENTRY-REF-CONDITIONAL>
                                <BSW-MODULE-ENTRY-REF DEST="BSW-MODULE-ENTRY">/AURIX2G_Dma/BswModuleEntrys/Dma_ChInterruptDisable</BSW-MODULE-ENTRY-REF>
                            </BSW-MODULE-ENTRY-REF-CONDITIONAL>
                            <BSW-MODULE-ENTRY-REF-CONDITIONAL>
                                <BSW-MODULE-ENTRY-REF DEST="BSW-MODULE-ENTRY">/AURIX2G_Dma/BswModuleEntrys/Dma_GetChannelEvent</BSW-MODULE-ENTRY-REF>
                            </BSW-MODULE-ENTRY-REF-CONDITIONAL>
                            <BSW-MODULE-ENTRY-REF-CONDITIONAL>
                                <BSW-MODULE-ENTRY-REF DEST="BSW-MODULE-ENTRY">/AURIX2G_Dma/BswModuleEntrys/Dma_GetMoveEngineEvent</BSW-MODULE-ENTRY-REF>
                            </BSW-MODULE-ENTRY-REF-CONDITIONAL>
                            <BSW-MODULE-ENTRY-REF-CONDITIONAL>
                                <BSW-MODULE-ENTRY-REF DEST="BSW-MODULE-ENTRY">/AURIX2G_Dma/BswModuleEntrys/Dma_MEStatusClear</BSW-MODULE-ENTRY-REF>
                            </BSW-MODULE-ENTRY-REF-CONDITIONAL>
                            <BSW-MODULE-ENTRY-REF-CONDITIONAL>
                                <BSW-MODULE-ENTRY-REF DEST="BSW-MODULE-ENTRY">/AURIX2G_Dma/BswModuleEntrys/Dma_ChInterruptHandler</BSW-MODULE-ENTRY-REF>
                            </BSW-MODULE-ENTRY-REF-CONDITIONAL>
                            <BSW-MODULE-ENTRY-REF-CONDITIONAL>
                                <BSW-MODULE-ENTRY-REF DEST="BSW-MODULE-ENTRY">/AURIX2G_Dma/BswModuleEntrys/Dma_MEInterruptHandler</BSW-MODULE-ENTRY-REF>
                            </BSW-MODULE-ENTRY-REF-CONDITIONAL>
                            <BSW-MODULE-ENTRY-REF-CONDITIONAL>
                                <BSW-MODULE-ENTRY-REF DEST="BSW-MODULE-ENTRY">/AURIX2G_Dma/BswModuleEntrys/Dma_MEInterruptDispatcher</BSW-MODULE-ENTRY-REF>
                            </BSW-MODULE-ENTRY-REF-CONDITIONAL>
[!IF "$DmaInitCheckApi_Xpath = 'true'"!]
                            <BSW-MODULE-ENTRY-REF-CONDITIONAL>
                                <BSW-MODULE-ENTRY-REF DEST="BSW-MODULE-ENTRY">/AURIX2G_Dma/BswModuleEntrys/Dma_InitCheck</BSW-MODULE-ENTRY-REF>
                            </BSW-MODULE-ENTRY-REF-CONDITIONAL>
[!ENDIF!][!//
                            <BSW-MODULE-ENTRY-REF-CONDITIONAL>
                                <BSW-MODULE-ENTRY-REF DEST="BSW-MODULE-ENTRY">/AURIX2G_Dma/BswModuleEntrys/Dma_GetCurrentTimeStamp</BSW-MODULE-ENTRY-REF>
                            </BSW-MODULE-ENTRY-REF-CONDITIONAL>
                            <BSW-MODULE-ENTRY-REF-CONDITIONAL>
                                <BSW-MODULE-ENTRY-REF DEST="BSW-MODULE-ENTRY">/AURIX2G_Dma/BswModuleEntrys/Dma_GetCrcValue</BSW-MODULE-ENTRY-REF>
                            </BSW-MODULE-ENTRY-REF-CONDITIONAL>
                            <BSW-MODULE-ENTRY-REF-CONDITIONAL>
                                <BSW-MODULE-ENTRY-REF DEST="BSW-MODULE-ENTRY">/AURIX2G_Dma/BswModuleEntrys/Dma_IsChannelInitDone</BSW-MODULE-ENTRY-REF>
                            </BSW-MODULE-ENTRY-REF-CONDITIONAL>
[!IF "$Dma_VersionInfoApi_Xpath = 'true'"!]
                            <BSW-MODULE-ENTRY-REF-CONDITIONAL>
                                <BSW-MODULE-ENTRY-REF DEST="BSW-MODULE-ENTRY">/AURIX2G_Dma/BswModuleEntrys/Dma_GetVersionInfo</BSW-MODULE-ENTRY-REF>
                            </BSW-MODULE-ENTRY-REF-CONDITIONAL>
[!ENDIF!][!//
                        </PROVIDED-ENTRYS>
                        <BSW-MODULE-DEPENDENCYS>
                            <BSW-MODULE-DEPENDENCY>
                                <SHORT-NAME>DetDependency</SHORT-NAME>
                                <TARGET-MODULE-ID>15</TARGET-MODULE-ID>
                                <REQUIRED-ENTRYS>
                                    <BSW-MODULE-ENTRY-REF-CONDITIONAL>
                                        <BSW-MODULE-ENTRY-REF DEST="BSW-MODULE-ENTRY">/AUTOSAR_Det/BswModuleEntrys/Det_ReportError</BSW-MODULE-ENTRY-REF>
                                    </BSW-MODULE-ENTRY-REF-CONDITIONAL>
                                </REQUIRED-ENTRYS>
                            </BSW-MODULE-DEPENDENCY>
                            <BSW-MODULE-DEPENDENCY>
                                <SHORT-NAME>McalLibDependency</SHORT-NAME>
                                <TARGET-MODULE-ID>255</TARGET-MODULE-ID>
                                <REQUIRED-ENTRYS>
                                    <BSW-MODULE-ENTRY-REF-CONDITIONAL>
                                       <BSW-MODULE-ENTRY-REF DEST="BSW-MODULE-ENTRY">/AURIX2G_McalLib/BswModuleEntrys/Mcal_SetBitAtomic</BSW-MODULE-ENTRY-REF>
                                   </BSW-MODULE-ENTRY-REF-CONDITIONAL>
                                   <BSW-MODULE-ENTRY-REF-CONDITIONAL>
                                       <BSW-MODULE-ENTRY-REF DEST="BSW-MODULE-ENTRY">/AURIX2G_McalLib/BswModuleEntrys/Mcal_WriteCpuEndInitProtReg</BSW-MODULE-ENTRY-REF>
                                   </BSW-MODULE-ENTRY-REF-CONDITIONAL>		
                                   <BSW-MODULE-ENTRY-REF-CONDITIONAL>
                                       <BSW-MODULE-ENTRY-REF DEST="BSW-MODULE-ENTRY">/AURIX2G_McalLib/BswModuleEntrys/Mcal_WriteSafetyEndInitProtReg</BSW-MODULE-ENTRY-REF>
                                   </BSW-MODULE-ENTRY-REF-CONDITIONAL>	
                                   <BSW-MODULE-ENTRY-REF-CONDITIONAL>
                                       <BSW-MODULE-ENTRY-REF DEST="BSW-MODULE-ENTRY">/AURIX2G_McalLib/BswModuleEntrys/Mcal_GetCpuIndex</BSW-MODULE-ENTRY-REF>
                                   </BSW-MODULE-ENTRY-REF-CONDITIONAL>	
                                   <BSW-MODULE-ENTRY-REF-CONDITIONAL>
                                       <BSW-MODULE-ENTRY-REF DEST="BSW-MODULE-ENTRY">/AURIX2G_McalLib/BswModuleEntrys/Mcal_GetCpuPhysicalId</BSW-MODULE-ENTRY-REF>
                                   </BSW-MODULE-ENTRY-REF-CONDITIONAL>	       
                                   <BSW-MODULE-ENTRY-REF-CONDITIONAL>
                                       <BSW-MODULE-ENTRY-REF DEST="BSW-MODULE-ENTRY">/AURIX2G_McalLib/BswModuleEntrys/Mcal_GetGlobalDsprAddress</BSW-MODULE-ENTRY-REF>
                                   </BSW-MODULE-ENTRY-REF-CONDITIONAL>	
                                </REQUIRED-ENTRYS>
                            </BSW-MODULE-DEPENDENCY>
[!IF "$DmaSafetyEnable_Xpath = 'true'"!][!//
                            <BSW-MODULE-DEPENDENCY>
                              <SHORT-NAME>McalSafetyErrorDependency</SHORT-NAME>
                              <TARGET-MODULE-ID>255</TARGET-MODULE-ID>
                              <REQUIRED-ENTRYS>
                                <BSW-MODULE-ENTRY-REF-CONDITIONAL>
                                  <BSW-MODULE-ENTRY-REF DEST="BSW-MODULE-ENTRY">/AUTOSAR_SafetyError/BswModuleEntrys/Mcal_ReportSafetyError</BSW-MODULE-ENTRY-REF>
                                </BSW-MODULE-ENTRY-REF-CONDITIONAL>
                              </REQUIRED-ENTRYS>
                            </BSW-MODULE-DEPENDENCY>
[!ENDIF!][!//
                        </BSW-MODULE-DEPENDENCYS>
                        <INTERNAL-BEHAVIORS>
                          <BSW-INTERNAL-BEHAVIOR>
                            <SHORT-NAME>DmaBehavior</SHORT-NAME>
                                <EXCLUSIVE-AREAS>
                                    <EXCLUSIVE-AREA>
                                        <SHORT-NAME>ChannelConfigUpdate</SHORT-NAME>
                                        <INTRODUCTION>
                                            <NOTE SI="User of DMA shall ensure that the critical section protection provided by DMA is implemented to suspend and resume interrupts" NOTE-TYPE="HINT"/>
                                        </INTRODUCTION>
                                    </EXCLUSIVE-AREA>                                   
                                </EXCLUSIVE-AREAS>
                            <ENTITYS>
                              <BSW-CALLED-ENTITY>
                                <SHORT-NAME>Dma_Init</SHORT-NAME>
                                <REENTRANCY-LEVEL>NON-REENTRANT</REENTRANCY-LEVEL>
                                <IMPLEMENTED-ENTRY-REF DEST="BSW-MODULE-ENTRY">/AURIX2G_Dma/BswModuleEntrys/Dma_Init</IMPLEMENTED-ENTRY-REF>
                              </BSW-CALLED-ENTITY>
[!IF "$Dma_DeinitApi_Xpath = 'true'"!]
                              <BSW-CALLED-ENTITY>
                                <SHORT-NAME>Dma_ChDeInit</SHORT-NAME>
                                <CAN-ENTER-EXCLUSIVE-AREA-REFS>
                                  <CAN-ENTER-EXCLUSIVE-AREA-REF DEST="EXCLUSIVE-AREA">/AURIX2G_Dma/BswModuleDescriptions/Dma/DmaBehavior/ChannelConfigUpdate</CAN-ENTER-EXCLUSIVE-AREA-REF>
                                </CAN-ENTER-EXCLUSIVE-AREA-REFS>
                                <REENTRANCY-LEVEL>MULTICORE-REENTRANT</REENTRANCY-LEVEL>
                                <IMPLEMENTED-ENTRY-REF DEST="BSW-MODULE-ENTRY">/AURIX2G_Dma/BswModuleEntrys/Dma_ChDeInit</IMPLEMENTED-ENTRY-REF>
                              </BSW-CALLED-ENTITY>
[!ENDIF!][!//
                              <BSW-CALLED-ENTITY>
                                <SHORT-NAME>Dma_IsInitDone</SHORT-NAME>
                                <REENTRANCY-LEVEL>MULTICORE-REENTRANT</REENTRANCY-LEVEL>
                                <IMPLEMENTED-ENTRY-REF DEST="BSW-MODULE-ENTRY">/AURIX2G_Dma/BswModuleEntrys/Dma_IsInitDone</IMPLEMENTED-ENTRY-REF>
                              </BSW-CALLED-ENTITY>
                              <BSW-CALLED-ENTITY>
                                <SHORT-NAME>Dma_ChInit</SHORT-NAME>
                                <CAN-ENTER-EXCLUSIVE-AREA-REFS>
                                  <CAN-ENTER-EXCLUSIVE-AREA-REF DEST="EXCLUSIVE-AREA">/AURIX2G_Dma/BswModuleDescriptions/Dma/DmaBehavior/ChannelConfigUpdate</CAN-ENTER-EXCLUSIVE-AREA-REF>
                                </CAN-ENTER-EXCLUSIVE-AREA-REFS>
                                <REENTRANCY-LEVEL>MULTICORE-REENTRANT</REENTRANCY-LEVEL>
                                <IMPLEMENTED-ENTRY-REF DEST="BSW-MODULE-ENTRY">/AURIX2G_Dma/BswModuleEntrys/Dma_ChInit</IMPLEMENTED-ENTRY-REF>
                              </BSW-CALLED-ENTITY>
                              <BSW-CALLED-ENTITY>
                                <SHORT-NAME>Dma_ChUpdate</SHORT-NAME>
                                <CAN-ENTER-EXCLUSIVE-AREA-REFS>
                                  <CAN-ENTER-EXCLUSIVE-AREA-REF DEST="EXCLUSIVE-AREA">/AURIX2G_Dma/BswModuleDescriptions/Dma/DmaBehavior/ChannelConfigUpdate</CAN-ENTER-EXCLUSIVE-AREA-REF>
                                </CAN-ENTER-EXCLUSIVE-AREA-REFS>
                                <REENTRANCY-LEVEL>MULTICORE-REENTRANT</REENTRANCY-LEVEL>
                                <IMPLEMENTED-ENTRY-REF DEST="BSW-MODULE-ENTRY">/AURIX2G_Dma/BswModuleEntrys/Dma_ChUpdate</IMPLEMENTED-ENTRY-REF>
                              </BSW-CALLED-ENTITY>
[!IF "$Dma_SuspendApi_Xpath = 'true'"!]
                              <BSW-CALLED-ENTITY>
                                <SHORT-NAME>Dma_ChTransferFreeze</SHORT-NAME>
                                <CAN-ENTER-EXCLUSIVE-AREA-REFS>
                                  <CAN-ENTER-EXCLUSIVE-AREA-REF DEST="EXCLUSIVE-AREA">/AURIX2G_Dma/BswModuleDescriptions/Dma/DmaBehavior/ChannelConfigUpdate</CAN-ENTER-EXCLUSIVE-AREA-REF>
                                </CAN-ENTER-EXCLUSIVE-AREA-REFS>
                                <REENTRANCY-LEVEL>MULTICORE-REENTRANT</REENTRANCY-LEVEL>
                                <IMPLEMENTED-ENTRY-REF DEST="BSW-MODULE-ENTRY">/AURIX2G_Dma/BswModuleEntrys/Dma_ChTransferFreeze</IMPLEMENTED-ENTRY-REF>
                              </BSW-CALLED-ENTITY>
                              <BSW-CALLED-ENTITY>
                                <SHORT-NAME>Dma_ChTransferResume</SHORT-NAME>
                                <CAN-ENTER-EXCLUSIVE-AREA-REFS>
                                  <CAN-ENTER-EXCLUSIVE-AREA-REF DEST="EXCLUSIVE-AREA">/AURIX2G_Dma/BswModuleDescriptions/Dma/DmaBehavior/ChannelConfigUpdate</CAN-ENTER-EXCLUSIVE-AREA-REF>
                                </CAN-ENTER-EXCLUSIVE-AREA-REFS>
                                <REENTRANCY-LEVEL>MULTICORE-REENTRANT</REENTRANCY-LEVEL>
                                <IMPLEMENTED-ENTRY-REF DEST="BSW-MODULE-ENTRY">/AURIX2G_Dma/BswModuleEntrys/Dma_ChTransferResume</IMPLEMENTED-ENTRY-REF>
                              </BSW-CALLED-ENTITY>
[!ENDIF!][!//
[!IF "$Dma_HardwareTriggerApi_Xpath = 'true'"!]
                              <BSW-CALLED-ENTITY>
                                <SHORT-NAME>Dma_ChEnableHardwareTrigger</SHORT-NAME>
                                <CAN-ENTER-EXCLUSIVE-AREA-REFS>
                                  <CAN-ENTER-EXCLUSIVE-AREA-REF DEST="EXCLUSIVE-AREA">/AURIX2G_Dma/BswModuleDescriptions/Dma/DmaBehavior/ChannelConfigUpdate</CAN-ENTER-EXCLUSIVE-AREA-REF>
                                </CAN-ENTER-EXCLUSIVE-AREA-REFS>
                                <REENTRANCY-LEVEL>MULTICORE-REENTRANT</REENTRANCY-LEVEL>
                                <IMPLEMENTED-ENTRY-REF DEST="BSW-MODULE-ENTRY">/AURIX2G_Dma/BswModuleEntrys/Dma_ChEnableHardwareTrigger</IMPLEMENTED-ENTRY-REF>
                              </BSW-CALLED-ENTITY>
                              <BSW-CALLED-ENTITY>
                                <SHORT-NAME>Dma_ChDisableHardwareTrigger</SHORT-NAME>
                                <CAN-ENTER-EXCLUSIVE-AREA-REFS>
                                  <CAN-ENTER-EXCLUSIVE-AREA-REF DEST="EXCLUSIVE-AREA">/AURIX2G_Dma/BswModuleDescriptions/Dma/DmaBehavior/ChannelConfigUpdate</CAN-ENTER-EXCLUSIVE-AREA-REF>
                                </CAN-ENTER-EXCLUSIVE-AREA-REFS>
                                <REENTRANCY-LEVEL>MULTICORE-REENTRANT</REENTRANCY-LEVEL>
                                <IMPLEMENTED-ENTRY-REF DEST="BSW-MODULE-ENTRY">/AURIX2G_Dma/BswModuleEntrys/Dma_ChDisableHardwareTrigger</IMPLEMENTED-ENTRY-REF>
                              </BSW-CALLED-ENTITY>
[!ENDIF!][!//
                              <BSW-CALLED-ENTITY>
                                <SHORT-NAME>Dma_ChInterruptEnable</SHORT-NAME>
                                <CAN-ENTER-EXCLUSIVE-AREA-REFS>
                                  <CAN-ENTER-EXCLUSIVE-AREA-REF DEST="EXCLUSIVE-AREA">/AURIX2G_Dma/BswModuleDescriptions/Dma/DmaBehavior/ChannelConfigUpdate</CAN-ENTER-EXCLUSIVE-AREA-REF>
                                </CAN-ENTER-EXCLUSIVE-AREA-REFS>
                                <REENTRANCY-LEVEL>MULTICORE-REENTRANT</REENTRANCY-LEVEL>
                                <IMPLEMENTED-ENTRY-REF DEST="BSW-MODULE-ENTRY">/AURIX2G_Dma/BswModuleEntrys/Dma_ChInterruptEnable</IMPLEMENTED-ENTRY-REF>
                              </BSW-CALLED-ENTITY>
                              <BSW-CALLED-ENTITY>
                                <SHORT-NAME>Dma_ChInterruptDisable</SHORT-NAME>
                                <CAN-ENTER-EXCLUSIVE-AREA-REFS>
                                  <CAN-ENTER-EXCLUSIVE-AREA-REF DEST="EXCLUSIVE-AREA">/AURIX2G_Dma/BswModuleDescriptions/Dma/DmaBehavior/ChannelConfigUpdate</CAN-ENTER-EXCLUSIVE-AREA-REF>
                                </CAN-ENTER-EXCLUSIVE-AREA-REFS>
                                <REENTRANCY-LEVEL>MULTICORE-REENTRANT</REENTRANCY-LEVEL>
                                <IMPLEMENTED-ENTRY-REF DEST="BSW-MODULE-ENTRY">/AURIX2G_Dma/BswModuleEntrys/Dma_ChInterruptDisable</IMPLEMENTED-ENTRY-REF>
                              </BSW-CALLED-ENTITY>
                              <BSW-CALLED-ENTITY>
                                <SHORT-NAME>Dma_ChStartTransfer</SHORT-NAME>
                                <CAN-ENTER-EXCLUSIVE-AREA-REFS>
                                  <CAN-ENTER-EXCLUSIVE-AREA-REF DEST="EXCLUSIVE-AREA">/AURIX2G_Dma/BswModuleDescriptions/Dma/DmaBehavior/ChannelConfigUpdate</CAN-ENTER-EXCLUSIVE-AREA-REF>
                                </CAN-ENTER-EXCLUSIVE-AREA-REFS>
                                <REENTRANCY-LEVEL>MULTICORE-REENTRANT</REENTRANCY-LEVEL>
                                <IMPLEMENTED-ENTRY-REF DEST="BSW-MODULE-ENTRY">/AURIX2G_Dma/BswModuleEntrys/Dma_ChStartTransfer</IMPLEMENTED-ENTRY-REF>
                              </BSW-CALLED-ENTITY>
[!IF "$Dma_PendingApi_Xpath = 'true'"!]
                              <BSW-CALLED-ENTITY>
                                <SHORT-NAME>Dma_ChGetRemainingData</SHORT-NAME>
                                <CAN-ENTER-EXCLUSIVE-AREA-REFS>
                                  <CAN-ENTER-EXCLUSIVE-AREA-REF DEST="EXCLUSIVE-AREA">/AURIX2G_Dma/BswModuleDescriptions/Dma/DmaBehavior/ChannelConfigUpdate</CAN-ENTER-EXCLUSIVE-AREA-REF>
                                </CAN-ENTER-EXCLUSIVE-AREA-REFS>
                                <REENTRANCY-LEVEL>MULTICORE-REENTRANT</REENTRANCY-LEVEL>
                                <IMPLEMENTED-ENTRY-REF DEST="BSW-MODULE-ENTRY">/AURIX2G_Dma/BswModuleEntrys/Dma_ChGetRemainingData</IMPLEMENTED-ENTRY-REF>
                              </BSW-CALLED-ENTITY>
[!ENDIF!][!//
                              <BSW-CALLED-ENTITY>
                                <SHORT-NAME>Dma_ChStopTransfer</SHORT-NAME>
                                <CAN-ENTER-EXCLUSIVE-AREA-REFS>
                                  <CAN-ENTER-EXCLUSIVE-AREA-REF DEST="EXCLUSIVE-AREA">/AURIX2G_Dma/BswModuleDescriptions/Dma/DmaBehavior/ChannelConfigUpdate</CAN-ENTER-EXCLUSIVE-AREA-REF>
                                </CAN-ENTER-EXCLUSIVE-AREA-REFS>
                                <REENTRANCY-LEVEL>MULTICORE-REENTRANT</REENTRANCY-LEVEL>
                                <IMPLEMENTED-ENTRY-REF DEST="BSW-MODULE-ENTRY">/AURIX2G_Dma/BswModuleEntrys/Dma_ChStopTransfer</IMPLEMENTED-ENTRY-REF>
                              </BSW-CALLED-ENTITY>
[!IF "$Dma_BufferSwitchApi_Xpath = 'true'"!]
                              <BSW-CALLED-ENTITY>
                                <SHORT-NAME>Dma_ChSwitchBuffer</SHORT-NAME>
                                <CAN-ENTER-EXCLUSIVE-AREA-REFS>
                                  <CAN-ENTER-EXCLUSIVE-AREA-REF DEST="EXCLUSIVE-AREA">/AURIX2G_Dma/BswModuleDescriptions/Dma/DmaBehavior/ChannelConfigUpdate</CAN-ENTER-EXCLUSIVE-AREA-REF>
                                </CAN-ENTER-EXCLUSIVE-AREA-REFS>
                               <REENTRANCY-LEVEL>MULTICORE-REENTRANT</REENTRANCY-LEVEL>
                                <IMPLEMENTED-ENTRY-REF DEST="BSW-MODULE-ENTRY">/AURIX2G_Dma/BswModuleEntrys/Dma_ChSwitchBuffer</IMPLEMENTED-ENTRY-REF>
                              </BSW-CALLED-ENTITY>
[!ENDIF!][!//
                              <BSW-CALLED-ENTITY>
                                <SHORT-NAME>Dma_ChIsStatusAsserted</SHORT-NAME>
                                <CAN-ENTER-EXCLUSIVE-AREA-REFS>
                                  <CAN-ENTER-EXCLUSIVE-AREA-REF DEST="EXCLUSIVE-AREA">/AURIX2G_Dma/BswModuleDescriptions/Dma/DmaBehavior/ChannelConfigUpdate</CAN-ENTER-EXCLUSIVE-AREA-REF>
                                </CAN-ENTER-EXCLUSIVE-AREA-REFS>
                                <REENTRANCY-LEVEL>MULTICORE-REENTRANT</REENTRANCY-LEVEL>
                                <IMPLEMENTED-ENTRY-REF DEST="BSW-MODULE-ENTRY">/AURIX2G_Dma/BswModuleEntrys/Dma_ChIsStatusAsserted</IMPLEMENTED-ENTRY-REF>
                              </BSW-CALLED-ENTITY>
                              <BSW-CALLED-ENTITY>
                                <SHORT-NAME>Dma_ChStatusClear</SHORT-NAME>
                                <CAN-ENTER-EXCLUSIVE-AREA-REFS>
                                  <CAN-ENTER-EXCLUSIVE-AREA-REF DEST="EXCLUSIVE-AREA">/AURIX2G_Dma/BswModuleDescriptions/Dma/DmaBehavior/ChannelConfigUpdate</CAN-ENTER-EXCLUSIVE-AREA-REF>
                                </CAN-ENTER-EXCLUSIVE-AREA-REFS>
                               <REENTRANCY-LEVEL>MULTICORE-REENTRANT</REENTRANCY-LEVEL>
                                <IMPLEMENTED-ENTRY-REF DEST="BSW-MODULE-ENTRY">/AURIX2G_Dma/BswModuleEntrys/Dma_ChStatusClear</IMPLEMENTED-ENTRY-REF>
                              </BSW-CALLED-ENTITY>
                              <BSW-CALLED-ENTITY>
                                <SHORT-NAME>Dma_GetChannelEvent</SHORT-NAME>
                                <CAN-ENTER-EXCLUSIVE-AREA-REFS>
                                  <CAN-ENTER-EXCLUSIVE-AREA-REF DEST="EXCLUSIVE-AREA">/AURIX2G_Dma/BswModuleDescriptions/Dma/DmaBehavior/ChannelConfigUpdate</CAN-ENTER-EXCLUSIVE-AREA-REF>
                                </CAN-ENTER-EXCLUSIVE-AREA-REFS>
                                <REENTRANCY-LEVEL>MULTICORE-REENTRANT</REENTRANCY-LEVEL>
                                <IMPLEMENTED-ENTRY-REF DEST="BSW-MODULE-ENTRY">/AURIX2G_Dma/BswModuleEntrys/Dma_GetChannelEvent</IMPLEMENTED-ENTRY-REF>
                              </BSW-CALLED-ENTITY>
                              <BSW-CALLED-ENTITY>
                                <SHORT-NAME>Dma_GetMoveEngineEvent</SHORT-NAME>
                                <CAN-ENTER-EXCLUSIVE-AREA-REFS>
                                  <CAN-ENTER-EXCLUSIVE-AREA-REF DEST="EXCLUSIVE-AREA">/AURIX2G_Dma/BswModuleDescriptions/Dma/DmaBehavior/ChannelConfigUpdate</CAN-ENTER-EXCLUSIVE-AREA-REF>
                                </CAN-ENTER-EXCLUSIVE-AREA-REFS>
                                <REENTRANCY-LEVEL>MULTICORE-REENTRANT</REENTRANCY-LEVEL>
                                <IMPLEMENTED-ENTRY-REF DEST="BSW-MODULE-ENTRY">/AURIX2G_Dma/BswModuleEntrys/Dma_GetMoveEngineEvent</IMPLEMENTED-ENTRY-REF>
                              </BSW-CALLED-ENTITY>
                              <BSW-CALLED-ENTITY>
                                <SHORT-NAME>Dma_MEStatusClear</SHORT-NAME>
                                <CAN-ENTER-EXCLUSIVE-AREA-REFS>
                                  <CAN-ENTER-EXCLUSIVE-AREA-REF DEST="EXCLUSIVE-AREA">/AURIX2G_Dma/BswModuleDescriptions/Dma/DmaBehavior/ChannelConfigUpdate</CAN-ENTER-EXCLUSIVE-AREA-REF>
                                </CAN-ENTER-EXCLUSIVE-AREA-REFS>
                               <REENTRANCY-LEVEL>MULTICORE-REENTRANT</REENTRANCY-LEVEL>
                                <IMPLEMENTED-ENTRY-REF DEST="BSW-MODULE-ENTRY">/AURIX2G_Dma/BswModuleEntrys/Dma_MEStatusClear</IMPLEMENTED-ENTRY-REF>
                              </BSW-CALLED-ENTITY>
                              <BSW-INTERRUPT-ENTITY>
                                <SHORT-NAME>Dma_MEInterruptHandler</SHORT-NAME>
                                <REENTRANCY-LEVEL>NON-REENTRANT</REENTRANCY-LEVEL>
                                <IMPLEMENTED-ENTRY-REF DEST="BSW-MODULE-ENTRY">/AURIX2G_Dma/BswModuleEntrys/Dma_MEInterruptHandler</IMPLEMENTED-ENTRY-REF>
                              </BSW-INTERRUPT-ENTITY>
                              <BSW-INTERRUPT-ENTITY>
                                <SHORT-NAME>Dma_MEInterruptDispatcher</SHORT-NAME>
                                <REENTRANCY-LEVEL>NON-REENTRANT</REENTRANCY-LEVEL>
                                <IMPLEMENTED-ENTRY-REF DEST="BSW-MODULE-ENTRY">/AURIX2G_Dma/BswModuleEntrys/Dma_MEInterruptDispatcher</IMPLEMENTED-ENTRY-REF>
                              </BSW-INTERRUPT-ENTITY>
                              <BSW-INTERRUPT-ENTITY>
                                <SHORT-NAME>Dma_ChInterruptHandler</SHORT-NAME>
                                <REENTRANCY-LEVEL>MULTICORE-REENTRANT</REENTRANCY-LEVEL>
                                <IMPLEMENTED-ENTRY-REF DEST="BSW-MODULE-ENTRY">/AURIX2G_Dma/BswModuleEntrys/Dma_ChInterruptHandler</IMPLEMENTED-ENTRY-REF>
                              </BSW-INTERRUPT-ENTITY>
                              <BSW-CALLED-ENTITY>
                                <SHORT-NAME>Dma_GetCrcValue</SHORT-NAME>
                                <CAN-ENTER-EXCLUSIVE-AREA-REFS>
                                  <CAN-ENTER-EXCLUSIVE-AREA-REF DEST="EXCLUSIVE-AREA">/AURIX2G_Dma/BswModuleDescriptions/Dma/DmaBehavior/ChannelConfigUpdate</CAN-ENTER-EXCLUSIVE-AREA-REF>
                                </CAN-ENTER-EXCLUSIVE-AREA-REFS>
                                <REENTRANCY-LEVEL>MULTICORE-REENTRANT</REENTRANCY-LEVEL>
                                <IMPLEMENTED-ENTRY-REF DEST="BSW-MODULE-ENTRY">/AURIX2G_Dma/BswModuleEntrys/Dma_GetCrcValue</IMPLEMENTED-ENTRY-REF>
                              </BSW-CALLED-ENTITY>
                              <BSW-CALLED-ENTITY>
                                <SHORT-NAME>Dma_GetCurrentTimeStamp</SHORT-NAME>
                                <REENTRANCY-LEVEL>MULTICORE-REENTRANT</REENTRANCY-LEVEL>
                                <IMPLEMENTED-ENTRY-REF DEST="BSW-MODULE-ENTRY">/AURIX2G_Dma/BswModuleEntrys/Dma_GetCurrentTimeStamp</IMPLEMENTED-ENTRY-REF>
                              </BSW-CALLED-ENTITY>

                              <BSW-CALLED-ENTITY>
                                <SHORT-NAME>Dma_IsChannelInitDone</SHORT-NAME>
                                <REENTRANCY-LEVEL>MULTICORE-REENTRANT</REENTRANCY-LEVEL>
                                <IMPLEMENTED-ENTRY-REF DEST="BSW-MODULE-ENTRY">/AURIX2G_Dma/BswModuleEntrys/Dma_IsChannelInitDone</IMPLEMENTED-ENTRY-REF>
                              </BSW-CALLED-ENTITY>
[!IF "$DmaInitCheckApi_Xpath  = 'true'"!]                             
                              <BSW-CALLED-ENTITY>
                                <SHORT-NAME>Dma_InitCheck</SHORT-NAME>
                                <REENTRANCY-LEVEL>NON-REENTRANT</REENTRANCY-LEVEL>
                                <IMPLEMENTED-ENTRY-REF DEST="BSW-MODULE-ENTRY">/AURIX2G_Dma/BswModuleEntrys/Dma_InitCheck</IMPLEMENTED-ENTRY-REF>
                              </BSW-CALLED-ENTITY>
[!ENDIF!][!// 
[!IF "$Dma_VersionInfoApi_Xpath = 'true'"!]
                              <BSW-CALLED-ENTITY>
                                <SHORT-NAME>Dma_GetVersionInfo</SHORT-NAME>
                               <REENTRANCY-LEVEL>MULTICORE-REENTRANT</REENTRANCY-LEVEL>
                                <IMPLEMENTED-ENTRY-REF DEST="BSW-MODULE-ENTRY">/AURIX2G_Dma/BswModuleEntrys/Dma_GetVersionInfo</IMPLEMENTED-ENTRY-REF>
                              </BSW-CALLED-ENTITY>
[!ENDIF!][!//
                            </ENTITYS>
                          </BSW-INTERNAL-BEHAVIOR>
                        </INTERNAL-BEHAVIORS>
                    </BSW-MODULE-DESCRIPTION>
                </ELEMENTS>
            </AR-PACKAGE>
            <AR-PACKAGE>
                <SHORT-NAME>BswModuleEntrys</SHORT-NAME>
                <CATEGORY>STANDARD</CATEGORY>
                <ELEMENTS>
                    <BSW-MODULE-ENTRY>
                        <SHORT-NAME>Dma_Init</SHORT-NAME>
                        <SERVICE-ID>1</SERVICE-ID>
                        <IS-REENTRANT>false</IS-REENTRANT>
                        <IS-SYNCHRONOUS>true</IS-SYNCHRONOUS>
                        <CALL-TYPE>REGULAR</CALL-TYPE>
                        <EXECUTION-CONTEXT>TASK</EXECUTION-CONTEXT>
                        <SW-SERVICE-IMPL-POLICY>STANDARD</SW-SERVICE-IMPL-POLICY>
                        <ARGUMENTS>
                          <SW-SERVICE-ARG>
                            <SHORT-NAME>ConfigPtr</SHORT-NAME>
                            <CATEGORY>DATA_REFERENCE</CATEGORY>
                            <SW-DATA-DEF-PROPS>
                              <SW-DATA-DEF-PROPS-VARIANTS>
                                <SW-DATA-DEF-PROPS-CONDITIONAL>
                                <SW-POINTER-TARGET-PROPS>
                                <TARGET-CATEGORY>TYPE_REFERENCE</TARGET-CATEGORY>
                                <SW-DATA-DEF-PROPS>
                                <SW-DATA-DEF-PROPS-VARIANTS>
                                <SW-DATA-DEF-PROPS-CONDITIONAL>
                                <IMPLEMENTATION-DATA-TYPE-REF DEST = "IMPLEMENTATION-DATA-TYPE">/AURIX2G_Dma/ImplementationDataTypes/Dma_ConfigType</IMPLEMENTATION-DATA-TYPE-REF>
                                </SW-DATA-DEF-PROPS-CONDITIONAL>
                                </SW-DATA-DEF-PROPS-VARIANTS>
                                </SW-DATA-DEF-PROPS>
                                </SW-POINTER-TARGET-PROPS>
                                </SW-DATA-DEF-PROPS-CONDITIONAL>
                              </SW-DATA-DEF-PROPS-VARIANTS>
                            </SW-DATA-DEF-PROPS>
                          </SW-SERVICE-ARG>
                        </ARGUMENTS>
                    </BSW-MODULE-ENTRY>
[!IF "$Dma_DeinitApi_Xpath = 'true'"!]
                    <BSW-MODULE-ENTRY>
                        <SHORT-NAME>Dma_ChDeInit</SHORT-NAME>
                        <INTRODUCTION>
                            <NOTE SI="Dma_ChDeInit is reentrant for different DMA channels" NOTE-TYPE="HINT" />
                        </INTRODUCTION>
                        <SERVICE-ID>5</SERVICE-ID>
                        <IS-REENTRANT>true</IS-REENTRANT>
                        <IS-SYNCHRONOUS>true</IS-SYNCHRONOUS>
                        <CALL-TYPE>REGULAR</CALL-TYPE>
                        <EXECUTION-CONTEXT>TASK</EXECUTION-CONTEXT>
                        <SW-SERVICE-IMPL-POLICY>STANDARD</SW-SERVICE-IMPL-POLICY>
                          <ARGUMENTS>
                          <SW-SERVICE-ARG>
                            <SHORT-NAME>Channel</SHORT-NAME>
                            <SW-DATA-DEF-PROPS>
                              <SW-DATA-DEF-PROPS-VARIANTS>
                                <SW-DATA-DEF-PROPS-CONDITIONAL>
                                <IMPLEMENTATION-DATA-TYPE-REF DEST = "IMPLEMENTATION-DATA-TYPE">/AUTOSAR_Platform/ImplementationDataTypes/uint8</IMPLEMENTATION-DATA-TYPE-REF>
                                </SW-DATA-DEF-PROPS-CONDITIONAL>
                              </SW-DATA-DEF-PROPS-VARIANTS>
                            </SW-DATA-DEF-PROPS>
                          </SW-SERVICE-ARG>
                          </ARGUMENTS>
                    </BSW-MODULE-ENTRY>
[!ENDIF!][!//
                    <BSW-MODULE-ENTRY>
                        <SHORT-NAME>Dma_IsInitDone</SHORT-NAME>
                        <SERVICE-ID>2</SERVICE-ID>
                        <IS-REENTRANT>true</IS-REENTRANT>
                        <IS-SYNCHRONOUS>true</IS-SYNCHRONOUS>
                        <CALL-TYPE>REGULAR</CALL-TYPE>
                        <EXECUTION-CONTEXT>TASK</EXECUTION-CONTEXT>
                        <SW-SERVICE-IMPL-POLICY>STANDARD</SW-SERVICE-IMPL-POLICY>
                        <RETURN-TYPE>
                          <SHORT-NAME>Return</SHORT-NAME>
                          <SW-DATA-DEF-PROPS>
                            <SW-DATA-DEF-PROPS-VARIANTS>
                              <SW-DATA-DEF-PROPS-CONDITIONAL>
                                <IMPLEMENTATION-DATA-TYPE-REF DEST = "IMPLEMENTATION-DATA-TYPE">/AUTOSAR_StdTypes/ImplementationDataTypes/Std_ReturnType</IMPLEMENTATION-DATA-TYPE-REF>
                              </SW-DATA-DEF-PROPS-CONDITIONAL>
                            </SW-DATA-DEF-PROPS-VARIANTS>
                          </SW-DATA-DEF-PROPS>
                        </RETURN-TYPE>
                    </BSW-MODULE-ENTRY>
                    <BSW-MODULE-ENTRY>
                        <SHORT-NAME>Dma_ChInit</SHORT-NAME>
                        <INTRODUCTION>
                            <NOTE SI="Dma_ChInit is reentrant for different DMA channels" NOTE-TYPE="HINT" />
                        </INTRODUCTION>
                        <SERVICE-ID>3</SERVICE-ID>
                        <IS-REENTRANT>true</IS-REENTRANT>
                        <IS-SYNCHRONOUS>true</IS-SYNCHRONOUS>
                        <CALL-TYPE>REGULAR</CALL-TYPE>
                        <EXECUTION-CONTEXT>TASK</EXECUTION-CONTEXT>
                        <SW-SERVICE-IMPL-POLICY>STANDARD</SW-SERVICE-IMPL-POLICY>
                          <ARGUMENTS>
                          <SW-SERVICE-ARG>
                            <SHORT-NAME>Channel</SHORT-NAME>
                            <SW-DATA-DEF-PROPS>
                              <SW-DATA-DEF-PROPS-VARIANTS>
                                <SW-DATA-DEF-PROPS-CONDITIONAL>
                                <IMPLEMENTATION-DATA-TYPE-REF DEST = "IMPLEMENTATION-DATA-TYPE">/AUTOSAR_Platform/ImplementationDataTypes/uint8</IMPLEMENTATION-DATA-TYPE-REF>
                                </SW-DATA-DEF-PROPS-CONDITIONAL>
                              </SW-DATA-DEF-PROPS-VARIANTS>
                            </SW-DATA-DEF-PROPS>
                          </SW-SERVICE-ARG>
                          </ARGUMENTS>
                    </BSW-MODULE-ENTRY>
                    <BSW-MODULE-ENTRY>
                        <SHORT-NAME>Dma_ChUpdate</SHORT-NAME>
                        <INTRODUCTION>
                            <NOTE SI="Dma_ChUpdate is reentrant for different DMA channels" NOTE-TYPE="HINT" />
                        </INTRODUCTION>
                        <SERVICE-ID>4</SERVICE-ID>
                        <IS-REENTRANT>true</IS-REENTRANT>
                        <IS-SYNCHRONOUS>true</IS-SYNCHRONOUS>
                        <CALL-TYPE>REGULAR</CALL-TYPE>
                        <EXECUTION-CONTEXT>TASK</EXECUTION-CONTEXT>
                        <SW-SERVICE-IMPL-POLICY>STANDARD</SW-SERVICE-IMPL-POLICY>
                        <ARGUMENTS>
                          <SW-SERVICE-ARG>
                            <SHORT-NAME>Channel</SHORT-NAME>
                            <SW-DATA-DEF-PROPS>
                              <SW-DATA-DEF-PROPS-VARIANTS>
                                <SW-DATA-DEF-PROPS-CONDITIONAL>
                                <IMPLEMENTATION-DATA-TYPE-REF DEST = "IMPLEMENTATION-DATA-TYPE">/AUTOSAR_Platform/ImplementationDataTypes/uint8</IMPLEMENTATION-DATA-TYPE-REF>
                                </SW-DATA-DEF-PROPS-CONDITIONAL>
                              </SW-DATA-DEF-PROPS-VARIANTS>
                            </SW-DATA-DEF-PROPS>
                          </SW-SERVICE-ARG>
                          <SW-SERVICE-ARG>
                            <SHORT-NAME>Config</SHORT-NAME>
                            <CATEGORY>DATA_REFERENCE</CATEGORY>
                            <SW-DATA-DEF-PROPS>
                              <SW-DATA-DEF-PROPS-VARIANTS>
                                <SW-DATA-DEF-PROPS-CONDITIONAL>
                                <SW-POINTER-TARGET-PROPS>
                                <TARGET-CATEGORY>TYPE_REFERENCE</TARGET-CATEGORY>
                                <SW-DATA-DEF-PROPS>
                                <SW-DATA-DEF-PROPS-VARIANTS>
                                <SW-DATA-DEF-PROPS-CONDITIONAL>
                                <IMPLEMENTATION-DATA-TYPE-REF DEST = "IMPLEMENTATION-DATA-TYPE">/AURIX2G_Dma/ImplementationDataTypes/Dma_ConfigUpdateType</IMPLEMENTATION-DATA-TYPE-REF>
                                </SW-DATA-DEF-PROPS-CONDITIONAL>
                                </SW-DATA-DEF-PROPS-VARIANTS>
                                </SW-DATA-DEF-PROPS>
                                </SW-POINTER-TARGET-PROPS>
                                </SW-DATA-DEF-PROPS-CONDITIONAL>
                              </SW-DATA-DEF-PROPS-VARIANTS>
                            </SW-DATA-DEF-PROPS>
                          </SW-SERVICE-ARG>
                          <SW-SERVICE-ARG>
                            <SHORT-NAME>NodeAddress</SHORT-NAME>
                            <CATEGORY>DATA_REFERENCE</CATEGORY>
                            <SW-DATA-DEF-PROPS>
                              <SW-DATA-DEF-PROPS-VARIANTS>
                                <SW-DATA-DEF-PROPS-CONDITIONAL>
                                <SW-POINTER-TARGET-PROPS>
                                <TARGET-CATEGORY>TYPE_REFERENCE</TARGET-CATEGORY>
                                <SW-DATA-DEF-PROPS>
                                <SW-DATA-DEF-PROPS-VARIANTS>
                                <SW-DATA-DEF-PROPS-CONDITIONAL>
                                <IMPLEMENTATION-DATA-TYPE-REF DEST = "IMPLEMENTATION-DATA-TYPE">/AUTOSAR_Platform/ImplementationDataTypes/uint32</IMPLEMENTATION-DATA-TYPE-REF>
                                </SW-DATA-DEF-PROPS-CONDITIONAL>
                                </SW-DATA-DEF-PROPS-VARIANTS>
                                </SW-DATA-DEF-PROPS>
                                </SW-POINTER-TARGET-PROPS>
                                </SW-DATA-DEF-PROPS-CONDITIONAL>
                              </SW-DATA-DEF-PROPS-VARIANTS>
                            </SW-DATA-DEF-PROPS>
                          </SW-SERVICE-ARG>
                        </ARGUMENTS>
                    </BSW-MODULE-ENTRY>
[!IF "$Dma_SuspendApi_Xpath = 'true'"!]
                     <BSW-MODULE-ENTRY>
                        <SHORT-NAME>Dma_ChTransferFreeze</SHORT-NAME>
                        <INTRODUCTION>
                            <NOTE SI="Dma_ChTransferFreeze is reentrant for different DMA channels" NOTE-TYPE="HINT" />
                        </INTRODUCTION>
                        <SERVICE-ID>6</SERVICE-ID>
                        <IS-REENTRANT>true</IS-REENTRANT>
                        <IS-SYNCHRONOUS>true</IS-SYNCHRONOUS>
                        <CALL-TYPE>REGULAR</CALL-TYPE>
                        <EXECUTION-CONTEXT>TASK</EXECUTION-CONTEXT>
                        <SW-SERVICE-IMPL-POLICY>STANDARD</SW-SERVICE-IMPL-POLICY>
                          <ARGUMENTS>
                          <SW-SERVICE-ARG>
                            <SHORT-NAME>Channel</SHORT-NAME>
                            <SW-DATA-DEF-PROPS>
                              <SW-DATA-DEF-PROPS-VARIANTS>
                                <SW-DATA-DEF-PROPS-CONDITIONAL>
                                <IMPLEMENTATION-DATA-TYPE-REF DEST = "IMPLEMENTATION-DATA-TYPE">/AUTOSAR_Platform/ImplementationDataTypes/uint8</IMPLEMENTATION-DATA-TYPE-REF>
                                </SW-DATA-DEF-PROPS-CONDITIONAL>
                              </SW-DATA-DEF-PROPS-VARIANTS>
                            </SW-DATA-DEF-PROPS>
                           </SW-SERVICE-ARG>
                           </ARGUMENTS>
                     </BSW-MODULE-ENTRY>
                     <BSW-MODULE-ENTRY>
                        <SHORT-NAME>Dma_ChTransferResume</SHORT-NAME>
                        <INTRODUCTION>
                            <NOTE SI="Dma_ChTransferResume is reentrant for different DMA channels" NOTE-TYPE="HINT" />
                        </INTRODUCTION>
                        <SERVICE-ID>7</SERVICE-ID>
                        <IS-REENTRANT>true</IS-REENTRANT>
                        <IS-SYNCHRONOUS>true</IS-SYNCHRONOUS>
                        <CALL-TYPE>REGULAR</CALL-TYPE>
                        <EXECUTION-CONTEXT>TASK</EXECUTION-CONTEXT>
                        <SW-SERVICE-IMPL-POLICY>STANDARD</SW-SERVICE-IMPL-POLICY>
                          <ARGUMENTS>
                          <SW-SERVICE-ARG>
                            <SHORT-NAME>Channel</SHORT-NAME>
                            <SW-DATA-DEF-PROPS>
                              <SW-DATA-DEF-PROPS-VARIANTS>
                                <SW-DATA-DEF-PROPS-CONDITIONAL>
                                <IMPLEMENTATION-DATA-TYPE-REF DEST = "IMPLEMENTATION-DATA-TYPE">/AUTOSAR_Platform/ImplementationDataTypes/uint8</IMPLEMENTATION-DATA-TYPE-REF>
                                </SW-DATA-DEF-PROPS-CONDITIONAL>
                              </SW-DATA-DEF-PROPS-VARIANTS>
                            </SW-DATA-DEF-PROPS>
                          </SW-SERVICE-ARG>
                          </ARGUMENTS>
                    </BSW-MODULE-ENTRY>
[!ENDIF!][!//
[!IF "$Dma_HardwareTriggerApi_Xpath = 'true'"!]
                    <BSW-MODULE-ENTRY>
                        <SHORT-NAME>Dma_ChEnableHardwareTrigger</SHORT-NAME>
                        <INTRODUCTION>
                            <NOTE SI="Dma_ChEnableHardwareTrigger is reentrant for different DMA channels" NOTE-TYPE="HINT" />
                        </INTRODUCTION>
                        <SERVICE-ID>8</SERVICE-ID>
                        <IS-REENTRANT>true</IS-REENTRANT>
                        <IS-SYNCHRONOUS>true</IS-SYNCHRONOUS>
                        <CALL-TYPE>REGULAR</CALL-TYPE>
                        <EXECUTION-CONTEXT>TASK</EXECUTION-CONTEXT>
                        <SW-SERVICE-IMPL-POLICY>STANDARD</SW-SERVICE-IMPL-POLICY>
                          <ARGUMENTS>
                          <SW-SERVICE-ARG>
                            <SHORT-NAME>Channel</SHORT-NAME>
                            <SW-DATA-DEF-PROPS>
                              <SW-DATA-DEF-PROPS-VARIANTS>
                                <SW-DATA-DEF-PROPS-CONDITIONAL>
                                <IMPLEMENTATION-DATA-TYPE-REF DEST = "IMPLEMENTATION-DATA-TYPE">/AUTOSAR_Platform/ImplementationDataTypes/uint8</IMPLEMENTATION-DATA-TYPE-REF>
                                </SW-DATA-DEF-PROPS-CONDITIONAL>
                              </SW-DATA-DEF-PROPS-VARIANTS>
                            </SW-DATA-DEF-PROPS>
                          </SW-SERVICE-ARG>
                          </ARGUMENTS>
                    </BSW-MODULE-ENTRY>
                    <BSW-MODULE-ENTRY>
                        <SHORT-NAME>Dma_ChDisableHardwareTrigger</SHORT-NAME>
                        <INTRODUCTION>
                            <NOTE SI="Dma_ChDisableHardwareTrigger is reentrant for different DMA channels" NOTE-TYPE="HINT" />
                        </INTRODUCTION>
                        <SERVICE-ID>9</SERVICE-ID>
                        <IS-REENTRANT>true</IS-REENTRANT>
                        <IS-SYNCHRONOUS>true</IS-SYNCHRONOUS>
                        <CALL-TYPE>REGULAR</CALL-TYPE>
                        <EXECUTION-CONTEXT>TASK</EXECUTION-CONTEXT>
                        <SW-SERVICE-IMPL-POLICY>STANDARD</SW-SERVICE-IMPL-POLICY>
                          <ARGUMENTS>
                          <SW-SERVICE-ARG>
                            <SHORT-NAME>Channel</SHORT-NAME>
                            <SW-DATA-DEF-PROPS>
                              <SW-DATA-DEF-PROPS-VARIANTS>
                                <SW-DATA-DEF-PROPS-CONDITIONAL>
                                <IMPLEMENTATION-DATA-TYPE-REF DEST = "IMPLEMENTATION-DATA-TYPE">/AUTOSAR_Platform/ImplementationDataTypes/uint8</IMPLEMENTATION-DATA-TYPE-REF>
                                </SW-DATA-DEF-PROPS-CONDITIONAL>
                              </SW-DATA-DEF-PROPS-VARIANTS>
                            </SW-DATA-DEF-PROPS>
                          </SW-SERVICE-ARG>
                          </ARGUMENTS>
                    </BSW-MODULE-ENTRY>
[!ENDIF!][!//
                     <BSW-MODULE-ENTRY>
                        <SHORT-NAME>Dma_ChStartTransfer</SHORT-NAME>
                        <INTRODUCTION>
                            <NOTE SI="Dma_ChStartTransfer is reentrant for different DMA channels" NOTE-TYPE="HINT" />
                        </INTRODUCTION>
                        <SERVICE-ID>10</SERVICE-ID>
                        <IS-REENTRANT>true</IS-REENTRANT>
                        <IS-SYNCHRONOUS>true</IS-SYNCHRONOUS>
                        <CALL-TYPE>REGULAR</CALL-TYPE>
                        <EXECUTION-CONTEXT>TASK</EXECUTION-CONTEXT>
                        <SW-SERVICE-IMPL-POLICY>STANDARD</SW-SERVICE-IMPL-POLICY>
                          <ARGUMENTS>
                          <SW-SERVICE-ARG>
                            <SHORT-NAME>Channel</SHORT-NAME>
                            <SW-DATA-DEF-PROPS>
                              <SW-DATA-DEF-PROPS-VARIANTS>
                                <SW-DATA-DEF-PROPS-CONDITIONAL>
                                <IMPLEMENTATION-DATA-TYPE-REF DEST = "IMPLEMENTATION-DATA-TYPE">/AUTOSAR_Platform/ImplementationDataTypes/uint8</IMPLEMENTATION-DATA-TYPE-REF>
                                </SW-DATA-DEF-PROPS-CONDITIONAL>
                              </SW-DATA-DEF-PROPS-VARIANTS>
                            </SW-DATA-DEF-PROPS>
                          </SW-SERVICE-ARG>
                          </ARGUMENTS>
                    </BSW-MODULE-ENTRY>
                    <BSW-MODULE-ENTRY>
                        <SHORT-NAME>Dma_ChStopTransfer</SHORT-NAME>
                        <INTRODUCTION>
                            <NOTE SI="Dma_ChStopTransfer is reentrant for different DMA channels" NOTE-TYPE="HINT" />
                        </INTRODUCTION>
                        <SERVICE-ID>11</SERVICE-ID>
                        <IS-REENTRANT>true</IS-REENTRANT>
                        <IS-SYNCHRONOUS>true</IS-SYNCHRONOUS>
                        <CALL-TYPE>REGULAR</CALL-TYPE>
                        <EXECUTION-CONTEXT>TASK</EXECUTION-CONTEXT>
                        <SW-SERVICE-IMPL-POLICY>STANDARD</SW-SERVICE-IMPL-POLICY>
                          <ARGUMENTS>
                          <SW-SERVICE-ARG>
                            <SHORT-NAME>Channel</SHORT-NAME>
                            <SW-DATA-DEF-PROPS>
                              <SW-DATA-DEF-PROPS-VARIANTS>
                                <SW-DATA-DEF-PROPS-CONDITIONAL>
                                <IMPLEMENTATION-DATA-TYPE-REF DEST = "IMPLEMENTATION-DATA-TYPE">/AUTOSAR_Platform/ImplementationDataTypes/uint8</IMPLEMENTATION-DATA-TYPE-REF>
                                </SW-DATA-DEF-PROPS-CONDITIONAL>
                              </SW-DATA-DEF-PROPS-VARIANTS>
                            </SW-DATA-DEF-PROPS>
                          </SW-SERVICE-ARG>
                          </ARGUMENTS>
                    </BSW-MODULE-ENTRY>
[!IF "$Dma_PendingApi_Xpath = 'true'"!]
                    <BSW-MODULE-ENTRY>
                        <SHORT-NAME>Dma_ChGetRemainingData</SHORT-NAME>
                        <INTRODUCTION>
                            <NOTE SI="Dma_ChGetRemainingData is reentrant for different DMA channels" NOTE-TYPE="HINT" />
                        </INTRODUCTION>
                        <SERVICE-ID>12</SERVICE-ID>
                        <IS-REENTRANT>true</IS-REENTRANT>
                        <IS-SYNCHRONOUS>true</IS-SYNCHRONOUS>
                        <CALL-TYPE>REGULAR</CALL-TYPE>
                        <EXECUTION-CONTEXT>TASK</EXECUTION-CONTEXT>
                        <SW-SERVICE-IMPL-POLICY>STANDARD</SW-SERVICE-IMPL-POLICY>
                        <RETURN-TYPE>
                          <SHORT-NAME>Return</SHORT-NAME>
                          <SW-DATA-DEF-PROPS>
                            <SW-DATA-DEF-PROPS-VARIANTS>
                              <SW-DATA-DEF-PROPS-CONDITIONAL>
                                <IMPLEMENTATION-DATA-TYPE-REF DEST = "IMPLEMENTATION-DATA-TYPE">/AUTOSAR_Platform/ImplementationDataTypes/uint32</IMPLEMENTATION-DATA-TYPE-REF>
                              </SW-DATA-DEF-PROPS-CONDITIONAL>
                            </SW-DATA-DEF-PROPS-VARIANTS>
                          </SW-DATA-DEF-PROPS>
                        </RETURN-TYPE>
                          <ARGUMENTS>
                          <SW-SERVICE-ARG>
                            <SHORT-NAME>Channel</SHORT-NAME>
                            <SW-DATA-DEF-PROPS>
                              <SW-DATA-DEF-PROPS-VARIANTS>
                                <SW-DATA-DEF-PROPS-CONDITIONAL>
                                <IMPLEMENTATION-DATA-TYPE-REF DEST = "IMPLEMENTATION-DATA-TYPE">/AUTOSAR_Platform/ImplementationDataTypes/uint8</IMPLEMENTATION-DATA-TYPE-REF>
                                </SW-DATA-DEF-PROPS-CONDITIONAL>
                              </SW-DATA-DEF-PROPS-VARIANTS>
                            </SW-DATA-DEF-PROPS>
                          </SW-SERVICE-ARG>
                          </ARGUMENTS>
                    </BSW-MODULE-ENTRY>
[!ENDIF!][!//
[!IF "$Dma_BufferSwitchApi_Xpath = 'true'"!]
                    <BSW-MODULE-ENTRY>
                        <SHORT-NAME>Dma_ChSwitchBuffer</SHORT-NAME>
                        <INTRODUCTION>
                            <NOTE SI="Dma_ChSwitchBuffer is reentrant for different DMA channels" NOTE-TYPE="HINT" />
                        </INTRODUCTION>
                        <SERVICE-ID>13</SERVICE-ID>
                        <IS-REENTRANT>true</IS-REENTRANT>
                        <IS-SYNCHRONOUS>true</IS-SYNCHRONOUS>
                        <CALL-TYPE>REGULAR</CALL-TYPE>
                        <EXECUTION-CONTEXT>TASK</EXECUTION-CONTEXT>
                        <SW-SERVICE-IMPL-POLICY>STANDARD</SW-SERVICE-IMPL-POLICY>
                          <ARGUMENTS>
                          <SW-SERVICE-ARG>
                            <SHORT-NAME>Channel</SHORT-NAME>
                            <SW-DATA-DEF-PROPS>
                              <SW-DATA-DEF-PROPS-VARIANTS>
                                <SW-DATA-DEF-PROPS-CONDITIONAL>
                                <IMPLEMENTATION-DATA-TYPE-REF DEST = "IMPLEMENTATION-DATA-TYPE">/AUTOSAR_Platform/ImplementationDataTypes/uint8</IMPLEMENTATION-DATA-TYPE-REF>
                                </SW-DATA-DEF-PROPS-CONDITIONAL>
                              </SW-DATA-DEF-PROPS-VARIANTS>
                            </SW-DATA-DEF-PROPS>
                          </SW-SERVICE-ARG>
                          </ARGUMENTS>
                    </BSW-MODULE-ENTRY>
[!ENDIF!][!//
                    <BSW-MODULE-ENTRY>
                        <SHORT-NAME>Dma_ChIsStatusAsserted</SHORT-NAME>
                        <INTRODUCTION>
                            <NOTE SI="Dma_ChIsStatusAsserted is reentrant for different DMA channels" NOTE-TYPE="HINT" />
                        </INTRODUCTION>
                        <SERVICE-ID>14</SERVICE-ID>
                        <IS-REENTRANT>true</IS-REENTRANT>
                        <IS-SYNCHRONOUS>true</IS-SYNCHRONOUS>
                        <CALL-TYPE>REGULAR</CALL-TYPE>
                        <EXECUTION-CONTEXT>TASK</EXECUTION-CONTEXT>
                        <SW-SERVICE-IMPL-POLICY>STANDARD</SW-SERVICE-IMPL-POLICY>
                        <RETURN-TYPE>
                          <SHORT-NAME>Return</SHORT-NAME>
                          <SW-DATA-DEF-PROPS>
                            <SW-DATA-DEF-PROPS-VARIANTS>
                              <SW-DATA-DEF-PROPS-CONDITIONAL>
                                <IMPLEMENTATION-DATA-TYPE-REF DEST = "IMPLEMENTATION-DATA-TYPE">/AUTOSAR_StdTypes/ImplementationDataTypes/Std_ReturnType</IMPLEMENTATION-DATA-TYPE-REF>
                              </SW-DATA-DEF-PROPS-CONDITIONAL>
                            </SW-DATA-DEF-PROPS-VARIANTS>
                          </SW-DATA-DEF-PROPS>
                        </RETURN-TYPE>
                          <ARGUMENTS>
                          <SW-SERVICE-ARG>
                            <SHORT-NAME>Channel</SHORT-NAME>
                            <SW-DATA-DEF-PROPS>
                              <SW-DATA-DEF-PROPS-VARIANTS>
                                <SW-DATA-DEF-PROPS-CONDITIONAL>
                                <IMPLEMENTATION-DATA-TYPE-REF DEST = "IMPLEMENTATION-DATA-TYPE">/AUTOSAR_Platform/ImplementationDataTypes/uint8</IMPLEMENTATION-DATA-TYPE-REF>
                                </SW-DATA-DEF-PROPS-CONDITIONAL>
                              </SW-DATA-DEF-PROPS-VARIANTS>
                            </SW-DATA-DEF-PROPS>
                          </SW-SERVICE-ARG>
                           <SW-SERVICE-ARG>
                            <SHORT-NAME>Event</SHORT-NAME>
                            <SW-DATA-DEF-PROPS>
                              <SW-DATA-DEF-PROPS-VARIANTS>
                                <SW-DATA-DEF-PROPS-CONDITIONAL>
                                <IMPLEMENTATION-DATA-TYPE-REF DEST = "IMPLEMENTATION-DATA-TYPE">/AURIX2G_Dma/ImplementationDataTypes/Dma_ChEventType</IMPLEMENTATION-DATA-TYPE-REF>
                                </SW-DATA-DEF-PROPS-CONDITIONAL>
                              </SW-DATA-DEF-PROPS-VARIANTS>
                            </SW-DATA-DEF-PROPS>
                          </SW-SERVICE-ARG>
                          </ARGUMENTS>
                    </BSW-MODULE-ENTRY>
                    <BSW-MODULE-ENTRY>
                        <SHORT-NAME>Dma_ChStatusClear</SHORT-NAME>
                        <INTRODUCTION>
                            <NOTE SI="Dma_ChStatusClear is reentrant for different DMA channels" NOTE-TYPE="HINT" />
                        </INTRODUCTION>
                        <SERVICE-ID>15</SERVICE-ID>
                        <IS-REENTRANT>true</IS-REENTRANT>
                        <IS-SYNCHRONOUS>true</IS-SYNCHRONOUS>
                        <CALL-TYPE>REGULAR</CALL-TYPE>
                        <EXECUTION-CONTEXT>TASK</EXECUTION-CONTEXT>
                        <SW-SERVICE-IMPL-POLICY>STANDARD</SW-SERVICE-IMPL-POLICY>
                          <ARGUMENTS>
                          <SW-SERVICE-ARG>
                            <SHORT-NAME>Channel</SHORT-NAME>
                            <SW-DATA-DEF-PROPS>
                              <SW-DATA-DEF-PROPS-VARIANTS>
                                <SW-DATA-DEF-PROPS-CONDITIONAL>
                                <IMPLEMENTATION-DATA-TYPE-REF DEST = "IMPLEMENTATION-DATA-TYPE">/AUTOSAR_Platform/ImplementationDataTypes/uint8</IMPLEMENTATION-DATA-TYPE-REF>
                                </SW-DATA-DEF-PROPS-CONDITIONAL>
                              </SW-DATA-DEF-PROPS-VARIANTS>
                            </SW-DATA-DEF-PROPS>
                          </SW-SERVICE-ARG>
                           <SW-SERVICE-ARG>
                            <SHORT-NAME>Event</SHORT-NAME>
                            <SW-DATA-DEF-PROPS>
                              <SW-DATA-DEF-PROPS-VARIANTS>
                                <SW-DATA-DEF-PROPS-CONDITIONAL>
                                <IMPLEMENTATION-DATA-TYPE-REF DEST = "IMPLEMENTATION-DATA-TYPE">/AURIX2G_Dma/ImplementationDataTypes/Dma_ChEventType</IMPLEMENTATION-DATA-TYPE-REF>
                                </SW-DATA-DEF-PROPS-CONDITIONAL>
                              </SW-DATA-DEF-PROPS-VARIANTS>
                            </SW-DATA-DEF-PROPS>
                          </SW-SERVICE-ARG>
                          </ARGUMENTS>
                    </BSW-MODULE-ENTRY>
                    <BSW-MODULE-ENTRY>
                        <SHORT-NAME>Dma_ChInterruptEnable</SHORT-NAME>
                        <INTRODUCTION>
                            <NOTE SI="Dma_ChInterruptEnable is reentrant for different DMA channels" NOTE-TYPE="HINT" />
                        </INTRODUCTION>
                        <SERVICE-ID>16</SERVICE-ID>
                        <IS-REENTRANT>true</IS-REENTRANT>
                        <IS-SYNCHRONOUS>true</IS-SYNCHRONOUS>
                        <CALL-TYPE>REGULAR</CALL-TYPE>
                        <EXECUTION-CONTEXT>TASK</EXECUTION-CONTEXT>
                        <SW-SERVICE-IMPL-POLICY>STANDARD</SW-SERVICE-IMPL-POLICY>
                          <ARGUMENTS>
                          <SW-SERVICE-ARG>
                            <SHORT-NAME>Channel</SHORT-NAME>
                            <SW-DATA-DEF-PROPS>
                              <SW-DATA-DEF-PROPS-VARIANTS>
                                <SW-DATA-DEF-PROPS-CONDITIONAL>
                                <IMPLEMENTATION-DATA-TYPE-REF DEST = "IMPLEMENTATION-DATA-TYPE">/AUTOSAR_Platform/ImplementationDataTypes/uint8</IMPLEMENTATION-DATA-TYPE-REF>
                                </SW-DATA-DEF-PROPS-CONDITIONAL>
                              </SW-DATA-DEF-PROPS-VARIANTS>
                            </SW-DATA-DEF-PROPS>
                          </SW-SERVICE-ARG>
                           <SW-SERVICE-ARG>
                            <SHORT-NAME>Event</SHORT-NAME>
                            <SW-DATA-DEF-PROPS>
                              <SW-DATA-DEF-PROPS-VARIANTS>
                                <SW-DATA-DEF-PROPS-CONDITIONAL>
                                <IMPLEMENTATION-DATA-TYPE-REF DEST = "IMPLEMENTATION-DATA-TYPE">/AURIX2G_Dma/ImplementationDataTypes/Dma_ChEventType</IMPLEMENTATION-DATA-TYPE-REF>
                                </SW-DATA-DEF-PROPS-CONDITIONAL>
                              </SW-DATA-DEF-PROPS-VARIANTS>
                            </SW-DATA-DEF-PROPS>
                          </SW-SERVICE-ARG>
                          </ARGUMENTS>
                    </BSW-MODULE-ENTRY>
                    <BSW-MODULE-ENTRY>
                        <SHORT-NAME>Dma_ChInterruptDisable</SHORT-NAME>
                        <INTRODUCTION>
                            <NOTE SI="Dma_ChInterruptDisable is reentrant for different DMA channels" NOTE-TYPE="HINT" />
                        </INTRODUCTION>
                        <SERVICE-ID>17</SERVICE-ID>
                        <IS-REENTRANT>true</IS-REENTRANT>
                        <IS-SYNCHRONOUS>true</IS-SYNCHRONOUS>
                        <CALL-TYPE>REGULAR</CALL-TYPE>
                        <EXECUTION-CONTEXT>TASK</EXECUTION-CONTEXT>
                        <SW-SERVICE-IMPL-POLICY>STANDARD</SW-SERVICE-IMPL-POLICY>
                          <ARGUMENTS>
                          <SW-SERVICE-ARG>
                            <SHORT-NAME>Channel</SHORT-NAME>
                            <SW-DATA-DEF-PROPS>
                              <SW-DATA-DEF-PROPS-VARIANTS>
                                <SW-DATA-DEF-PROPS-CONDITIONAL>
                                <IMPLEMENTATION-DATA-TYPE-REF DEST = "IMPLEMENTATION-DATA-TYPE">/AUTOSAR_Platform/ImplementationDataTypes/uint8</IMPLEMENTATION-DATA-TYPE-REF>
                                </SW-DATA-DEF-PROPS-CONDITIONAL>
                              </SW-DATA-DEF-PROPS-VARIANTS>
                            </SW-DATA-DEF-PROPS>
                          </SW-SERVICE-ARG>
                           <SW-SERVICE-ARG>
                            <SHORT-NAME>Event</SHORT-NAME>
                            <SW-DATA-DEF-PROPS>
                              <SW-DATA-DEF-PROPS-VARIANTS>
                                <SW-DATA-DEF-PROPS-CONDITIONAL>
                                <IMPLEMENTATION-DATA-TYPE-REF DEST = "IMPLEMENTATION-DATA-TYPE">/AURIX2G_Dma/ImplementationDataTypes/Dma_ChEventType</IMPLEMENTATION-DATA-TYPE-REF>
                                </SW-DATA-DEF-PROPS-CONDITIONAL>
                              </SW-DATA-DEF-PROPS-VARIANTS>
                            </SW-DATA-DEF-PROPS>
                          </SW-SERVICE-ARG>
                          </ARGUMENTS>
                    </BSW-MODULE-ENTRY>
                    <BSW-MODULE-ENTRY>
                        <SHORT-NAME>Dma_GetChannelEvent</SHORT-NAME>
                        <INTRODUCTION>
                            <NOTE SI="Dma_GetChannelEvent is reentrant for different DMA channels" NOTE-TYPE="HINT" />
                        </INTRODUCTION>
                        <SERVICE-ID>19</SERVICE-ID>
                        <IS-REENTRANT>true</IS-REENTRANT>
                        <IS-SYNCHRONOUS>true</IS-SYNCHRONOUS>
                        <CALL-TYPE>REGULAR</CALL-TYPE>
                        <EXECUTION-CONTEXT>TASK</EXECUTION-CONTEXT>
                        <SW-SERVICE-IMPL-POLICY>STANDARD</SW-SERVICE-IMPL-POLICY>
                        <RETURN-TYPE>
                          <SHORT-NAME>Return</SHORT-NAME>
                          <SW-DATA-DEF-PROPS>
                            <SW-DATA-DEF-PROPS-VARIANTS>
                              <SW-DATA-DEF-PROPS-CONDITIONAL>
                                <IMPLEMENTATION-DATA-TYPE-REF DEST = "IMPLEMENTATION-DATA-TYPE">/AUTOSAR_Platform/ImplementationDataTypes/uint32</IMPLEMENTATION-DATA-TYPE-REF>
                              </SW-DATA-DEF-PROPS-CONDITIONAL>
                            </SW-DATA-DEF-PROPS-VARIANTS>
                          </SW-DATA-DEF-PROPS>
                        </RETURN-TYPE>
                          <ARGUMENTS>
                          <SW-SERVICE-ARG>
                            <SHORT-NAME>Channel</SHORT-NAME>
                            <SW-DATA-DEF-PROPS>
                              <SW-DATA-DEF-PROPS-VARIANTS>
                                <SW-DATA-DEF-PROPS-CONDITIONAL>
                                <IMPLEMENTATION-DATA-TYPE-REF DEST = "IMPLEMENTATION-DATA-TYPE">/AUTOSAR_Platform/ImplementationDataTypes/uint8</IMPLEMENTATION-DATA-TYPE-REF>
                                </SW-DATA-DEF-PROPS-CONDITIONAL>
                              </SW-DATA-DEF-PROPS-VARIANTS>
                            </SW-DATA-DEF-PROPS>
                          </SW-SERVICE-ARG>
                          </ARGUMENTS>
                    </BSW-MODULE-ENTRY>
                    <BSW-MODULE-ENTRY>
                        <SHORT-NAME>Dma_GetMoveEngineEvent</SHORT-NAME>
                        <INTRODUCTION>
                            <NOTE SI="Dma_GetMoveEngineEvent is reentrant for different DMA channels" NOTE-TYPE="HINT" />
                        </INTRODUCTION>
                        <SERVICE-ID>20</SERVICE-ID>
                        <IS-REENTRANT>true</IS-REENTRANT>
                        <IS-SYNCHRONOUS>true</IS-SYNCHRONOUS>
                        <CALL-TYPE>REGULAR</CALL-TYPE>
                        <EXECUTION-CONTEXT>TASK</EXECUTION-CONTEXT>
                        <SW-SERVICE-IMPL-POLICY>STANDARD</SW-SERVICE-IMPL-POLICY>
                        <RETURN-TYPE>
                          <SHORT-NAME>Return</SHORT-NAME>
                          <SW-DATA-DEF-PROPS>
                            <SW-DATA-DEF-PROPS-VARIANTS>
                              <SW-DATA-DEF-PROPS-CONDITIONAL>
                                <IMPLEMENTATION-DATA-TYPE-REF DEST = "IMPLEMENTATION-DATA-TYPE">/AUTOSAR_Platform/ImplementationDataTypes/uint32</IMPLEMENTATION-DATA-TYPE-REF>
                              </SW-DATA-DEF-PROPS-CONDITIONAL>
                            </SW-DATA-DEF-PROPS-VARIANTS>
                          </SW-DATA-DEF-PROPS>
                        </RETURN-TYPE>
                          <ARGUMENTS>
                          <SW-SERVICE-ARG>
                            <SHORT-NAME>Channel</SHORT-NAME>
                            <SW-DATA-DEF-PROPS>
                              <SW-DATA-DEF-PROPS-VARIANTS>
                                <SW-DATA-DEF-PROPS-CONDITIONAL>
                                <IMPLEMENTATION-DATA-TYPE-REF DEST = "IMPLEMENTATION-DATA-TYPE">/AUTOSAR_Platform/ImplementationDataTypes/uint8</IMPLEMENTATION-DATA-TYPE-REF>
                                </SW-DATA-DEF-PROPS-CONDITIONAL>
                              </SW-DATA-DEF-PROPS-VARIANTS>
                            </SW-DATA-DEF-PROPS>
                          </SW-SERVICE-ARG>
                          </ARGUMENTS>
                    </BSW-MODULE-ENTRY>
                    <BSW-MODULE-ENTRY>
                        <SHORT-NAME>Dma_MEStatusClear</SHORT-NAME>
                        <SERVICE-ID>21</SERVICE-ID>
                        <IS-REENTRANT>true</IS-REENTRANT>
                        <IS-SYNCHRONOUS>true</IS-SYNCHRONOUS>
                        <CALL-TYPE>REGULAR</CALL-TYPE>
                        <EXECUTION-CONTEXT>TASK</EXECUTION-CONTEXT>
                        <SW-SERVICE-IMPL-POLICY>STANDARD</SW-SERVICE-IMPL-POLICY>
                        <ARGUMENTS>
                          <SW-SERVICE-ARG>
                            <SHORT-NAME>MoveEngineNumber</SHORT-NAME>
                            <SW-DATA-DEF-PROPS>
                              <SW-DATA-DEF-PROPS-VARIANTS>
                                <SW-DATA-DEF-PROPS-CONDITIONAL>
                                <IMPLEMENTATION-DATA-TYPE-REF DEST = "IMPLEMENTATION-DATA-TYPE">/AURIX2G_Dma/ImplementationDataTypes/Dma_MoveEngineListType</IMPLEMENTATION-DATA-TYPE-REF>
                                </SW-DATA-DEF-PROPS-CONDITIONAL>
                              </SW-DATA-DEF-PROPS-VARIANTS>
                            </SW-DATA-DEF-PROPS>
                          </SW-SERVICE-ARG>
                        </ARGUMENTS>
                    </BSW-MODULE-ENTRY>
                    <BSW-MODULE-ENTRY>
                        <SHORT-NAME>Dma_ChInterruptHandler</SHORT-NAME>
                        <INTRODUCTION>
                            <NOTE SI="Dma_ChInterruptHandler is reentrant for different DMA channels" NOTE-TYPE="HINT" />
                        </INTRODUCTION>
                        <IS-REENTRANT>true</IS-REENTRANT>
                        <IS-SYNCHRONOUS>true</IS-SYNCHRONOUS>
                        <CALL-TYPE>INTERRUPT</CALL-TYPE>
                        <EXECUTION-CONTEXT>INTERRUPT-CAT-1</EXECUTION-CONTEXT>
                        <SW-SERVICE-IMPL-POLICY>STANDARD</SW-SERVICE-IMPL-POLICY>
                          <ARGUMENTS>
                            <SW-SERVICE-ARG>
                              <SHORT-NAME>Channel</SHORT-NAME>
                              <SW-DATA-DEF-PROPS>
                                <SW-DATA-DEF-PROPS-VARIANTS>
                                  <SW-DATA-DEF-PROPS-CONDITIONAL>
                                  <IMPLEMENTATION-DATA-TYPE-REF DEST = "IMPLEMENTATION-DATA-TYPE">/AUTOSAR_Platform/ImplementationDataTypes/uint8</IMPLEMENTATION-DATA-TYPE-REF>
                                  </SW-DATA-DEF-PROPS-CONDITIONAL>
                                </SW-DATA-DEF-PROPS-VARIANTS>
                              </SW-DATA-DEF-PROPS>
                            </SW-SERVICE-ARG>
                          </ARGUMENTS>
                    </BSW-MODULE-ENTRY>
                    <BSW-MODULE-ENTRY>
                        <SHORT-NAME>Dma_MEInterruptHandler</SHORT-NAME>
                        <IS-REENTRANT>false</IS-REENTRANT>
                        <IS-SYNCHRONOUS>true</IS-SYNCHRONOUS>
                        <CALL-TYPE>INTERRUPT</CALL-TYPE>
                        <EXECUTION-CONTEXT>INTERRUPT-CAT-1</EXECUTION-CONTEXT>
                        <SW-SERVICE-IMPL-POLICY>STANDARD</SW-SERVICE-IMPL-POLICY>
                          <ARGUMENTS>
                            <SW-SERVICE-ARG>
                              <SHORT-NAME>lErrorSource</SHORT-NAME>
                              <SW-DATA-DEF-PROPS>
                                <SW-DATA-DEF-PROPS-VARIANTS>
                                  <SW-DATA-DEF-PROPS-CONDITIONAL>
                                  <IMPLEMENTATION-DATA-TYPE-REF DEST = "IMPLEMENTATION-DATA-TYPE">/AUTOSAR_Platform/ImplementationDataTypes/uint8</IMPLEMENTATION-DATA-TYPE-REF>
                                  </SW-DATA-DEF-PROPS-CONDITIONAL>
                                </SW-DATA-DEF-PROPS-VARIANTS>
                              </SW-DATA-DEF-PROPS>
                            </SW-SERVICE-ARG>
                            <SW-SERVICE-ARG>
                              <SHORT-NAME>lErrorData</SHORT-NAME>
                              <SW-DATA-DEF-PROPS>
                                <SW-DATA-DEF-PROPS-VARIANTS>
                                  <SW-DATA-DEF-PROPS-CONDITIONAL>
                                  <IMPLEMENTATION-DATA-TYPE-REF DEST = "IMPLEMENTATION-DATA-TYPE">/AUTOSAR_Platform/ImplementationDataTypes/uint32</IMPLEMENTATION-DATA-TYPE-REF>
                                  </SW-DATA-DEF-PROPS-CONDITIONAL>
                                </SW-DATA-DEF-PROPS-VARIANTS>
                              </SW-DATA-DEF-PROPS>
                            </SW-SERVICE-ARG>
                          </ARGUMENTS>
                    </BSW-MODULE-ENTRY>
                    <BSW-MODULE-ENTRY>
                        <SHORT-NAME>Dma_MEInterruptDispatcher</SHORT-NAME>
                        <IS-REENTRANT>false</IS-REENTRANT>
                        <IS-SYNCHRONOUS>true</IS-SYNCHRONOUS>
                        <CALL-TYPE>INTERRUPT</CALL-TYPE>
                        <EXECUTION-CONTEXT>INTERRUPT-CAT-1</EXECUTION-CONTEXT>
                        <SW-SERVICE-IMPL-POLICY>STANDARD</SW-SERVICE-IMPL-POLICY>
                    </BSW-MODULE-ENTRY>
[!IF "$Dma_VersionInfoApi_Xpath = 'true'"!]                    
                    <BSW-MODULE-ENTRY>
                        <SHORT-NAME>Dma_GetVersionInfo</SHORT-NAME>
                        <SERVICE-ID>18</SERVICE-ID>
                        <IS-REENTRANT>true</IS-REENTRANT>
                        <IS-SYNCHRONOUS>true</IS-SYNCHRONOUS>
                        <CALL-TYPE>REGULAR</CALL-TYPE>
                        <EXECUTION-CONTEXT>TASK</EXECUTION-CONTEXT>
                        <SW-SERVICE-IMPL-POLICY>STANDARD</SW-SERVICE-IMPL-POLICY>
                        <ARGUMENTS>
                          <SW-SERVICE-ARG>
                            <SHORT-NAME>VersionInfoPtr</SHORT-NAME>
                            <CATEGORY>DATA_REFERENCE</CATEGORY>
                            <SW-DATA-DEF-PROPS>
                              <SW-DATA-DEF-PROPS-VARIANTS>
                                <SW-DATA-DEF-PROPS-CONDITIONAL>
                                <SW-POINTER-TARGET-PROPS>
                                <TARGET-CATEGORY>TYPE_REFERENCE</TARGET-CATEGORY>
                                <SW-DATA-DEF-PROPS>
                                <SW-DATA-DEF-PROPS-VARIANTS>
                                <SW-DATA-DEF-PROPS-CONDITIONAL>
                                <IMPLEMENTATION-DATA-TYPE-REF DEST = "IMPLEMENTATION-DATA-TYPE">/AUTOSAR_StdTypes/ImplementationDataTypes/Std_VersionInfoType</IMPLEMENTATION-DATA-TYPE-REF>
                                </SW-DATA-DEF-PROPS-CONDITIONAL>
                                </SW-DATA-DEF-PROPS-VARIANTS>
                                </SW-DATA-DEF-PROPS>
                                </SW-POINTER-TARGET-PROPS>
                                </SW-DATA-DEF-PROPS-CONDITIONAL>
                              </SW-DATA-DEF-PROPS-VARIANTS>
                            </SW-DATA-DEF-PROPS>
                          </SW-SERVICE-ARG>
                        </ARGUMENTS>
                    </BSW-MODULE-ENTRY>
[!ENDIF!][!//              
                    <BSW-MODULE-ENTRY>
                        <SHORT-NAME>Dma_GetCrcValue</SHORT-NAME>
                        <SERVICE-ID>23</SERVICE-ID>
                        <IS-REENTRANT>true</IS-REENTRANT>
                        <IS-SYNCHRONOUS>true</IS-SYNCHRONOUS>
                        <CALL-TYPE>REGULAR</CALL-TYPE>
                        <EXECUTION-CONTEXT>TASK</EXECUTION-CONTEXT>
                        <SW-SERVICE-IMPL-POLICY>STANDARD</SW-SERVICE-IMPL-POLICY>
                        <RETURN-TYPE>
                          <SHORT-NAME>Return</SHORT-NAME>
                          <SW-DATA-DEF-PROPS>
                            <SW-DATA-DEF-PROPS-VARIANTS>
                              <SW-DATA-DEF-PROPS-CONDITIONAL>
                                <IMPLEMENTATION-DATA-TYPE-REF DEST = "IMPLEMENTATION-DATA-TYPE">/AUTOSAR_Platform/ImplementationDataTypes/uint32</IMPLEMENTATION-DATA-TYPE-REF>
                              </SW-DATA-DEF-PROPS-CONDITIONAL>
                            </SW-DATA-DEF-PROPS-VARIANTS>
                          </SW-DATA-DEF-PROPS>
                        </RETURN-TYPE>
                        <ARGUMENTS>
                          <SW-SERVICE-ARG>
                            <SHORT-NAME>ChannelId</SHORT-NAME>
                            <SW-DATA-DEF-PROPS>
                              <SW-DATA-DEF-PROPS-VARIANTS>
                                <SW-DATA-DEF-PROPS-CONDITIONAL>
                                <IMPLEMENTATION-DATA-TYPE-REF DEST = "IMPLEMENTATION-DATA-TYPE">/AUTOSAR_Platform/ImplementationDataTypes/uint8</IMPLEMENTATION-DATA-TYPE-REF>
                                </SW-DATA-DEF-PROPS-CONDITIONAL>
                              </SW-DATA-DEF-PROPS-VARIANTS>
                            </SW-DATA-DEF-PROPS>
                          </SW-SERVICE-ARG>
                          <SW-SERVICE-ARG>
                            <SHORT-NAME>CrcType</SHORT-NAME>
                            <SW-DATA-DEF-PROPS>
                              <SW-DATA-DEF-PROPS-VARIANTS>
                                <SW-DATA-DEF-PROPS-CONDITIONAL>
                                <IMPLEMENTATION-DATA-TYPE-REF DEST = "IMPLEMENTATION-DATA-TYPE">/AURIX2G_Dma/ImplementationDataTypes/Dma_CrcType</IMPLEMENTATION-DATA-TYPE-REF>
                                </SW-DATA-DEF-PROPS-CONDITIONAL>
                              </SW-DATA-DEF-PROPS-VARIANTS>
                            </SW-DATA-DEF-PROPS>
                          </SW-SERVICE-ARG>
                        </ARGUMENTS>
                    </BSW-MODULE-ENTRY>
                    <BSW-MODULE-ENTRY>
                        <SHORT-NAME>Dma_GetCurrentTimeStamp</SHORT-NAME>
                        <SERVICE-ID>24</SERVICE-ID>
                        <IS-REENTRANT>true</IS-REENTRANT>
                        <IS-SYNCHRONOUS>true</IS-SYNCHRONOUS>
                        <CALL-TYPE>REGULAR</CALL-TYPE>
                        <EXECUTION-CONTEXT>TASK</EXECUTION-CONTEXT>
                        <SW-SERVICE-IMPL-POLICY>STANDARD</SW-SERVICE-IMPL-POLICY>
                        <RETURN-TYPE>
                          <SHORT-NAME>Return</SHORT-NAME>
                          <SW-DATA-DEF-PROPS>
                            <SW-DATA-DEF-PROPS-VARIANTS>
                              <SW-DATA-DEF-PROPS-CONDITIONAL>
                                <IMPLEMENTATION-DATA-TYPE-REF DEST = "IMPLEMENTATION-DATA-TYPE">/AUTOSAR_Platform/ImplementationDataTypes/uint32</IMPLEMENTATION-DATA-TYPE-REF>
                              </SW-DATA-DEF-PROPS-CONDITIONAL>
                            </SW-DATA-DEF-PROPS-VARIANTS>
                          </SW-DATA-DEF-PROPS>
                        </RETURN-TYPE>
                    </BSW-MODULE-ENTRY>
                    <BSW-MODULE-ENTRY>
                        <SHORT-NAME>Dma_IsChannelInitDone</SHORT-NAME>
                        <SERVICE-ID>25</SERVICE-ID>
                        <IS-REENTRANT>true</IS-REENTRANT>
                        <IS-SYNCHRONOUS>true</IS-SYNCHRONOUS>
                        <CALL-TYPE>REGULAR</CALL-TYPE>
                        <EXECUTION-CONTEXT>TASK</EXECUTION-CONTEXT>
                        <SW-SERVICE-IMPL-POLICY>STANDARD</SW-SERVICE-IMPL-POLICY>
                        <RETURN-TYPE>
                          <SHORT-NAME>Return</SHORT-NAME>
                          <SW-DATA-DEF-PROPS>
                            <SW-DATA-DEF-PROPS-VARIANTS>
                              <SW-DATA-DEF-PROPS-CONDITIONAL>
                                <IMPLEMENTATION-DATA-TYPE-REF DEST = "IMPLEMENTATION-DATA-TYPE">/AUTOSAR_StdTypes/ImplementationDataTypes/Std_ReturnType</IMPLEMENTATION-DATA-TYPE-REF>
                              </SW-DATA-DEF-PROPS-CONDITIONAL>
                            </SW-DATA-DEF-PROPS-VARIANTS>
                          </SW-DATA-DEF-PROPS>
                        </RETURN-TYPE>
                          <ARGUMENTS>
                          <SW-SERVICE-ARG>
                            <SHORT-NAME>Channel</SHORT-NAME>
                            <SW-DATA-DEF-PROPS>
                              <SW-DATA-DEF-PROPS-VARIANTS>
                                <SW-DATA-DEF-PROPS-CONDITIONAL>
                                <IMPLEMENTATION-DATA-TYPE-REF DEST = "IMPLEMENTATION-DATA-TYPE">/AUTOSAR_Platform/ImplementationDataTypes/uint8</IMPLEMENTATION-DATA-TYPE-REF>
                                </SW-DATA-DEF-PROPS-CONDITIONAL>
                              </SW-DATA-DEF-PROPS-VARIANTS>
                            </SW-DATA-DEF-PROPS>
                          </SW-SERVICE-ARG>
                          </ARGUMENTS>
                    </BSW-MODULE-ENTRY>
[!IF "$DmaInitCheckApi_Xpath = 'true'"!]
                    <BSW-MODULE-ENTRY>
                        <SHORT-NAME>Dma_InitCheck</SHORT-NAME>
                        <SERVICE-ID>22</SERVICE-ID>
                        <IS-REENTRANT>false</IS-REENTRANT>
                        <IS-SYNCHRONOUS>true</IS-SYNCHRONOUS>
                        <CALL-TYPE>REGULAR</CALL-TYPE>
                        <EXECUTION-CONTEXT>TASK</EXECUTION-CONTEXT>
                        <SW-SERVICE-IMPL-POLICY>STANDARD</SW-SERVICE-IMPL-POLICY>
                        <RETURN-TYPE>
                          <SHORT-NAME>Return</SHORT-NAME>
                          <SW-DATA-DEF-PROPS>
                            <SW-DATA-DEF-PROPS-VARIANTS>
                              <SW-DATA-DEF-PROPS-CONDITIONAL>
                                <IMPLEMENTATION-DATA-TYPE-REF DEST = "IMPLEMENTATION-DATA-TYPE">/AUTOSAR_StdTypes/ImplementationDataTypes/Std_ReturnType</IMPLEMENTATION-DATA-TYPE-REF>
                              </SW-DATA-DEF-PROPS-CONDITIONAL>
                            </SW-DATA-DEF-PROPS-VARIANTS>
                          </SW-DATA-DEF-PROPS>
                        </RETURN-TYPE>
                          <ARGUMENTS>
                          <SW-SERVICE-ARG>
                            <SHORT-NAME>ConfigPtr</SHORT-NAME>
                            <SW-DATA-DEF-PROPS>
                              <SW-DATA-DEF-PROPS-VARIANTS>
                                <SW-DATA-DEF-PROPS-CONDITIONAL>
                                <IMPLEMENTATION-DATA-TYPE-REF DEST = "IMPLEMENTATION-DATA-TYPE">/AURIX2G_Dma/ImplementationDataTypes/Dma_ConfigType</IMPLEMENTATION-DATA-TYPE-REF>
                                </SW-DATA-DEF-PROPS-CONDITIONAL>
                              </SW-DATA-DEF-PROPS-VARIANTS>
                            </SW-DATA-DEF-PROPS>
                          </SW-SERVICE-ARG>
                          </ARGUMENTS>
                    </BSW-MODULE-ENTRY>
[!ENDIF!][!//
                </ELEMENTS>
            </AR-PACKAGE>
            <AR-PACKAGE>
                <SHORT-NAME>Implementations</SHORT-NAME>
                <ELEMENTS>
                    <BSW-IMPLEMENTATION>
                        <SHORT-NAME>Dma</SHORT-NAME>
                        <CODE-DESCRIPTORS>
                            <CODE>
                                <SHORT-NAME>Files</SHORT-NAME>
                                <ARTIFACT-DESCRIPTORS>
                                    <AUTOSAR-ENGINEERING-OBJECT>
                                        <SHORT-LABEL>ssc::src::Dma.c</SHORT-LABEL>
                                        <CATEGORY>SWSRC</CATEGORY>
                                    </AUTOSAR-ENGINEERING-OBJECT>
                                    <AUTOSAR-ENGINEERING-OBJECT>
                                        <SHORT-LABEL>ssc::inc::Dma.h</SHORT-LABEL>
                                        <CATEGORY>SWHDR</CATEGORY>
                                    </AUTOSAR-ENGINEERING-OBJECT>
                                   </ARTIFACT-DESCRIPTORS>
                            </CODE>
                        </CODE-DESCRIPTORS>
                        <COMPILERS>
                            <COMPILER>
                                <SHORT-NAME>TASKING_COMPILE</SHORT-NAME>
                                <NAME>TASKING</NAME>
                                <OPTIONS>"[!"$TaskingCompilerOption"!]"</OPTIONS>
                                <VENDOR>Altium</VENDOR>
                                <VERSION>[!"$TaskingVersion"!]</VERSION>
                            </COMPILER>
                            <COMPILER>
                                <SHORT-NAME>GNU_COMPILE</SHORT-NAME>
                                <NAME>GNU</NAME>
                                <OPTIONS>"[!"$GnucCompilerOption"!]"</OPTIONS>
                                <VENDOR>Hightec</VENDOR>
                                <VERSION>[!"$GnucVersion"!]</VERSION>
                            </COMPILER>
                            <COMPILER>
                                <SHORT-NAME>DIAB_COMPILE</SHORT-NAME>
                                <NAME>DIAB</NAME>
                                <OPTIONS>"[!"$DccCompilerOption"!]"</OPTIONS>
                                <VENDOR>Windriver</VENDOR>
                                <VERSION>[!"$DccVersion"!]</VERSION>
                            </COMPILER>
                            <COMPILER>
                                <SHORT-NAME>GHS_COMPILE</SHORT-NAME>
                                <NAME>GHS</NAME>
                                <OPTIONS>"[!"$GhsCompilerOption"!]"</OPTIONS>
                                <VENDOR>GreenHills</VENDOR>
                                <VERSION>[!"$GhsVersion"!]</VERSION>
                            </COMPILER>
                        </COMPILERS>
                        <GENERATED-ARTIFACTS>
                            <DEPENDENCY-ON-ARTIFACT>
                                <SHORT-NAME>Dma_PBcfg_c</SHORT-NAME>
                                <ARTIFACT-DESCRIPTOR>
                                    <SHORT-LABEL>generate::template::src::Dma_PBcfg.c</SHORT-LABEL>
                                    <CATEGORY>SWTEMPLATE</CATEGORY>
                                </ARTIFACT-DESCRIPTOR>
                                <USAGES>
                                    <USAGE>EXECUTE</USAGE>
                                </USAGES>
                            </DEPENDENCY-ON-ARTIFACT>
                            <DEPENDENCY-ON-ARTIFACT>
                                <SHORT-NAME>Dma_PBcfg_h</SHORT-NAME>
                                <ARTIFACT-DESCRIPTOR>
                                    <SHORT-LABEL>generate::template::inc::Dma_PBcfg.h</SHORT-LABEL>
                                    <CATEGORY>SWTEMPLATE</CATEGORY>
                                </ARTIFACT-DESCRIPTOR>
                                <USAGES>
                                    <USAGE>EXECUTE</USAGE>
                                </USAGES>
                            </DEPENDENCY-ON-ARTIFACT>                            
                            <DEPENDENCY-ON-ARTIFACT>
                                <SHORT-NAME>Dma_Cfg_h</SHORT-NAME>
                                <ARTIFACT-DESCRIPTOR>
                                    <SHORT-LABEL>generate::template::inc::Dma_Cfg.h</SHORT-LABEL>
                                    <CATEGORY>SWTEMPLATE</CATEGORY>
                                </ARTIFACT-DESCRIPTOR>
                                <USAGES>
                                    <USAGE>COMPILE</USAGE>
                                </USAGES>
                            </DEPENDENCY-ON-ARTIFACT>
                            <DEPENDENCY-ON-ARTIFACT>
                                <SHORT-NAME>Dma_xdm</SHORT-NAME>
                                <ARTIFACT-DESCRIPTOR>
                                    <SHORT-LABEL>config::Dma.xdm</SHORT-LABEL>
                                    <CATEGORY>SWTOOL</CATEGORY>
                                </ARTIFACT-DESCRIPTOR>
                                <USAGES>
                                    <USAGE>CODEGENERATION</USAGE>
                                </USAGES>
                            </DEPENDENCY-ON-ARTIFACT>
                            <DEPENDENCY-ON-ARTIFACT>
                                <SHORT-NAME>Dma_bmd</SHORT-NAME>
                                <ARTIFACT-DESCRIPTOR>
                                    <SHORT-LABEL>autosar::[!"concat(substring(ecu:get('Rel.SubDerivate'),1,4),'x')"!]::[!"ecu:get('Rel.SubDerivate')"!]::Dma.bmd</SHORT-LABEL>
                                    <CATEGORY>SWTOOL</CATEGORY>
                                </ARTIFACT-DESCRIPTOR>
                                <USAGES>
                                    <USAGE>CODEGENERATION</USAGE>
                                </USAGES>
                            </DEPENDENCY-ON-ARTIFACT>
                        </GENERATED-ARTIFACTS>
                        <LINKERS>
                            <LINKER>
                                <SHORT-NAME>TASKING_LINK</SHORT-NAME>
                                <NAME>TASKING</NAME>
                                <OPTIONS>"[!"$TaskingLinkerOption"!]"</OPTIONS>
                                <VENDOR>Altium</VENDOR>
                                <VERSION>[!"$TaskingVersion"!]</VERSION>
                            </LINKER>
                            <LINKER>
                                <SHORT-NAME>GNU_LINK</SHORT-NAME>
                                <NAME>GNU</NAME>
                                <OPTIONS>"[!"$GnucLinkerOption"!]"</OPTIONS>
                                <VENDOR>Hightec</VENDOR>
                                <VERSION>[!"$GnucVersion"!]</VERSION>
                            </LINKER>
                            <LINKER>
                                <SHORT-NAME>DIAB_LINK</SHORT-NAME>
                                <NAME>DIAB</NAME>
                                <OPTIONS>"[!"$DccLinkerOption"!]"</OPTIONS>
                                <VENDOR>Windriver</VENDOR>
                                <VERSION>[!"$DccVersion"!]</VERSION>
                            </LINKER>
                            <LINKER>
                                <SHORT-NAME>GHS_LINK</SHORT-NAME>
                                <NAME>GHS</NAME>
                                <OPTIONS>"[!"$GhsLinkerOption"!]"</OPTIONS>
                                <VENDOR>GreenHills</VENDOR>
                                <VERSION>[!"$GhsVersion"!]</VERSION>
                            </LINKER>
                        </LINKERS>
                        <PROGRAMMING-LANGUAGE>C</PROGRAMMING-LANGUAGE>
                        <RESOURCE-CONSUMPTION>
                            <SHORT-NAME>ResourceConsumption</SHORT-NAME>
                            <MEMORY-SECTIONS>
                                <MEMORY-SECTION>
                                    <SHORT-NAME>VAR_CLEARED_ASIL_B_GLOBAL_32</SHORT-NAME>
                                    <ALIGNMENT>32</ALIGNMENT>
                                    <SW-ADDRMETHOD-REF DEST="SW-ADDR-METHOD">/AUTOSAR_MemMap/SwAddrMethods/VAR</SW-ADDRMETHOD-REF>
                                </MEMORY-SECTION>
                                <MEMORY-SECTION>
                                    <SHORT-NAME>VAR_CLEARED_ASIL_B_GLOBAL_8</SHORT-NAME>
                                    <ALIGNMENT>8</ALIGNMENT>
                                    <SW-ADDRMETHOD-REF DEST="SW-ADDR-METHOD">/AUTOSAR_MemMap/SwAddrMethods/VAR</SW-ADDRMETHOD-REF>
                                </MEMORY-SECTION>
                                <MEMORY-SECTION>
                                    <SHORT-NAME>CODE_ASIL_B_GLOBAL</SHORT-NAME>
                                    <ALIGNMENT>UNSPECIFIED</ALIGNMENT>
                                    <SW-ADDRMETHOD-REF DEST="SW-ADDR-METHOD">/AUTOSAR_MemMap/SwAddrMethods/CODE</SW-ADDRMETHOD-REF>
                                </MEMORY-SECTION>
                                <MEMORY-SECTION>
                                    <SHORT-NAME>CONST_ASIL_B_GLOBAL_32</SHORT-NAME>
                                    <ALIGNMENT>32</ALIGNMENT>
                                    <SW-ADDRMETHOD-REF DEST="SW-ADDR-METHOD">/AUTOSAR_MemMap/SwAddrMethods/CONST</SW-ADDRMETHOD-REF>
                                </MEMORY-SECTION>
[!NOCODE!][!//
    [!/* Get all the core and channel mappings from the Resource Manager */!][!//
    [!CALL "Dma_CG_GenerateModuleMap", "Module"="'DMA'"!][!//
    [!VAR "MasterCoreNumber" = "num:i(0)"!][!//
    [!/* Get the number of the core configured as the master core */!][!//
    [!CALL "Dma_CG_GetMasterCoreNumber", "MasterCoreNumber" = "num:i(0)"!][!//
    [!VAR "NoOfUnassignedChannels" = "num:i(0)"!][!//
    [!/* Get the number of unallocated channels, which eventually goes to the master core */!][!//
    [!CALL "Dma_CG_GetNoOfUnallocatedChannels", "NoOfUnassignedChannels" = "num:i(0)"!][!//
    [!FOR "ChannelCoreIndex" = "num:i(0)" TO "num:i(ecu:get('Mcu.NoOfCoreAvailable')) - num:i(1)"!][!//
        [!VAR "AllocationTotalCount" = "num:i(0)"!][!//
        [!CALL "Dma_CG_GetResourceNumbers", "LocalCoreId"="$ChannelCoreIndex", "AllocationTotalCount" = "''"!][!//
        [!IF "$ChannelCoreIndex = $MasterCoreNumber"!][!//
            [!VAR "ConsolidatedCount" = "num:i(num:i($AllocationTotalCount) + num:i($NoOfUnassignedChannels))"!][!//
        [!ELSE!][!//
            [!VAR "ConsolidatedCount" = "num:i($AllocationTotalCount)"!][!//
        [!ENDIF!][!//
        [!CODE!][!//
            [!IF "num:i($ConsolidatedCount) > num:i(0)"!][!//
                                <MEMORY-SECTION>
                                    <SHORT-NAME>CONFIG_DATA_ASIL_B_CORE[!"num:i($ChannelCoreIndex)"!]_256</SHORT-NAME>
                                    <ALIGNMENT>256</ALIGNMENT>
                                    <SW-ADDRMETHOD-REF DEST="SW-ADDR-METHOD">/AUTOSAR_MemMap/SwAddrMethods/CONFIG_DATA</SW-ADDRMETHOD-REF>
                                </MEMORY-SECTION>
                                <MEMORY-SECTION>
                                    <SHORT-NAME>CONFIG_DATA_ASIL_B_CORE[!"num:i($ChannelCoreIndex)"!]_UNSPECIFIED</SHORT-NAME>
                                    <ALIGNMENT>256</ALIGNMENT>
                                    <SW-ADDRMETHOD-REF DEST="SW-ADDR-METHOD">/AUTOSAR_MemMap/SwAddrMethods/CONFIG_DATA</SW-ADDRMETHOD-REF>
                                </MEMORY-SECTION>
            [!ENDIF!][!//
                                <MEMORY-SECTION>
                                    <SHORT-NAME>VAR_CLEARED_ASIL_B_CORE[!"num:i($ChannelCoreIndex)"!]_8</SHORT-NAME>
                                    <ALIGNMENT>8</ALIGNMENT>
                                    <SW-ADDRMETHOD-REF DEST="SW-ADDR-METHOD">/AUTOSAR_MemMap/SwAddrMethods/VAR</SW-ADDRMETHOD-REF>
                                </MEMORY-SECTION>
        [!ENDCODE!][!//
    [!ENDFOR!][!//
[!ENDNOCODE!][!//
                                <MEMORY-SECTION>
                                    <SHORT-NAME>CONFIG_DATA_ASIL_B_GLOBAL_UNSPECIFIED</SHORT-NAME>
                                    <ALIGNMENT>UNSPECIFIED</ALIGNMENT>
                                    <SW-ADDRMETHOD-REF DEST="SW-ADDR-METHOD">/AUTOSAR_MemMap/SwAddrMethods/CONFIG_DATA</SW-ADDRMETHOD-REF>
                                </MEMORY-SECTION>
                            </MEMORY-SECTIONS>
                            <SECTION-NAME-PREFIXS>
                                <SECTION-NAME-PREFIX>
                                    <SHORT-NAME>DMA</SHORT-NAME>
                                    <SYMBOL>DMA</SYMBOL>
                                </SECTION-NAME-PREFIX>
                            </SECTION-NAME-PREFIXS>
                        </RESOURCE-CONSUMPTION>
                        <SW-VERSION>2.1.0</SW-VERSION>
                        <VENDOR-ID>17</VENDOR-ID>
                        <AR-RELEASE-VERSION>4.2.2</AR-RELEASE-VERSION>
                        <BEHAVIOR-REF DEST="BSW-INTERNAL-BEHAVIOR">/AURIX2G_Dma/BswModuleDescriptions/Dma/DmaBehavior</BEHAVIOR-REF>
                        <VENDOR-SPECIFIC-MODULE-DEF-REFS>
                                <VENDOR-SPECIFIC-MODULE-DEF-REF DEST="ECUC-MODULE-DEF">/AURIX2G/EcucDefs/Dma</VENDOR-SPECIFIC-MODULE-DEF-REF>
                        </VENDOR-SPECIFIC-MODULE-DEF-REFS>
                    </BSW-IMPLEMENTATION>
                </ELEMENTS>
            </AR-PACKAGE>
            <AR-PACKAGE>
                <SHORT-NAME>ImplementationDataTypes</SHORT-NAME>
                <CATEGORY>STANDARD</CATEGORY>
                <ELEMENTS>
                    <IMPLEMENTATION-DATA-TYPE>
                        <SHORT-NAME>Dma_ChannelNotificationFnPtrType</SHORT-NAME>
                        <CATEGORY>DATA_REFERENCE</CATEGORY>
                        <INTRODUCTION>
                            <NOTE SI="This data type is for a function pointer type pointing to the callback-notification function. The referred function should be implemented by user of the driver" NOTE-TYPE="HINT"/>
                        </INTRODUCTION>
                        <SW-DATA-DEF-PROPS>
                            <SW-DATA-DEF-PROPS-VARIANTS>
                                <SW-DATA-DEF-PROPS-CONDITIONAL>
                                    <SW-POINTER-TARGET-PROPS>
                                        <TARGET-CATEGORY>FUNCTION_REFERENCE</TARGET-CATEGORY>
                                        <FUNCTION-POINTER-SIGNATURE-REF DEST="BSW-MODULE-ENTRY">/AUTOSAR_Stub/BswModuleEntrys/Dma_ChannelNotification</FUNCTION-POINTER-SIGNATURE-REF>
                                    </SW-POINTER-TARGET-PROPS>
                                </SW-DATA-DEF-PROPS-CONDITIONAL>
                            </SW-DATA-DEF-PROPS-VARIANTS>
                        </SW-DATA-DEF-PROPS>
                    </IMPLEMENTATION-DATA-TYPE>
                    <IMPLEMENTATION-DATA-TYPE>
                        <SHORT-NAME>Dma_ChEventType</SHORT-NAME>
                        <CATEGORY>TYPE_REFERENCE</CATEGORY>
                        <SW-DATA-DEF-PROPS>
                            <SW-DATA-DEF-PROPS-VARIANTS>
                                <SW-DATA-DEF-PROPS-CONDITIONAL>
                                    <COMPU-METHOD-REF DEST="COMPU-METHOD">/AURIX2G_Dma/CompuMethods/Dma_ChEventType</COMPU-METHOD-REF>
                                    <IMPLEMENTATION-DATA-TYPE-REF DEST="IMPLEMENTATION-DATA-TYPE">/AUTOSAR_Platform/ImplementationDataTypes/uint32</IMPLEMENTATION-DATA-TYPE-REF>
                                    <SW-IMPL-POLICY>STANDARD</SW-IMPL-POLICY>
                                    <ADDITIONAL-NATIVE-TYPE-QUALIFIER>enum</ADDITIONAL-NATIVE-TYPE-QUALIFIER>
                                </SW-DATA-DEF-PROPS-CONDITIONAL>
                            </SW-DATA-DEF-PROPS-VARIANTS>
                        </SW-DATA-DEF-PROPS>
                        <TYPE-EMITTER>BSW</TYPE-EMITTER>
                    </IMPLEMENTATION-DATA-TYPE>
                    <IMPLEMENTATION-DATA-TYPE>
                        <SHORT-NAME>Dma_ConfigUpdateType</SHORT-NAME>
                        <CATEGORY>STRUCTURE</CATEGORY>
                        <SUB-ELEMENTS>
                            <IMPLEMENTATION-DATA-TYPE-ELEMENT>
                                <SHORT-NAME>AddressCrc</SHORT-NAME>
                                <CATEGORY>TYPE_REFERENCE</CATEGORY>
                                <SW-DATA-DEF-PROPS>
                                    <SW-DATA-DEF-PROPS-VARIANTS>
                                        <SW-DATA-DEF-PROPS-CONDITIONAL>
                                            <IMPLEMENTATION-DATA-TYPE-REF DEST="IMPLEMENTATION-DATA-TYPE">/AUTOSAR_Platform/ImplementationDataTypes/uint32</IMPLEMENTATION-DATA-TYPE-REF>
                                        </SW-DATA-DEF-PROPS-CONDITIONAL>
                                    </SW-DATA-DEF-PROPS-VARIANTS>
                                </SW-DATA-DEF-PROPS>
                            </IMPLEMENTATION-DATA-TYPE-ELEMENT>
                            <IMPLEMENTATION-DATA-TYPE-ELEMENT>
                                <SHORT-NAME>Config</SHORT-NAME>
                                <CATEGORY>TYPE_REFERENCE</CATEGORY>
                                <SW-DATA-DEF-PROPS>
                                    <SW-DATA-DEF-PROPS-VARIANTS>
                                        <SW-DATA-DEF-PROPS-CONDITIONAL>
                                            <IMPLEMENTATION-DATA-TYPE-REF DEST="IMPLEMENTATION-DATA-TYPE">/AUTOSAR_Platform/ImplementationDataTypes/uint32</IMPLEMENTATION-DATA-TYPE-REF>
                                        </SW-DATA-DEF-PROPS-CONDITIONAL>
                                    </SW-DATA-DEF-PROPS-VARIANTS>
                                </SW-DATA-DEF-PROPS>
                            </IMPLEMENTATION-DATA-TYPE-ELEMENT>
                            <IMPLEMENTATION-DATA-TYPE-ELEMENT>
                                <SHORT-NAME>Control</SHORT-NAME>
                                <CATEGORY>TYPE_REFERENCE</CATEGORY>
                                <SW-DATA-DEF-PROPS>
                                    <SW-DATA-DEF-PROPS-VARIANTS>
                                        <SW-DATA-DEF-PROPS-CONDITIONAL>
                                            <IMPLEMENTATION-DATA-TYPE-REF DEST="IMPLEMENTATION-DATA-TYPE">/AUTOSAR_Platform/ImplementationDataTypes/uint32</IMPLEMENTATION-DATA-TYPE-REF>
                                        </SW-DATA-DEF-PROPS-CONDITIONAL>
                                    </SW-DATA-DEF-PROPS-VARIANTS>
                                </SW-DATA-DEF-PROPS>
                            </IMPLEMENTATION-DATA-TYPE-ELEMENT>
                            <IMPLEMENTATION-DATA-TYPE-ELEMENT>
                                <SHORT-NAME>DestAddress</SHORT-NAME>
                                <CATEGORY>TYPE_REFERENCE</CATEGORY>
                                <SW-DATA-DEF-PROPS>
                                    <SW-DATA-DEF-PROPS-VARIANTS>
                                        <SW-DATA-DEF-PROPS-CONDITIONAL>
                                            <IMPLEMENTATION-DATA-TYPE-REF DEST="IMPLEMENTATION-DATA-TYPE">/AUTOSAR_Platform/ImplementationDataTypes/uint32</IMPLEMENTATION-DATA-TYPE-REF>
                                        </SW-DATA-DEF-PROPS-CONDITIONAL>
                                    </SW-DATA-DEF-PROPS-VARIANTS>
                                </SW-DATA-DEF-PROPS>
                            </IMPLEMENTATION-DATA-TYPE-ELEMENT>
                            <IMPLEMENTATION-DATA-TYPE-ELEMENT>
                                <SHORT-NAME>UpdateAddressCrc</SHORT-NAME>
                                <CATEGORY>TYPE_REFERENCE</CATEGORY>
                                <SW-DATA-DEF-PROPS>
                                    <SW-DATA-DEF-PROPS-VARIANTS>
                                        <SW-DATA-DEF-PROPS-CONDITIONAL>
                                            <SW-BIT-REPRESENTATION>
                                                <NUMBER-OF-BITS>1</NUMBER-OF-BITS>
                                            </SW-BIT-REPRESENTATION>
                                            <IMPLEMENTATION-DATA-TYPE-REF DEST="IMPLEMENTATION-DATA-TYPE">/AURIX2G_McalLib/ImplementationDataTypes/unsigned_int</IMPLEMENTATION-DATA-TYPE-REF>
                                        </SW-DATA-DEF-PROPS-CONDITIONAL>
                                    </SW-DATA-DEF-PROPS-VARIANTS>
                                </SW-DATA-DEF-PROPS>
                            </IMPLEMENTATION-DATA-TYPE-ELEMENT>
                            <IMPLEMENTATION-DATA-TYPE-ELEMENT>
                                <SHORT-NAME>UpdateConfig</SHORT-NAME>
                                <CATEGORY>TYPE_REFERENCE</CATEGORY>
                                <SW-DATA-DEF-PROPS>
                                    <SW-DATA-DEF-PROPS-VARIANTS>
                                        <SW-DATA-DEF-PROPS-CONDITIONAL>
                                            <SW-BIT-REPRESENTATION>
                                                <NUMBER-OF-BITS>1</NUMBER-OF-BITS>
                                            </SW-BIT-REPRESENTATION>
                                            <IMPLEMENTATION-DATA-TYPE-REF DEST="IMPLEMENTATION-DATA-TYPE">/AURIX2G_McalLib/ImplementationDataTypes/unsigned_int</IMPLEMENTATION-DATA-TYPE-REF>
                                        </SW-DATA-DEF-PROPS-CONDITIONAL>
                                    </SW-DATA-DEF-PROPS-VARIANTS>
                                </SW-DATA-DEF-PROPS>
                            </IMPLEMENTATION-DATA-TYPE-ELEMENT>
                            <IMPLEMENTATION-DATA-TYPE-ELEMENT>
                                <SHORT-NAME>UpdateControlAdicr</SHORT-NAME>
                                <CATEGORY>TYPE_REFERENCE</CATEGORY>
                                <SW-DATA-DEF-PROPS>
                                    <SW-DATA-DEF-PROPS-VARIANTS>
                                        <SW-DATA-DEF-PROPS-CONDITIONAL>
                                            <SW-BIT-REPRESENTATION>
                                                <NUMBER-OF-BITS>1</NUMBER-OF-BITS>
                                            </SW-BIT-REPRESENTATION>
                                            <IMPLEMENTATION-DATA-TYPE-REF DEST="IMPLEMENTATION-DATA-TYPE">/AURIX2G_McalLib/ImplementationDataTypes/unsigned_int</IMPLEMENTATION-DATA-TYPE-REF>
                                        </SW-DATA-DEF-PROPS-CONDITIONAL>
                                    </SW-DATA-DEF-PROPS-VARIANTS>
                                </SW-DATA-DEF-PROPS>
                            </IMPLEMENTATION-DATA-TYPE-ELEMENT>
                            <IMPLEMENTATION-DATA-TYPE-ELEMENT>
                                <SHORT-NAME>UpdateDestAddress</SHORT-NAME>
                                <CATEGORY>TYPE_REFERENCE</CATEGORY>
                                <SW-DATA-DEF-PROPS>
                                    <SW-DATA-DEF-PROPS-VARIANTS>
                                        <SW-DATA-DEF-PROPS-CONDITIONAL>
                                            <SW-BIT-REPRESENTATION>
                                                <NUMBER-OF-BITS>1</NUMBER-OF-BITS>
                                            </SW-BIT-REPRESENTATION>
                                            <IMPLEMENTATION-DATA-TYPE-REF DEST="IMPLEMENTATION-DATA-TYPE">/AURIX2G_McalLib/ImplementationDataTypes/unsigned_int</IMPLEMENTATION-DATA-TYPE-REF>
                                        </SW-DATA-DEF-PROPS-CONDITIONAL>
                                    </SW-DATA-DEF-PROPS-VARIANTS>
                                </SW-DATA-DEF-PROPS>
                            </IMPLEMENTATION-DATA-TYPE-ELEMENT>
                            <IMPLEMENTATION-DATA-TYPE-ELEMENT>
                                <SHORT-NAME>UpdateShadowConfig</SHORT-NAME>
                                <CATEGORY>TYPE_REFERENCE</CATEGORY>
                                <SW-DATA-DEF-PROPS>
                                    <SW-DATA-DEF-PROPS-VARIANTS>
                                        <SW-DATA-DEF-PROPS-CONDITIONAL>
                                            <SW-BIT-REPRESENTATION>
                                                <NUMBER-OF-BITS>1</NUMBER-OF-BITS>
                                            </SW-BIT-REPRESENTATION>
                                            <IMPLEMENTATION-DATA-TYPE-REF DEST="IMPLEMENTATION-DATA-TYPE">/AURIX2G_McalLib/ImplementationDataTypes/unsigned_int</IMPLEMENTATION-DATA-TYPE-REF>
                                        </SW-DATA-DEF-PROPS-CONDITIONAL>
                                    </SW-DATA-DEF-PROPS-VARIANTS>
                                </SW-DATA-DEF-PROPS>
                            </IMPLEMENTATION-DATA-TYPE-ELEMENT>
                            <IMPLEMENTATION-DATA-TYPE-ELEMENT>
                                <SHORT-NAME>UpdateSourceAddress</SHORT-NAME>
                                <CATEGORY>TYPE_REFERENCE</CATEGORY>
                                <SW-DATA-DEF-PROPS>
                                    <SW-DATA-DEF-PROPS-VARIANTS>
                                        <SW-DATA-DEF-PROPS-CONDITIONAL>
                                            <SW-BIT-REPRESENTATION>
                                                <NUMBER-OF-BITS>1</NUMBER-OF-BITS>
                                            </SW-BIT-REPRESENTATION>
                                            <IMPLEMENTATION-DATA-TYPE-REF DEST="IMPLEMENTATION-DATA-TYPE">/AURIX2G_McalLib/ImplementationDataTypes/unsigned_int</IMPLEMENTATION-DATA-TYPE-REF>
                                        </SW-DATA-DEF-PROPS-CONDITIONAL>
                                    </SW-DATA-DEF-PROPS-VARIANTS>
                                </SW-DATA-DEF-PROPS>
                            </IMPLEMENTATION-DATA-TYPE-ELEMENT>
                            <IMPLEMENTATION-DATA-TYPE-ELEMENT>
                                <SHORT-NAME>ShadowConfig</SHORT-NAME>
                                <CATEGORY>TYPE_REFERENCE</CATEGORY>
                                <SW-DATA-DEF-PROPS>
                                    <SW-DATA-DEF-PROPS-VARIANTS>
                                        <SW-DATA-DEF-PROPS-CONDITIONAL>
                                            <IMPLEMENTATION-DATA-TYPE-REF DEST="IMPLEMENTATION-DATA-TYPE">/AUTOSAR_Platform/ImplementationDataTypes/uint32</IMPLEMENTATION-DATA-TYPE-REF>
                                        </SW-DATA-DEF-PROPS-CONDITIONAL>
                                    </SW-DATA-DEF-PROPS-VARIANTS>
                                </SW-DATA-DEF-PROPS>
                            </IMPLEMENTATION-DATA-TYPE-ELEMENT>
                            <IMPLEMENTATION-DATA-TYPE-ELEMENT>
                                <SHORT-NAME>SourceAddress</SHORT-NAME>
                                <CATEGORY>TYPE_REFERENCE</CATEGORY>
                                <SW-DATA-DEF-PROPS>
                                    <SW-DATA-DEF-PROPS-VARIANTS>
                                        <SW-DATA-DEF-PROPS-CONDITIONAL>
                                            <IMPLEMENTATION-DATA-TYPE-REF DEST="IMPLEMENTATION-DATA-TYPE">/AUTOSAR_Platform/ImplementationDataTypes/uint32</IMPLEMENTATION-DATA-TYPE-REF>
                                        </SW-DATA-DEF-PROPS-CONDITIONAL>
                                    </SW-DATA-DEF-PROPS-VARIANTS>
                                </SW-DATA-DEF-PROPS>
                            </IMPLEMENTATION-DATA-TYPE-ELEMENT>
                            <IMPLEMENTATION-DATA-TYPE-ELEMENT>
                                <SHORT-NAME>UpdateControlChcsr</SHORT-NAME>
                                <CATEGORY>TYPE_REFERENCE</CATEGORY>
                                <SW-DATA-DEF-PROPS>
                                    <SW-DATA-DEF-PROPS-VARIANTS>
                                        <SW-DATA-DEF-PROPS-CONDITIONAL>
                                            <SW-BIT-REPRESENTATION>
                                                <NUMBER-OF-BITS>1</NUMBER-OF-BITS>
                                            </SW-BIT-REPRESENTATION>
                                            <IMPLEMENTATION-DATA-TYPE-REF DEST="IMPLEMENTATION-DATA-TYPE">/AURIX2G_McalLib/ImplementationDataTypes/unsigned_int</IMPLEMENTATION-DATA-TYPE-REF>
                                        </SW-DATA-DEF-PROPS-CONDITIONAL>
                                    </SW-DATA-DEF-PROPS-VARIANTS>
                                </SW-DATA-DEF-PROPS>
                            </IMPLEMENTATION-DATA-TYPE-ELEMENT>
                        </SUB-ELEMENTS>
                    </IMPLEMENTATION-DATA-TYPE>
                    <IMPLEMENTATION-DATA-TYPE>
                        <SHORT-NAME>Dma_CrcType</SHORT-NAME>
                        <CATEGORY>TYPE_REFERENCE</CATEGORY>
                        <SW-DATA-DEF-PROPS>
                            <SW-DATA-DEF-PROPS-VARIANTS>
                                <SW-DATA-DEF-PROPS-CONDITIONAL>
                                    <COMPU-METHOD-REF DEST="COMPU-METHOD">/AURIX2G_Dma/CompuMethods/Dma_CrcType</COMPU-METHOD-REF>
                                    <IMPLEMENTATION-DATA-TYPE-REF DEST="IMPLEMENTATION-DATA-TYPE">/AUTOSAR_Platform/ImplementationDataTypes/uint32</IMPLEMENTATION-DATA-TYPE-REF>
                                    <SW-IMPL-POLICY>STANDARD</SW-IMPL-POLICY>
                                    <ADDITIONAL-NATIVE-TYPE-QUALIFIER>enum</ADDITIONAL-NATIVE-TYPE-QUALIFIER>
                                </SW-DATA-DEF-PROPS-CONDITIONAL>
                            </SW-DATA-DEF-PROPS-VARIANTS>
                        </SW-DATA-DEF-PROPS>
                        <TYPE-EMITTER>BSW</TYPE-EMITTER>
                    </IMPLEMENTATION-DATA-TYPE>
                    <IMPLEMENTATION-DATA-TYPE>
                        <SHORT-NAME>Dma_MoveEngineErrorNotificationPtrType</SHORT-NAME>
                        <CATEGORY>DATA_REFERENCE</CATEGORY>
                        <INTRODUCTION>
                            <NOTE SI="This data type is for a function pointer type pointing to the callback-notification function. The referred function should be implemented by user of the driver" NOTE-TYPE="HINT"/>
                        </INTRODUCTION>
                        <SW-DATA-DEF-PROPS>
                            <SW-DATA-DEF-PROPS-VARIANTS>
                                <SW-DATA-DEF-PROPS-CONDITIONAL>
                                    <SW-POINTER-TARGET-PROPS>
                                        <TARGET-CATEGORY>FUNCTION_REFERENCE</TARGET-CATEGORY>
                                        <FUNCTION-POINTER-SIGNATURE-REF DEST="BSW-MODULE-ENTRY">/AUTOSAR_Stub/BswModuleEntrys/Dma_MoveEngineErrorNotification</FUNCTION-POINTER-SIGNATURE-REF>
                                    </SW-POINTER-TARGET-PROPS>
                                </SW-DATA-DEF-PROPS-CONDITIONAL>
                            </SW-DATA-DEF-PROPS-VARIANTS>
                        </SW-DATA-DEF-PROPS>
                    </IMPLEMENTATION-DATA-TYPE>
                    <IMPLEMENTATION-DATA-TYPE>
                        <SHORT-NAME>Dma_MoveEngineEventType</SHORT-NAME>
                        <CATEGORY>TYPE_REFERENCE</CATEGORY>
                        <SW-DATA-DEF-PROPS>
                            <SW-DATA-DEF-PROPS-VARIANTS>
                                <SW-DATA-DEF-PROPS-CONDITIONAL>
                                    <COMPU-METHOD-REF DEST="COMPU-METHOD">/AURIX2G_Dma/CompuMethods/Dma_MoveEngineEventType</COMPU-METHOD-REF>
                                    <IMPLEMENTATION-DATA-TYPE-REF DEST="IMPLEMENTATION-DATA-TYPE">/AUTOSAR_Platform/ImplementationDataTypes/uint32</IMPLEMENTATION-DATA-TYPE-REF>
                                    <SW-IMPL-POLICY>STANDARD</SW-IMPL-POLICY>
                                    <ADDITIONAL-NATIVE-TYPE-QUALIFIER>enum</ADDITIONAL-NATIVE-TYPE-QUALIFIER>
                                </SW-DATA-DEF-PROPS-CONDITIONAL>
                            </SW-DATA-DEF-PROPS-VARIANTS>
                        </SW-DATA-DEF-PROPS>
                        <TYPE-EMITTER>BSW</TYPE-EMITTER>
                    </IMPLEMENTATION-DATA-TYPE>
                    <IMPLEMENTATION-DATA-TYPE>
                        <SHORT-NAME>Dma_MoveEngineListType</SHORT-NAME>
                        <CATEGORY>TYPE_REFERENCE</CATEGORY>
                        <SW-DATA-DEF-PROPS>
                            <SW-DATA-DEF-PROPS-VARIANTS>
                                <SW-DATA-DEF-PROPS-CONDITIONAL>
                                    <COMPU-METHOD-REF DEST="COMPU-METHOD">/AURIX2G_Dma/CompuMethods/Dma_MoveEngineListType</COMPU-METHOD-REF>
                                    <IMPLEMENTATION-DATA-TYPE-REF DEST="IMPLEMENTATION-DATA-TYPE">/AUTOSAR_Platform/ImplementationDataTypes/uint32</IMPLEMENTATION-DATA-TYPE-REF>
                                    <SW-IMPL-POLICY>STANDARD</SW-IMPL-POLICY>
                                    <ADDITIONAL-NATIVE-TYPE-QUALIFIER>enum</ADDITIONAL-NATIVE-TYPE-QUALIFIER>
                                </SW-DATA-DEF-PROPS-CONDITIONAL>
                            </SW-DATA-DEF-PROPS-VARIANTS>
                        </SW-DATA-DEF-PROPS>
                        <TYPE-EMITTER>BSW</TYPE-EMITTER>
                    </IMPLEMENTATION-DATA-TYPE>
                    <IMPLEMENTATION-DATA-TYPE>
                        <SHORT-NAME>Dma_ChannelMapType</SHORT-NAME>
                        <CATEGORY>STRUCTURE</CATEGORY>
                        <SUB-ELEMENTS>
                            <IMPLEMENTATION-DATA-TYPE-ELEMENT>
                                <SHORT-NAME>Dma_ChannelConfIndexMap</SHORT-NAME>
                                <CATEGORY>DATA_REFERENCE</CATEGORY>
                                <SW-DATA-DEF-PROPS>
                                    <SW-DATA-DEF-PROPS-VARIANTS>
                                        <SW-DATA-DEF-PROPS-CONDITIONAL>
                                            <SW-POINTER-TARGET-PROPS>
                                                <TARGET-CATEGORY>TYPE_REFERENCE</TARGET-CATEGORY>
                                                <SW-DATA-DEF-PROPS>
                                                    <SW-DATA-DEF-PROPS-VARIANTS>
                                                        <SW-DATA-DEF-PROPS-CONDITIONAL>
                                                            <IMPLEMENTATION-DATA-TYPE-REF DEST="IMPLEMENTATION-DATA-TYPE">/AUTOSAR_Platform/ImplementationDataTypes/uint8</IMPLEMENTATION-DATA-TYPE-REF>
                                                        </SW-DATA-DEF-PROPS-CONDITIONAL>
                                                    </SW-DATA-DEF-PROPS-VARIANTS>
                                                </SW-DATA-DEF-PROPS>
                                            </SW-POINTER-TARGET-PROPS>
                                        </SW-DATA-DEF-PROPS-CONDITIONAL>
                                    </SW-DATA-DEF-PROPS-VARIANTS>
                                </SW-DATA-DEF-PROPS>
                            </IMPLEMENTATION-DATA-TYPE-ELEMENT>
                            <IMPLEMENTATION-DATA-TYPE-ELEMENT>
                                <SHORT-NAME>Dma_ChannelCoreMap</SHORT-NAME>
                                <CATEGORY>DATA_REFERENCE</CATEGORY>
                                <SW-DATA-DEF-PROPS>
                                    <SW-DATA-DEF-PROPS-VARIANTS>
                                        <SW-DATA-DEF-PROPS-CONDITIONAL>
                                            <SW-POINTER-TARGET-PROPS>
                                                <TARGET-CATEGORY>TYPE_REFERENCE</TARGET-CATEGORY>
                                                <SW-DATA-DEF-PROPS>
                                                    <SW-DATA-DEF-PROPS-VARIANTS>
                                                        <SW-DATA-DEF-PROPS-CONDITIONAL>
                                                            <IMPLEMENTATION-DATA-TYPE-REF DEST="IMPLEMENTATION-DATA-TYPE">/AUTOSAR_Platform/ImplementationDataTypes/uint8</IMPLEMENTATION-DATA-TYPE-REF>
                                                        </SW-DATA-DEF-PROPS-CONDITIONAL>
                                                    </SW-DATA-DEF-PROPS-VARIANTS>
                                                </SW-DATA-DEF-PROPS>
                                            </SW-POINTER-TARGET-PROPS>
                                        </SW-DATA-DEF-PROPS-CONDITIONAL>
                                    </SW-DATA-DEF-PROPS-VARIANTS>
                                </SW-DATA-DEF-PROPS>
                            </IMPLEMENTATION-DATA-TYPE-ELEMENT>
                        </SUB-ELEMENTS>
                    </IMPLEMENTATION-DATA-TYPE>
                    <IMPLEMENTATION-DATA-TYPE>
                        <SHORT-NAME>Dma_CoreSpecificChConfigType</SHORT-NAME>
                        <CATEGORY>STRUCTURE</CATEGORY>
                        <SUB-ELEMENTS>
                            <IMPLEMENTATION-DATA-TYPE-ELEMENT>
                                <SHORT-NAME>DmaChConfigPtr</SHORT-NAME>
                                <CATEGORY>DATA_REFERENCE</CATEGORY>
                                <SW-DATA-DEF-PROPS>
                                    <SW-DATA-DEF-PROPS-VARIANTS>
                                        <SW-DATA-DEF-PROPS-CONDITIONAL>
                                            <SW-POINTER-TARGET-PROPS>
                                                <TARGET-CATEGORY>TYPE_REFERENCE</TARGET-CATEGORY>
                                                <SW-DATA-DEF-PROPS>
                                                    <SW-DATA-DEF-PROPS-VARIANTS>
                                                        <SW-DATA-DEF-PROPS-CONDITIONAL>
                                                            <IMPLEMENTATION-DATA-TYPE-REF DEST="IMPLEMENTATION-DATA-TYPE">/AURIX2G_Dma/ImplementationDataTypes/Dma_ChConfigType</IMPLEMENTATION-DATA-TYPE-REF>
                                                        </SW-DATA-DEF-PROPS-CONDITIONAL>
                                                    </SW-DATA-DEF-PROPS-VARIANTS>
                                                </SW-DATA-DEF-PROPS>
                                            </SW-POINTER-TARGET-PROPS>
                                        </SW-DATA-DEF-PROPS-CONDITIONAL>
                                    </SW-DATA-DEF-PROPS-VARIANTS>
                                </SW-DATA-DEF-PROPS>
                            </IMPLEMENTATION-DATA-TYPE-ELEMENT>
                            <IMPLEMENTATION-DATA-TYPE-ELEMENT>
                                <SHORT-NAME>DmaNumberofChConfiguredPerCore</SHORT-NAME>
                                <CATEGORY>TYPE_REFERENCE</CATEGORY>
                                <SW-DATA-DEF-PROPS>
                                    <SW-DATA-DEF-PROPS-VARIANTS>
                                        <SW-DATA-DEF-PROPS-CONDITIONAL>
                                            <IMPLEMENTATION-DATA-TYPE-REF DEST="IMPLEMENTATION-DATA-TYPE">/AUTOSAR_Platform/ImplementationDataTypes/uint8</IMPLEMENTATION-DATA-TYPE-REF>
                                        </SW-DATA-DEF-PROPS-CONDITIONAL>
                                    </SW-DATA-DEF-PROPS-VARIANTS>
                                </SW-DATA-DEF-PROPS>
                            </IMPLEMENTATION-DATA-TYPE-ELEMENT>
                        </SUB-ELEMENTS>
                    </IMPLEMENTATION-DATA-TYPE>
                    <IMPLEMENTATION-DATA-TYPE>
                        <SHORT-NAME>Dma_TransactionCtrlSetType</SHORT-NAME>
                        <CATEGORY>STRUCTURE</CATEGORY>
                        <SUB-ELEMENTS>
                            <IMPLEMENTATION-DATA-TYPE-ELEMENT>
                                <SHORT-NAME>DmaReadDataCrc</SHORT-NAME>
                                <CATEGORY>TYPE_REFERENCE</CATEGORY>
                                <SW-DATA-DEF-PROPS>
                                    <SW-DATA-DEF-PROPS-VARIANTS>
                                        <SW-DATA-DEF-PROPS-CONDITIONAL>
                                            <IMPLEMENTATION-DATA-TYPE-REF DEST="IMPLEMENTATION-DATA-TYPE">/AUTOSAR_Platform/ImplementationDataTypes/uint32</IMPLEMENTATION-DATA-TYPE-REF>
                                        </SW-DATA-DEF-PROPS-CONDITIONAL>
                                    </SW-DATA-DEF-PROPS-VARIANTS>
                                </SW-DATA-DEF-PROPS>
                            </IMPLEMENTATION-DATA-TYPE-ELEMENT>
                            <IMPLEMENTATION-DATA-TYPE-ELEMENT>
                                <SHORT-NAME>DmaSourceDestAddressCrc</SHORT-NAME>
                                <CATEGORY>TYPE_REFERENCE</CATEGORY>
                                <SW-DATA-DEF-PROPS>
                                    <SW-DATA-DEF-PROPS-VARIANTS>
                                        <SW-DATA-DEF-PROPS-CONDITIONAL>
                                            <IMPLEMENTATION-DATA-TYPE-REF DEST="IMPLEMENTATION-DATA-TYPE">/AUTOSAR_Platform/ImplementationDataTypes/uint32</IMPLEMENTATION-DATA-TYPE-REF>
                                        </SW-DATA-DEF-PROPS-CONDITIONAL>
                                    </SW-DATA-DEF-PROPS-VARIANTS>
                                </SW-DATA-DEF-PROPS>
                            </IMPLEMENTATION-DATA-TYPE-ELEMENT>
                            <IMPLEMENTATION-DATA-TYPE-ELEMENT>
                                <SHORT-NAME>DmaSourceAddress</SHORT-NAME>
                                <CATEGORY>DATA_REFERENCE</CATEGORY>
                                <SW-DATA-DEF-PROPS>
                                    <SW-DATA-DEF-PROPS-VARIANTS>
                                        <SW-DATA-DEF-PROPS-CONDITIONAL>
                                            <SW-POINTER-TARGET-PROPS>
                                                <TARGET-CATEGORY>TYPE_REFERENCE</TARGET-CATEGORY>
                                                <SW-DATA-DEF-PROPS>
                                                    <SW-DATA-DEF-PROPS-VARIANTS>
                                                        <SW-DATA-DEF-PROPS-CONDITIONAL>
                                                            <IMPLEMENTATION-DATA-TYPE-REF DEST="IMPLEMENTATION-DATA-TYPE">/AUTOSAR_Platform/ImplementationDataTypes/uint32</IMPLEMENTATION-DATA-TYPE-REF>
                                                        </SW-DATA-DEF-PROPS-CONDITIONAL>
                                                    </SW-DATA-DEF-PROPS-VARIANTS>
                                                </SW-DATA-DEF-PROPS>
                                            </SW-POINTER-TARGET-PROPS>
                                        </SW-DATA-DEF-PROPS-CONDITIONAL>
                                    </SW-DATA-DEF-PROPS-VARIANTS>
                                </SW-DATA-DEF-PROPS>
                            </IMPLEMENTATION-DATA-TYPE-ELEMENT>
                            <IMPLEMENTATION-DATA-TYPE-ELEMENT>
                                <SHORT-NAME>DmaDestinationAddress</SHORT-NAME>
                                <CATEGORY>DATA_REFERENCE</CATEGORY>
                                <SW-DATA-DEF-PROPS>
                                    <SW-DATA-DEF-PROPS-VARIANTS>
                                        <SW-DATA-DEF-PROPS-CONDITIONAL>
                                            <SW-POINTER-TARGET-PROPS>
                                                <TARGET-CATEGORY>TYPE_REFERENCE</TARGET-CATEGORY>
                                                <SW-DATA-DEF-PROPS>
                                                    <SW-DATA-DEF-PROPS-VARIANTS>
                                                        <SW-DATA-DEF-PROPS-CONDITIONAL>
                                                            <IMPLEMENTATION-DATA-TYPE-REF DEST="IMPLEMENTATION-DATA-TYPE">/AUTOSAR_Platform/ImplementationDataTypes/uint32</IMPLEMENTATION-DATA-TYPE-REF>
                                                        </SW-DATA-DEF-PROPS-CONDITIONAL>
                                                    </SW-DATA-DEF-PROPS-VARIANTS>
                                                </SW-DATA-DEF-PROPS>
                                            </SW-POINTER-TARGET-PROPS>
                                        </SW-DATA-DEF-PROPS-CONDITIONAL>
                                    </SW-DATA-DEF-PROPS-VARIANTS>
                                </SW-DATA-DEF-PROPS>
                            </IMPLEMENTATION-DATA-TYPE-ELEMENT>
                            <IMPLEMENTATION-DATA-TYPE-ELEMENT>
                                <SHORT-NAME>DmaAddressInterruptControl</SHORT-NAME>
                                <CATEGORY>TYPE_REFERENCE</CATEGORY>
                                <SW-DATA-DEF-PROPS>
                                    <SW-DATA-DEF-PROPS-VARIANTS>
                                        <SW-DATA-DEF-PROPS-CONDITIONAL>
                                            <IMPLEMENTATION-DATA-TYPE-REF DEST="IMPLEMENTATION-DATA-TYPE">/AUTOSAR_Platform/ImplementationDataTypes/uint32</IMPLEMENTATION-DATA-TYPE-REF>
                                        </SW-DATA-DEF-PROPS-CONDITIONAL>
                                    </SW-DATA-DEF-PROPS-VARIANTS>
                                </SW-DATA-DEF-PROPS>
                            </IMPLEMENTATION-DATA-TYPE-ELEMENT>
                            <IMPLEMENTATION-DATA-TYPE-ELEMENT>
                                <SHORT-NAME>DmaChannelConfig</SHORT-NAME>
                                <CATEGORY>TYPE_REFERENCE</CATEGORY>
                                <SW-DATA-DEF-PROPS>
                                    <SW-DATA-DEF-PROPS-VARIANTS>
                                        <SW-DATA-DEF-PROPS-CONDITIONAL>
                                            <IMPLEMENTATION-DATA-TYPE-REF DEST="IMPLEMENTATION-DATA-TYPE">/AUTOSAR_Platform/ImplementationDataTypes/uint32</IMPLEMENTATION-DATA-TYPE-REF>
                                        </SW-DATA-DEF-PROPS-CONDITIONAL>
                                    </SW-DATA-DEF-PROPS-VARIANTS>
                                </SW-DATA-DEF-PROPS>
                            </IMPLEMENTATION-DATA-TYPE-ELEMENT>
                            <IMPLEMENTATION-DATA-TYPE-ELEMENT>
                                <SHORT-NAME>DmaShadowAddress</SHORT-NAME>
                                <CATEGORY>DATA_REFERENCE</CATEGORY>
                                <SW-DATA-DEF-PROPS>
                                    <SW-DATA-DEF-PROPS-VARIANTS>
                                        <SW-DATA-DEF-PROPS-CONDITIONAL>
                                            <SW-POINTER-TARGET-PROPS>
                                                <TARGET-CATEGORY>TYPE_REFERENCE</TARGET-CATEGORY>
                                                <SW-DATA-DEF-PROPS>
                                                    <SW-DATA-DEF-PROPS-VARIANTS>
                                                        <SW-DATA-DEF-PROPS-CONDITIONAL>
                                                            <IMPLEMENTATION-DATA-TYPE-REF DEST="IMPLEMENTATION-DATA-TYPE">/AURIX2G_Dma/ImplementationDataTypes/Dma_TransactionCtrlSetType</IMPLEMENTATION-DATA-TYPE-REF>
                                                        </SW-DATA-DEF-PROPS-CONDITIONAL>
                                                    </SW-DATA-DEF-PROPS-VARIANTS>
                                                </SW-DATA-DEF-PROPS>
                                            </SW-POINTER-TARGET-PROPS>
                                        </SW-DATA-DEF-PROPS-CONDITIONAL>
                                    </SW-DATA-DEF-PROPS-VARIANTS>
                                </SW-DATA-DEF-PROPS>
                            </IMPLEMENTATION-DATA-TYPE-ELEMENT>
                            <IMPLEMENTATION-DATA-TYPE-ELEMENT>
                                <SHORT-NAME>DmaChControlStatus</SHORT-NAME>
                                <CATEGORY>TYPE_REFERENCE</CATEGORY>
                                <SW-DATA-DEF-PROPS>
                                    <SW-DATA-DEF-PROPS-VARIANTS>
                                        <SW-DATA-DEF-PROPS-CONDITIONAL>
                                            <IMPLEMENTATION-DATA-TYPE-REF DEST="IMPLEMENTATION-DATA-TYPE">/AUTOSAR_Platform/ImplementationDataTypes/uint32</IMPLEMENTATION-DATA-TYPE-REF>
                                        </SW-DATA-DEF-PROPS-CONDITIONAL>
                                    </SW-DATA-DEF-PROPS-VARIANTS>
                                </SW-DATA-DEF-PROPS>
                            </IMPLEMENTATION-DATA-TYPE-ELEMENT>
                        </SUB-ELEMENTS>
                    </IMPLEMENTATION-DATA-TYPE>
                    <IMPLEMENTATION-DATA-TYPE>
                        <SHORT-NAME>Dma_ChConfigType</SHORT-NAME>
                        <CATEGORY>STRUCTURE</CATEGORY>
                        <SUB-ELEMENTS>
                            <IMPLEMENTATION-DATA-TYPE-ELEMENT>
                                <SHORT-NAME>DmaChTCSPtr</SHORT-NAME>
                                <CATEGORY>DATA_REFERENCE</CATEGORY>
                                <SW-DATA-DEF-PROPS>
                                    <SW-DATA-DEF-PROPS-VARIANTS>
                                        <SW-DATA-DEF-PROPS-CONDITIONAL>
                                            <SW-POINTER-TARGET-PROPS>
                                                <TARGET-CATEGORY>TYPE_REFERENCE</TARGET-CATEGORY>
                                                <SW-DATA-DEF-PROPS>
                                                    <SW-DATA-DEF-PROPS-VARIANTS>
                                                        <SW-DATA-DEF-PROPS-CONDITIONAL>
                                                            <IMPLEMENTATION-DATA-TYPE-REF DEST="IMPLEMENTATION-DATA-TYPE">/AURIX2G_Dma/ImplementationDataTypes/Dma_TransactionCtrlSetType</IMPLEMENTATION-DATA-TYPE-REF>
                                                        </SW-DATA-DEF-PROPS-CONDITIONAL>
                                                    </SW-DATA-DEF-PROPS-VARIANTS>
                                                </SW-DATA-DEF-PROPS>
                                            </SW-POINTER-TARGET-PROPS>
                                        </SW-DATA-DEF-PROPS-CONDITIONAL>
                                    </SW-DATA-DEF-PROPS-VARIANTS>
                                </SW-DATA-DEF-PROPS>
                            </IMPLEMENTATION-DATA-TYPE-ELEMENT>
                            <IMPLEMENTATION-DATA-TYPE-ELEMENT>
                                <SHORT-NAME>DmaChNotifPtr</SHORT-NAME>
                                <CATEGORY>TYPE_REFERENCE</CATEGORY>
                                <SW-DATA-DEF-PROPS>
                                    <SW-DATA-DEF-PROPS-VARIANTS>
                                        <SW-DATA-DEF-PROPS-CONDITIONAL>
                                            <IMPLEMENTATION-DATA-TYPE-REF DEST="IMPLEMENTATION-DATA-TYPE">/AURIX2G_Dma/ImplementationDataTypes/Dma_ChannelNotificationFnPtrType</IMPLEMENTATION-DATA-TYPE-REF>
                                        </SW-DATA-DEF-PROPS-CONDITIONAL>
                                    </SW-DATA-DEF-PROPS-VARIANTS>
                                </SW-DATA-DEF-PROPS>
                            </IMPLEMENTATION-DATA-TYPE-ELEMENT>
                            <IMPLEMENTATION-DATA-TYPE-ELEMENT>
                                <SHORT-NAME>DmaTsrConfig</SHORT-NAME>
                                <CATEGORY>TYPE_REFERENCE</CATEGORY>
                                <SW-DATA-DEF-PROPS>
                                    <SW-DATA-DEF-PROPS-VARIANTS>
                                        <SW-DATA-DEF-PROPS-CONDITIONAL>
                                            <IMPLEMENTATION-DATA-TYPE-REF DEST="IMPLEMENTATION-DATA-TYPE">/AUTOSAR_Platform/ImplementationDataTypes/uint32</IMPLEMENTATION-DATA-TYPE-REF>
                                        </SW-DATA-DEF-PROPS-CONDITIONAL>
                                    </SW-DATA-DEF-PROPS-VARIANTS>
                                </SW-DATA-DEF-PROPS>
                            </IMPLEMENTATION-DATA-TYPE-ELEMENT>
                            <IMPLEMENTATION-DATA-TYPE-ELEMENT>
                                <SHORT-NAME>DmaChNumber</SHORT-NAME>
                                <CATEGORY>TYPE_REFERENCE</CATEGORY>
                                <SW-DATA-DEF-PROPS>
                                    <SW-DATA-DEF-PROPS-VARIANTS>
                                        <SW-DATA-DEF-PROPS-CONDITIONAL>
                                            <IMPLEMENTATION-DATA-TYPE-REF DEST="IMPLEMENTATION-DATA-TYPE">/AUTOSAR_Platform/ImplementationDataTypes/uint8</IMPLEMENTATION-DATA-TYPE-REF>
                                        </SW-DATA-DEF-PROPS-CONDITIONAL>
                                    </SW-DATA-DEF-PROPS-VARIANTS>
                                </SW-DATA-DEF-PROPS>
                            </IMPLEMENTATION-DATA-TYPE-ELEMENT>
                            <IMPLEMENTATION-DATA-TYPE-ELEMENT>
                                <SHORT-NAME>DmaChHwPartitionConfig</SHORT-NAME>
                                <CATEGORY>TYPE_REFERENCE</CATEGORY>
                                <SW-DATA-DEF-PROPS>
                                    <SW-DATA-DEF-PROPS-VARIANTS>
                                        <SW-DATA-DEF-PROPS-CONDITIONAL>
                                            <IMPLEMENTATION-DATA-TYPE-REF DEST="IMPLEMENTATION-DATA-TYPE">/AUTOSAR_Platform/ImplementationDataTypes/uint8</IMPLEMENTATION-DATA-TYPE-REF>
                                        </SW-DATA-DEF-PROPS-CONDITIONAL>
                                    </SW-DATA-DEF-PROPS-VARIANTS>
                                </SW-DATA-DEF-PROPS>
                            </IMPLEMENTATION-DATA-TYPE-ELEMENT>
                            <IMPLEMENTATION-DATA-TYPE-ELEMENT>
                                <SHORT-NAME>DmaMEErrorNotifPtr</SHORT-NAME>
                                <CATEGORY>TYPE_REFERENCE</CATEGORY>
                                <SW-DATA-DEF-PROPS>
                                    <SW-DATA-DEF-PROPS-VARIANTS>
                                        <SW-DATA-DEF-PROPS-CONDITIONAL>
                                            <IMPLEMENTATION-DATA-TYPE-REF DEST="IMPLEMENTATION-DATA-TYPE">/AURIX2G_Dma/ImplementationDataTypes/Dma_MoveEngineErrorNotificationPtrType</IMPLEMENTATION-DATA-TYPE-REF>
                                        </SW-DATA-DEF-PROPS-CONDITIONAL>
                                    </SW-DATA-DEF-PROPS-VARIANTS>
                                </SW-DATA-DEF-PROPS>
                            </IMPLEMENTATION-DATA-TYPE-ELEMENT>
                        </SUB-ELEMENTS>
                    </IMPLEMENTATION-DATA-TYPE>
                    <IMPLEMENTATION-DATA-TYPE>
                        <SHORT-NAME>Dma_ResourcePartitionConfigType</SHORT-NAME>
                        <CATEGORY>STRUCTURE</CATEGORY>
                        <SUB-ELEMENTS>
                            <IMPLEMENTATION-DATA-TYPE-ELEMENT>
                                <SHORT-NAME>DmaHwResourceBusMasterAccess</SHORT-NAME>
                                <CATEGORY>TYPE_REFERENCE</CATEGORY>
                                <ARRAY-SIZE>4</ARRAY-SIZE>
                                <ARRAY-SIZE-SEMANTICS>FIXED-SIZE</ARRAY-SIZE-SEMANTICS>
                                <SW-DATA-DEF-PROPS>
                                    <SW-DATA-DEF-PROPS-VARIANTS>
                                        <SW-DATA-DEF-PROPS-CONDITIONAL>
                                            <IMPLEMENTATION-DATA-TYPE-REF DEST="IMPLEMENTATION-DATA-TYPE">/AUTOSAR_Platform/ImplementationDataTypes/uint32</IMPLEMENTATION-DATA-TYPE-REF>
                                        </SW-DATA-DEF-PROPS-CONDITIONAL>
                                    </SW-DATA-DEF-PROPS-VARIANTS>
                                </SW-DATA-DEF-PROPS>
                            </IMPLEMENTATION-DATA-TYPE-ELEMENT>
                            <IMPLEMENTATION-DATA-TYPE-ELEMENT>
                                <SHORT-NAME>DmaHwResourceMode</SHORT-NAME>
                                <CATEGORY>TYPE_REFERENCE</CATEGORY>
                                <ARRAY-SIZE>4</ARRAY-SIZE>
                                <ARRAY-SIZE-SEMANTICS>FIXED-SIZE</ARRAY-SIZE-SEMANTICS>
                                <SW-DATA-DEF-PROPS>
                                    <SW-DATA-DEF-PROPS-VARIANTS>
                                        <SW-DATA-DEF-PROPS-CONDITIONAL>
                                            <IMPLEMENTATION-DATA-TYPE-REF DEST="IMPLEMENTATION-DATA-TYPE">/AUTOSAR_Platform/ImplementationDataTypes/uint8</IMPLEMENTATION-DATA-TYPE-REF>
                                        </SW-DATA-DEF-PROPS-CONDITIONAL>
                                    </SW-DATA-DEF-PROPS-VARIANTS>
                                </SW-DATA-DEF-PROPS>
                            </IMPLEMENTATION-DATA-TYPE-ELEMENT>
                        </SUB-ELEMENTS>
                    </IMPLEMENTATION-DATA-TYPE>
                    <IMPLEMENTATION-DATA-TYPE>
                        <SHORT-NAME>Dma_ConfigType</SHORT-NAME>
                        <CATEGORY>STRUCTURE</CATEGORY>
                        <SUB-ELEMENTS>
                            <IMPLEMENTATION-DATA-TYPE-ELEMENT>
                                <SHORT-NAME>DmaCoreConfigPtr</SHORT-NAME>
                                <CATEGORY>DATA_REFERENCE</CATEGORY>
                                <ARRAY-SIZE>[!"$NoOfCores"!]</ARRAY-SIZE>
                                <ARRAY-SIZE-SEMANTICS>FIXED-SIZE</ARRAY-SIZE-SEMANTICS>
                                <SW-DATA-DEF-PROPS>
                                    <SW-DATA-DEF-PROPS-VARIANTS>
                                        <SW-DATA-DEF-PROPS-CONDITIONAL>
                                            <SW-POINTER-TARGET-PROPS>
                                                <TARGET-CATEGORY>TYPE_REFERENCE</TARGET-CATEGORY>
                                                <SW-DATA-DEF-PROPS>
                                                    <SW-DATA-DEF-PROPS-VARIANTS>
                                                        <SW-DATA-DEF-PROPS-CONDITIONAL>
                                                            <IMPLEMENTATION-DATA-TYPE-REF DEST="IMPLEMENTATION-DATA-TYPE">/AURIX2G_Dma/ImplementationDataTypes/Dma_CoreSpecificChConfigType</IMPLEMENTATION-DATA-TYPE-REF>
                                                        </SW-DATA-DEF-PROPS-CONDITIONAL>
                                                    </SW-DATA-DEF-PROPS-VARIANTS>
                                                </SW-DATA-DEF-PROPS>
                                            </SW-POINTER-TARGET-PROPS>
                                        </SW-DATA-DEF-PROPS-CONDITIONAL>
                                    </SW-DATA-DEF-PROPS-VARIANTS>
                                </SW-DATA-DEF-PROPS>
                            </IMPLEMENTATION-DATA-TYPE-ELEMENT>
                            <IMPLEMENTATION-DATA-TYPE-ELEMENT>
                                <SHORT-NAME>DmaMovEngErr</SHORT-NAME>
                                <CATEGORY>TYPE_REFERENCE</CATEGORY>
                                <ARRAY-SIZE>2</ARRAY-SIZE>
                                <ARRAY-SIZE-SEMANTICS>FIXED-SIZE</ARRAY-SIZE-SEMANTICS>
                                <SW-DATA-DEF-PROPS>
                                    <SW-DATA-DEF-PROPS-VARIANTS>
                                        <SW-DATA-DEF-PROPS-CONDITIONAL>
                                            <IMPLEMENTATION-DATA-TYPE-REF DEST="IMPLEMENTATION-DATA-TYPE">/AUTOSAR_Platform/ImplementationDataTypes/uint32</IMPLEMENTATION-DATA-TYPE-REF>
                                        </SW-DATA-DEF-PROPS-CONDITIONAL>
                                    </SW-DATA-DEF-PROPS-VARIANTS>
                                </SW-DATA-DEF-PROPS>
                            </IMPLEMENTATION-DATA-TYPE-ELEMENT>
                            <IMPLEMENTATION-DATA-TYPE-ELEMENT>
                                <SHORT-NAME>DmaHwResourcePartition</SHORT-NAME>
                                <CATEGORY>TYPE_REFERENCE</CATEGORY>
                                <SW-DATA-DEF-PROPS>
                                    <SW-DATA-DEF-PROPS-VARIANTS>
                                        <SW-DATA-DEF-PROPS-CONDITIONAL>
                                            <IMPLEMENTATION-DATA-TYPE-REF DEST="IMPLEMENTATION-DATA-TYPE">/AURIX2G_Dma/ImplementationDataTypes/Dma_ResourcePartitionConfigType</IMPLEMENTATION-DATA-TYPE-REF>
                                        </SW-DATA-DEF-PROPS-CONDITIONAL>
                                    </SW-DATA-DEF-PROPS-VARIANTS>
                                </SW-DATA-DEF-PROPS>
                            </IMPLEMENTATION-DATA-TYPE-ELEMENT>
                            <IMPLEMENTATION-DATA-TYPE-ELEMENT>
                                <SHORT-NAME>Dma_ChannelMaps</SHORT-NAME>
                                <CATEGORY>TYPE_REFERENCE</CATEGORY>
                                <ARRAY-SIZE>[!"$NoOfDmaChannels"!]</ARRAY-SIZE>
                                <ARRAY-SIZE-SEMANTICS>FIXED-SIZE</ARRAY-SIZE-SEMANTICS>
                                <SW-DATA-DEF-PROPS>
                                    <SW-DATA-DEF-PROPS-VARIANTS>
                                        <SW-DATA-DEF-PROPS-CONDITIONAL>
                                            <IMPLEMENTATION-DATA-TYPE-REF DEST="IMPLEMENTATION-DATA-TYPE">/AURIX2G_Dma/ImplementationDataTypes/Dma_ChannelMapType</IMPLEMENTATION-DATA-TYPE-REF>
                                        </SW-DATA-DEF-PROPS-CONDITIONAL>
                                    </SW-DATA-DEF-PROPS-VARIANTS>
                                </SW-DATA-DEF-PROPS>
                            </IMPLEMENTATION-DATA-TYPE-ELEMENT>
                            <IMPLEMENTATION-DATA-TYPE-ELEMENT>
                                <SHORT-NAME>DmaTotalChConfigured</SHORT-NAME>
                                <CATEGORY>TYPE_REFERENCE</CATEGORY>
                                <SW-DATA-DEF-PROPS>
                                    <SW-DATA-DEF-PROPS-VARIANTS>
                                        <SW-DATA-DEF-PROPS-CONDITIONAL>
                                            <IMPLEMENTATION-DATA-TYPE-REF DEST="IMPLEMENTATION-DATA-TYPE">/AUTOSAR_Platform/ImplementationDataTypes/uint8</IMPLEMENTATION-DATA-TYPE-REF>
                                        </SW-DATA-DEF-PROPS-CONDITIONAL>
                                    </SW-DATA-DEF-PROPS-VARIANTS>
                                </SW-DATA-DEF-PROPS>
                            </IMPLEMENTATION-DATA-TYPE-ELEMENT>
                        </SUB-ELEMENTS>
                    </IMPLEMENTATION-DATA-TYPE>
                </ELEMENTS>
            </AR-PACKAGE>
            <AR-PACKAGE>
                <SHORT-NAME>CompuMethods</SHORT-NAME>
                <CATEGORY>STANDARD</CATEGORY>
                <ELEMENTS>
                    <COMPU-METHOD>
                        <SHORT-NAME>Dma_ChEventType</SHORT-NAME>
                        <CATEGORY>TEXTTABLE</CATEGORY>
                        <COMPU-INTERNAL-TO-PHYS>
                            <COMPU-SCALES>
                                <COMPU-SCALE>
                                    <LOWER-LIMIT INTERVAL-TYPE="CLOSED">0</LOWER-LIMIT>
                                    <UPPER-LIMIT INTERVAL-TYPE="CLOSED">0</UPPER-LIMIT>
                                    <COMPU-CONST>
                                        <VT>DMA_CHEVENT_NONE</VT>
                                    </COMPU-CONST>
                                </COMPU-SCALE>
                                <COMPU-SCALE>
                                    <LOWER-LIMIT INTERVAL-TYPE="CLOSED">1</LOWER-LIMIT>
                                    <UPPER-LIMIT INTERVAL-TYPE="CLOSED">1</UPPER-LIMIT>
                                    <COMPU-CONST>
                                        <VT>DMA_CHEVENT_TRANSFER_COMPLETE</VT>
                                    </COMPU-CONST>
                                </COMPU-SCALE>
                                <COMPU-SCALE>
                                    <LOWER-LIMIT INTERVAL-TYPE="CLOSED">2</LOWER-LIMIT>
                                    <UPPER-LIMIT INTERVAL-TYPE="CLOSED">2</UPPER-LIMIT>
                                    <COMPU-CONST>
                                        <VT>DMA_CHEVENT_BUFFER_WRAP_SOURCE</VT>
                                    </COMPU-CONST>
                                </COMPU-SCALE>
                                <COMPU-SCALE>
                                    <LOWER-LIMIT INTERVAL-TYPE="CLOSED">4</LOWER-LIMIT>
                                    <UPPER-LIMIT INTERVAL-TYPE="CLOSED">4</UPPER-LIMIT>
                                    <COMPU-CONST>
                                        <VT>DMA_CHEVENT_BUFFER_WRAP_DEST</VT>
                                    </COMPU-CONST>
                                </COMPU-SCALE>
                                <COMPU-SCALE>
                                    <LOWER-LIMIT INTERVAL-TYPE="CLOSED">8</LOWER-LIMIT>
                                    <UPPER-LIMIT INTERVAL-TYPE="CLOSED">8</UPPER-LIMIT>
                                    <COMPU-CONST>
                                        <VT>DMA_CHEVENT_UNKNOWN_EVENT</VT>
                                    </COMPU-CONST>
                                </COMPU-SCALE>
                            </COMPU-SCALES>
                        </COMPU-INTERNAL-TO-PHYS>
                    </COMPU-METHOD>
                    <COMPU-METHOD>
                        <SHORT-NAME>Dma_CrcType</SHORT-NAME>
                        <CATEGORY>TEXTTABLE</CATEGORY>
                        <COMPU-INTERNAL-TO-PHYS>
                            <COMPU-SCALES>
                                <COMPU-SCALE>
                                    <LOWER-LIMIT INTERVAL-TYPE="CLOSED">0</LOWER-LIMIT>
                                    <UPPER-LIMIT INTERVAL-TYPE="CLOSED">0</UPPER-LIMIT>
                                    <COMPU-CONST>
                                        <VT>DMA_NO_CRC_TYPE</VT>
                                    </COMPU-CONST>
                                </COMPU-SCALE>
                                <COMPU-SCALE>
                                    <LOWER-LIMIT INTERVAL-TYPE="CLOSED">1</LOWER-LIMIT>
                                    <UPPER-LIMIT INTERVAL-TYPE="CLOSED">1</UPPER-LIMIT>
                                    <COMPU-CONST>
                                        <VT>DMA_DATA_CRC_TYPE</VT>
                                    </COMPU-CONST>
                                </COMPU-SCALE>
                                <COMPU-SCALE>
                                    <LOWER-LIMIT INTERVAL-TYPE="CLOSED">2</LOWER-LIMIT>
                                    <UPPER-LIMIT INTERVAL-TYPE="CLOSED">2</UPPER-LIMIT>
                                    <COMPU-CONST>
                                        <VT>DMA_ADDRESS_CRC_TYPE</VT>
                                    </COMPU-CONST>
                                </COMPU-SCALE>
                            </COMPU-SCALES>
                        </COMPU-INTERNAL-TO-PHYS>
                    </COMPU-METHOD>
                    <COMPU-METHOD>
                        <SHORT-NAME>Dma_MoveEngineEventType</SHORT-NAME>
                        <CATEGORY>TEXTTABLE</CATEGORY>
                        <COMPU-INTERNAL-TO-PHYS>
                            <COMPU-SCALES>
                                <COMPU-SCALE>
                                    <LOWER-LIMIT INTERVAL-TYPE="CLOSED">0</LOWER-LIMIT>
                                    <UPPER-LIMIT INTERVAL-TYPE="CLOSED">0</UPPER-LIMIT>
                                    <COMPU-CONST>
                                        <VT>DMA_MOVE_ENGINE_EVENT_NONE</VT>
                                    </COMPU-CONST>
                                </COMPU-SCALE>
                                <COMPU-SCALE>
                                    <LOWER-LIMIT INTERVAL-TYPE="CLOSED">1</LOWER-LIMIT>
                                    <UPPER-LIMIT INTERVAL-TYPE="CLOSED">1</UPPER-LIMIT>
                                    <COMPU-CONST>
                                        <VT>DMA_MOVE_ENGINE_SOURCE_ERROR</VT>
                                    </COMPU-CONST>
                                </COMPU-SCALE>
                                <COMPU-SCALE>
                                    <LOWER-LIMIT INTERVAL-TYPE="CLOSED">2</LOWER-LIMIT>
                                    <UPPER-LIMIT INTERVAL-TYPE="CLOSED">2</UPPER-LIMIT>
                                    <COMPU-CONST>
                                        <VT>DMA_MOVE_ENGINE_DESTINATION_ERROR</VT>
                                    </COMPU-CONST>
                                </COMPU-SCALE>
                                <COMPU-SCALE>
                                    <LOWER-LIMIT INTERVAL-TYPE="CLOSED">4</LOWER-LIMIT>
                                    <UPPER-LIMIT INTERVAL-TYPE="CLOSED">4</UPPER-LIMIT>
                                    <COMPU-CONST>
                                        <VT>DMA_MOVE_ENGINE_SPB_ERROR</VT>
                                    </COMPU-CONST>
                                </COMPU-SCALE>
                                <COMPU-SCALE>
                                    <LOWER-LIMIT INTERVAL-TYPE="CLOSED">8</LOWER-LIMIT>
                                    <UPPER-LIMIT INTERVAL-TYPE="CLOSED">8</UPPER-LIMIT>
                                    <COMPU-CONST>
                                        <VT>DMA_MOVE_ENGINE_SRI_ERROR</VT>
                                    </COMPU-CONST>
                                </COMPU-SCALE>
                                <COMPU-SCALE>
                                    <LOWER-LIMIT INTERVAL-TYPE="CLOSED">16</LOWER-LIMIT>
                                    <UPPER-LIMIT INTERVAL-TYPE="CLOSED">16</UPPER-LIMIT>
                                    <COMPU-CONST>
                                        <VT>DMA_MOVE_ENGINE_RAM_ERROR</VT>
                                    </COMPU-CONST>
                                </COMPU-SCALE>
                                <COMPU-SCALE>
                                    <LOWER-LIMIT INTERVAL-TYPE="CLOSED">32</LOWER-LIMIT>
                                    <UPPER-LIMIT INTERVAL-TYPE="CLOSED">32</UPPER-LIMIT>
                                    <COMPU-CONST>
                                        <VT>DMA_MOVE_ENGINE_SAFE_LINKEDLIST_ERROR</VT>
                                    </COMPU-CONST>
                                </COMPU-SCALE>
                                <COMPU-SCALE>
                                    <LOWER-LIMIT INTERVAL-TYPE="CLOSED">64</LOWER-LIMIT>
                                    <UPPER-LIMIT INTERVAL-TYPE="CLOSED">64</UPPER-LIMIT>
                                    <COMPU-CONST>
                                        <VT>DMA_MOVE_ENGINE_DMA_LINKEDLIST_ERROR</VT>
                                    </COMPU-CONST>
                                </COMPU-SCALE>
                                <COMPU-SCALE>
                                    <LOWER-LIMIT INTERVAL-TYPE="CLOSED">128</LOWER-LIMIT>
                                    <UPPER-LIMIT INTERVAL-TYPE="CLOSED">128</UPPER-LIMIT>
                                    <COMPU-CONST>
                                        <VT>DMA_CHANNEL_TRL_ERROR</VT>
                                    </COMPU-CONST>
                                </COMPU-SCALE>
                            </COMPU-SCALES>
                        </COMPU-INTERNAL-TO-PHYS>
                    </COMPU-METHOD>
                    <COMPU-METHOD>
                        <SHORT-NAME>Dma_MoveEngineListType</SHORT-NAME>
                        <CATEGORY>TEXTTABLE</CATEGORY>
                        <COMPU-INTERNAL-TO-PHYS>
                            <COMPU-SCALES>
                                <COMPU-SCALE>
                                    <LOWER-LIMIT INTERVAL-TYPE="CLOSED">0</LOWER-LIMIT>
                                    <UPPER-LIMIT INTERVAL-TYPE="CLOSED">0</UPPER-LIMIT>
                                    <COMPU-CONST>
                                        <VT>DMA_ME_NONE</VT>
                                    </COMPU-CONST>
                                </COMPU-SCALE>
                                <COMPU-SCALE>
                                    <LOWER-LIMIT INTERVAL-TYPE="CLOSED">1</LOWER-LIMIT>
                                    <UPPER-LIMIT INTERVAL-TYPE="CLOSED">1</UPPER-LIMIT>
                                    <COMPU-CONST>
                                        <VT>DMA_ME_0</VT>
                                    </COMPU-CONST>
                                </COMPU-SCALE>
                                <COMPU-SCALE>
                                    <LOWER-LIMIT INTERVAL-TYPE="CLOSED">2</LOWER-LIMIT>
                                    <UPPER-LIMIT INTERVAL-TYPE="CLOSED">2</UPPER-LIMIT>
                                    <COMPU-CONST>
                                        <VT>DMA_ME_1</VT>
                                    </COMPU-CONST>
                                </COMPU-SCALE>
                                <COMPU-SCALE>
                                    <LOWER-LIMIT INTERVAL-TYPE="CLOSED">4</LOWER-LIMIT>
                                    <UPPER-LIMIT INTERVAL-TYPE="CLOSED">4</UPPER-LIMIT>
                                    <COMPU-CONST>
                                        <VT>DMA_ME_ALL</VT>
                                    </COMPU-CONST>
                                </COMPU-SCALE>
                            </COMPU-SCALES>
                        </COMPU-INTERNAL-TO-PHYS>
                    </COMPU-METHOD>
                </ELEMENTS>
            </AR-PACKAGE>
        </AR-PACKAGES>
    </AR-PACKAGE>
</AR-PACKAGES>
</AUTOSAR>
