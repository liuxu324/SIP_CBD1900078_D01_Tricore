AUTOSAR XML (schema 4-2-1)
package /InitialEcuC
  ecuc value collection InitialEcuC: ecuc-values=[Can, CanIf, CanNm, CanSM, CanTp, Com, ComM, Dcm, EcuC, EcuM, Nm, PduR]
  module config Can
    CanConfigSet
      CT_CAN00_9df8a959 (CanController):
        CanControllerActivation = true
        CanControllerDefaultBaudrate = CT_CAN00_9df8a959/CanControllerBaudrateConfig
        CanControllerSystemRef = CT_CAN00
        CanWakeupSourceRef = EcuMCommonConfiguration/CN_CAN00_5e566ad9
        CanControllerBaudrateConfig
      CT_CAN01_eaff99cf (CanController):
        CanControllerActivation = true
        CanControllerDefaultBaudrate = CT_CAN01_eaff99cf/CanControllerBaudrateConfig
        CanControllerSystemRef = CT_CAN01
        CanWakeupSourceRef = EcuMCommonConfiguration/CN_CAN01_29515a4f
        CanControllerBaudrateConfig
      5 x CanHardwareObject, all with CanHandleType=BASIC, CanIdValue=0:
        CN_CAN00_4240a648_Rx: CanIdType=EXTENDED, CanObjectType=RECEIVE, CanControllerRef=CanConfigSet/CT_CAN00_9df8a959
        CN_CAN00_5e566ad9_Tx: CanObjectType=TRANSMIT, CanControllerRef=CanConfigSet/CT_CAN00_9df8a959
        CN_CAN00_770af0b0_Rx: CanIdType=STANDARD, CanObjectType=RECEIVE, CanControllerRef=CanConfigSet/CT_CAN00_9df8a959
        CN_CAN01_29515a4f_Tx: CanObjectType=TRANSMIT, CanControllerRef=CanConfigSet/CT_CAN01_eaff99cf
        CN_CAN01_ad82cd76_Rx: CanIdType=EXTENDED, CanObjectType=RECEIVE, CanControllerRef=CanConfigSet/CT_CAN01_eaff99cf
    CanGeneral: CanIndex=0
  module config CanIf
    CanIfCtrlDrvCfg_7d254554 (CanIfCtrlDrvCfg): CanIfCtrlDrvInitHohConfigRef=CanIfInitHohCfg, CanIfCtrlDrvNameRef=CanGeneral
      CT_CAN00_9df8a959 (CanIfCtrlCfg): CanIfCtrlCanCtrlRef=CanConfigSet/CT_CAN00_9df8a959
      CT_CAN01_eaff99cf (CanIfCtrlCfg): CanIfCtrlCanCtrlRef=CanConfigSet/CT_CAN01_eaff99cf
    CanIfInitCfg
      CHNL_0fb271d2 (CanIfBufferCfg): CanIfBufferSize=0, CanIfBufferHthRef=CanIfInitHohCfg/CN_CAN00_5e566ad9_Tx
      CHNL_c4eea277 (CanIfBufferCfg): CanIfBufferSize=0, CanIfBufferHthRef=CanIfInitHohCfg/CN_CAN01_29515a4f_Tx
      CanIfInitHohCfg: CanIfInitRefCfgSet=CanConfigSet
        3 x CanIfHrhCfg:
          CN_CAN00_4240a648_Rx: CanIfHrhCanCtrlIdRef=CanIfCtrlDrvCfg_7d254554/CT_CAN00_9df8a959, CanIfHrhIdSymRef=CanConfigSet/CN_CAN00_4240a648_Rx
          CN_CAN00_770af0b0_Rx: CanIfHrhCanCtrlIdRef=CanIfCtrlDrvCfg_7d254554/CT_CAN00_9df8a959, CanIfHrhIdSymRef=CanConfigSet/CN_CAN00_770af0b0_Rx
          CN_CAN01_ad82cd76_Rx: CanIfHrhCanCtrlIdRef=CanIfCtrlDrvCfg_7d254554/CT_CAN01_eaff99cf, CanIfHrhIdSymRef=CanConfigSet/CN_CAN01_ad82cd76_Rx
        CN_CAN00_5e566ad9_Tx (CanIfHthCfg): CanIfHthCanCtrlIdRef=CanIfCtrlDrvCfg_7d254554/CT_CAN00_9df8a959, CanIfHthIdSymRef=CanConfigSet/CN_CAN00_5e566ad9_Tx
        CN_CAN01_29515a4f_Tx (CanIfHthCfg): CanIfHthCanCtrlIdRef=CanIfCtrlDrvCfg_7d254554/CT_CAN01_eaff99cf, CanIfHthIdSymRef=CanConfigSet/CN_CAN01_29515a4f_Tx
      7 x CanIfRxPduCfg:
        MyECU_f835e395_Rx: CanIfRxPduCanIdType=STANDARD_CAN, CanIfRxPduDlc=8, CanIfRxPduUserRxIndicationName=CanNm_RxIndication, CanIfRxPduUserRxIndicationUL=CAN_NM, CanIfRxPduHrhIdRef=CanIfInitHohCfg/CN_CAN00_770af0b0_Rx, CanIfRxPduRef=MyECU_df2f1767_Rx
          CHNL_39b6d69b (CanIfRxPduCanIdRange): CanIfRxPduCanIdRangeLowerCanId=1024, CanIfRxPduCanIdRangeUpperCanId=1087
        msg_Receive_1_oCAN00_c6c44320_Rx: CanIfRxPduCanId=529, CanIfRxPduCanIdType=STANDARD_CAN, CanIfRxPduDlc=1, CanIfRxPduUserRxIndicationName=PduR_CanIfRxIndication, CanIfRxPduUserRxIndicationUL=PDUR, CanIfRxPduHrhIdRef=CanIfInitHohCfg/CN_CAN00_770af0b0_Rx, CanIfRxPduRef=EcucPduCollection/msg_Receive_1_oCAN00_4daba59b_Rx
        msg_Receive_Extend_1_oCAN00_8798d8dc_Rx: CanIfRxPduCanId=417071097, CanIfRxPduCanIdType=EXTENDED_CAN, CanIfRxPduDlc=1, CanIfRxPduUserRxIndicationName=PduR_CanIfRxIndication, CanIfRxPduUserRxIndicationUL=PDUR, CanIfRxPduHrhIdRef=CanIfInitHohCfg/CN_CAN00_4240a648_Rx, CanIfRxPduRef=EcucPduCollection/msg_Receive_Extend_1_oCAN00_42b41e10_Rx
        msg_Receive_Extend_2_oCAN01_3b324635_Rx: CanIfRxPduCanId=417071096, CanIfRxPduCanIdType=EXTENDED_CAN, CanIfRxPduDlc=1, CanIfRxPduUserRxIndicationName=PduR_CanIfRxIndication, CanIfRxPduUserRxIndicationUL=PDUR, CanIfRxPduHrhIdRef=CanIfInitHohCfg/CN_CAN01_ad82cd76_Rx, CanIfRxPduRef=EcucPduCollection/msg_Receive_Extend_2_oCAN01_ed3e862a_Rx
        msg_Receive_oCAN00_76f25845_Rx: CanIfRxPduCanId=528, CanIfRxPduCanIdType=STANDARD_CAN, CanIfRxPduDlc=1, CanIfRxPduUserRxIndicationName=PduR_CanIfRxIndication, CanIfRxPduUserRxIndicationUL=PDUR, CanIfRxPduHrhIdRef=CanIfInitHohCfg/CN_CAN00_770af0b0_Rx, CanIfRxPduRef=EcucPduCollection/msg_Receive_oCAN00_3867e0b8_Rx
        msg_diag_RequestGlobal_Tp_oCAN00_5c56b065_Rx: CanIfRxPduCanId=1556, CanIfRxPduCanIdType=STANDARD_CAN, CanIfRxPduDlc=8, CanIfRxPduUserRxIndicationName=CanTp_RxIndication, CanIfRxPduUserRxIndicationType=PDUID_PDUINFOPTR, CanIfRxPduUserRxIndicationUL=CAN_TP, CanIfRxPduHrhIdRef=CanIfInitHohCfg/CN_CAN00_770af0b0_Rx, CanIfRxPduRef=msg_diag_RequestGlobal_Tp_oCAN00_7b1e9193_Rx
        msg_diag_Request_MyECU_Tp_oCAN00_2c5ccddc_Rx: CanIfRxPduCanId=1552, CanIfRxPduCanIdType=STANDARD_CAN, CanIfRxPduDlc=8, CanIfRxPduUserRxIndicationName=CanTp_RxIndication, CanIfRxPduUserRxIndicationType=PDUID_PDUINFOPTR, CanIfRxPduUserRxIndicationUL=CAN_TP, CanIfRxPduHrhIdRef=CanIfInitHohCfg/CN_CAN00_770af0b0_Rx, CanIfRxPduRef=msg_diag_Request_MyECU_Tp_oCAN00_ecbacca2_Rx
      7 x CanIfTxPduCfg:
        msg_MyECU_Lamp_oCAN00_41befc25_Tx: CanIfTxPduCanId=1297, CanIfTxPduCanIdType=STANDARD_CAN, CanIfTxPduDlc=8, CanIfTxPduUserTxConfirmationName=PduR_CanIfTxConfirmation, CanIfTxPduUserTxConfirmationUL=PDUR, CanIfTxPduBufferRef=CanIfInitCfg/CHNL_0fb271d2, CanIfTxPduRef=EcucPduCollection/msg_MyECU_Lamp_oCAN00_26f3473b_Tx
        msg_Transmit_Copy_1_oCAN00_990cfc00_Tx: CanIfTxPduCanId=513, CanIfTxPduCanIdType=STANDARD_CAN, CanIfTxPduDlc=8, CanIfTxPduUserTxConfirmationName=PduR_CanIfTxConfirmation, CanIfTxPduUserTxConfirmationUL=PDUR, CanIfTxPduBufferRef=CanIfInitCfg/CHNL_0fb271d2, CanIfTxPduRef=EcucPduCollection/msg_Transmit_Copy_1_oCAN00_70bbb9d5_Tx
        msg_Transmit_Extended1_oCAN00_f3b05f8f_Tx: CanIfTxPduCanId=417003795, CanIfTxPduCanIdType=EXTENDED_CAN, CanIfTxPduDlc=8, CanIfTxPduUserTxConfirmationName=PduR_CanIfTxConfirmation, CanIfTxPduUserTxConfirmationUL=PDUR, CanIfTxPduBufferRef=CanIfInitCfg/CHNL_0fb271d2, CanIfTxPduRef=EcucPduCollection/msg_Transmit_Extended1_oCAN00_ff88358c_Tx
        msg_Transmit_Extended2_oCAN01_f0f4fa20_Tx: CanIfTxPduCanId=417003796, CanIfTxPduCanIdType=EXTENDED_CAN, CanIfTxPduDlc=8, CanIfTxPduUserTxConfirmationName=PduR_CanIfTxConfirmation, CanIfTxPduUserTxConfirmationUL=PDUR, CanIfTxPduBufferRef=CanIfInitCfg/CHNL_c4eea277, CanIfTxPduRef=EcucPduCollection/msg_Transmit_Extended2_oCAN01_5002adb6_Tx
        msg_Transmit_oCAN00_29db34a4_Tx: CanIfTxPduCanId=512, CanIfTxPduCanIdType=STANDARD_CAN, CanIfTxPduDlc=1, CanIfTxPduUserTxConfirmationName=PduR_CanIfTxConfirmation, CanIfTxPduUserTxConfirmationUL=PDUR, CanIfTxPduBufferRef=CanIfInitCfg/CHNL_0fb271d2, CanIfTxPduRef=EcucPduCollection/msg_Transmit_oCAN00_9631a86b_Tx
        msg_diag_Response_MyECU_Tp_oCAN00_59e48f7a_Tx: CanIfTxPduCanId=1554, CanIfTxPduCanIdType=STANDARD_CAN, CanIfTxPduDlc=8, CanIfTxPduUserTxConfirmationName=CanTp_TxConfirmation, CanIfTxPduUserTxConfirmationUL=CAN_TP, CanIfTxPduBufferRef=CanIfInitCfg/CHNL_0fb271d2, CanIfTxPduRef=msg_diag_Response_MyECU_Tp_oCAN00_0ed9d144_Tx
        msg_nm_MyECU_oCAN00_dfbc2140_Tx: CanIfTxPduCanId=1024, CanIfTxPduCanIdType=STANDARD_CAN, CanIfTxPduDlc=8, CanIfTxPduUserTxConfirmationName=CanNm_TxConfirmation, CanIfTxPduUserTxConfirmationUL=CAN_NM, CanIfTxPduBufferRef=CanIfInitCfg/CHNL_0fb271d2, CanIfTxPduRef=EcucPduCollection/msg_nm_MyECU_oCAN00_077ec9e6_Tx
    CanIfPrivateCfg: CanIfPrivateSoftwareFilterType=LINEAR
    CanIfPublicCfg: CanIfPublicPnSupport=false
  module config CanNm
    CanNmGlobalConfig: CanNmPnEiraCalcEnabled=false, CanNmUserDataEnabled=true
      CAN00_CAN_5faa4e95 (CanNmChannelConfig):
        CanNmMsgCycleTime = 0.1
        CanNmMsgReducedTime = 0.05
        CanNmNodeId = 0
        CanNmRepeatMessageTime = 0.4
        CanNmTimeoutTime = 1
        CanNmUserDataLength = 6
        CanNmWaitBusSleepTime = 0.75
        CanNmComMNetworkHandleRef = ComMConfigSet/CN_CAN00_5e566ad9
        CAN00_CAN_5faa4e95_Rx (CanNmRxPdu): CanNmRxPduRef=MyECU_df2f1767_Rx
        msg_nm_MyECU_oCAN00_077ec9e6_Tx (CanNmTxPdu): CanNmTxPduRef=EcucPduCollection/msg_nm_MyECU_oCAN00_077ec9e6_Tx
  module config CanSM
    CanSMConfiguration
      CHNL_0fb271d2 (CanSMManagerNetwork): CanSMComMNetworkHandleRef=ComMConfigSet/CN_CAN00_5e566ad9
        CT_CAN00_f3aba03e (CanSMController): CanSMControllerId=CanIfCtrlDrvCfg_7d254554/CT_CAN00_9df8a959
      CHNL_c4eea277 (CanSMManagerNetwork): CanSMComMNetworkHandleRef=ComMConfigSet/CN_CAN01_29515a4f
        CT_CAN01_a72df005 (CanSMController): CanSMControllerId=CanIfCtrlDrvCfg_7d254554/CT_CAN01_eaff99cf
  module config CanTp
    CanTpConfig: CanTpMainFunctionPeriod=0.005
      TPCH_3983176e (CanTpChannel): CanTpChannelMode=CANTP_MODE_FULL_DUPLEX
        CanTpRxNSdu_678e3b4e (CanTpRxNSdu):
          CanTpRxAddressingFormat = CANTP_STANDARD
          CanTpRxDl = 8
          CanTpRxTaType = CANTP_FUNCTIONAL
          CanTpRxNSduRef = EcucPduCollection/msg_diag_RequestGlobal_oCAN00_38f4a687_Rx
          CanTpRxNPdu_55155daa (CanTpRxNPdu): CanTpRxNPduRef=msg_diag_RequestGlobal_Tp_oCAN00_7b1e9193_Rx
      TPCH_e391c48f (CanTpChannel): CanTpChannelMode=CANTP_MODE_FULL_DUPLEX
        CanTpRxNSdu_85e31bc0 (CanTpRxNSdu):
          CanTpRxAddressingFormat = CANTP_STANDARD
          CanTpRxDl = 8
          CanTpRxTaType = CANTP_PHYSICAL
          CanTpRxNSduRef = EcucPduCollection/msg_diag_Request_MyECU_oCAN00_a823f7ba_Rx
          CanTpRxNPdu_7fe257d9 (CanTpRxNPdu): CanTpRxNPduRef=msg_diag_Request_MyECU_Tp_oCAN00_ecbacca2_Rx
          CanTpTxFcNPdu_7fe257d9 (CanTpTxFcNPdu): CanTpTxFcNPduRef=msg_diag_Response_MyECU_Tp_oCAN00_0ed9d144_Tx
        CanTpTxNSdu_85e31bc0 (CanTpTxNSdu):
          CanTpTxAddressingFormat = CANTP_STANDARD
          CanTpTxDl = 8
          CanTpTxTaType = CANTP_PHYSICAL
          CanTpTxNSduRef = EcucPduCollection/msg_diag_Response_MyECU_oCAN00_45311294_Tx
          CanTpRxFcNPdu_5d18832b (CanTpRxFcNPdu): CanTpRxFcNPduRef=msg_diag_Request_MyECU_Tp_oCAN00_ecbacca2_Rx
          CanTpTxNPdu_5d18832b (CanTpTxNPdu): CanTpTxNPduRef=msg_diag_Response_MyECU_Tp_oCAN00_0ed9d144_Tx
  module config Com
    ComConfig
      9 x ComIPdu, all with ComIPduType=NORMAL:
        msg_MyECU_Lamp_oCAN00_818e1651_Tx: ComIPduDirection=SEND, ComIPduGroupRef=MyECU_oCAN00_Tx_1ae5d671, ComIPduSignalRef=sig_LampCnt_omsg_MyECU_Lamp_oCAN00_f37e68ea_Tx, ComPduIdRef=EcucPduCollection/msg_MyECU_Lamp_oCAN00_818e1651_Tx
          ComTxIPdu: ComMinimumDelayTime=0, ComTxIPduUnusedAreasDefault=0
            ComTxModeFalse
              ComTxMode: ComTxModeMode=PERIODIC, ComTxModeTimeOffset=0, ComTxModeTimePeriod=0.1
            ComTxModeTrue
              ComTxMode: ComTxModeMode=PERIODIC, ComTxModeTimeOffset=0, ComTxModeTimePeriod=0.1
        msg_Receive_1_oCAN00_e29a6c9c_Rx: ComIPduDirection=RECEIVE, ComIPduGroupRef=MyECU_oCAN00_Rx_4cbf71f7, ComIPduSignalRef=sig_State_Copy_1_omsg_Receive_1_oCAN00_0cb08066_Rx, ComPduIdRef=EcucPduCollection/msg_Receive_1_oCAN00_e29a6c9c_Rx
        msg_Receive_Extend_1_oCAN00_3c8d89c5_Rx: ComIPduDirection=RECEIVE, ComIPduGroupRef=MyECU_oCAN00_Rx_4cbf71f7, ComIPduSignalRef=sig_State_Extend_1_omsg_Receive_Extend_1_oCAN00_184f337d_Rx, ComPduIdRef=EcucPduCollection/msg_Receive_Extend_1_oCAN00_3c8d89c5_Rx
        msg_Receive_Extend_2_oCAN01_c505beb0_Rx: ComIPduDirection=RECEIVE, ComIPduGroupRef=MyECU_oCAN01_Rx_f4031692, ComIPduSignalRef=sig_State_Extend_2_omsg_Receive_Extend_2_oCAN01_a5662110_Rx, ComPduIdRef=EcucPduCollection/msg_Receive_Extend_2_oCAN01_c505beb0_Rx
        msg_Receive_oCAN00_2b456e3f_Rx: ComIPduDirection=RECEIVE, ComIPduGroupRef=MyECU_oCAN00_Rx_4cbf71f7, ComIPduSignalRef=sig_State_RearInteriorLight_omsg_Receive_oCAN00_63323183_Rx, ComIPduSignalRef=sig_State_RearLeftDoor_omsg_Receive_oCAN00_84ad4140_Rx, ComIPduSignalRef=sig_State_RearRightDoor_omsg_Receive_oCAN00_a8945098_Rx, ComPduIdRef=EcucPduCollection/msg_Receive_oCAN00_2b456e3f_Rx
        msg_Transmit_Copy_1_oCAN00_4f60d237_Tx: ComIPduDirection=SEND, ComIPduGroupRef=MyECU_oCAN00_Tx_1ae5d671, ComIPduSignalRef=sig_RearInteriorLight_Copy_1_omsg_Transmit_Copy_1_oCAN00_bb8c8f19_Tx, ComPduIdRef=EcucPduCollection/msg_Transmit_Copy_1_oCAN00_4f60d237_Tx
          ComTxIPdu: ComMinimumDelayTime=0, ComTxIPduUnusedAreasDefault=0
            ComTxModeFalse
              ComTxMode: ComTxModeMode=PERIODIC, ComTxModeTimeOffset=0, ComTxModeTimePeriod=0.1
            ComTxModeTrue
              ComTxMode: ComTxModeMode=PERIODIC, ComTxModeTimeOffset=0, ComTxModeTimePeriod=0.1
        msg_Transmit_Extended1_oCAN00_1bd55eb9_Tx: ComIPduDirection=SEND, ComIPduGroupRef=MyECU_oCAN00_Tx_1ae5d671, ComIPduSignalRef=sig_RearInteriorLight_Extend_1_omsg_Transmit_Extended1_oCAN00_4cf4a247_Tx, ComPduIdRef=EcucPduCollection/msg_Transmit_Extended1_oCAN00_1bd55eb9_Tx
          ComTxIPdu: ComMinimumDelayTime=0, ComTxIPduUnusedAreasDefault=0
            ComTxModeFalse
              ComTxMode: ComTxModeMode=PERIODIC, ComTxModeTimeOffset=0, ComTxModeTimePeriod=0.1
            ComTxModeTrue
              ComTxMode: ComTxModeMode=PERIODIC, ComTxModeTimeOffset=0, ComTxModeTimePeriod=0.1
        msg_Transmit_Extended2_oCAN01_e25d69cc_Tx: ComIPduDirection=SEND, ComIPduGroupRef=MyECU_oCAN01_Tx_a259b114, ComIPduSignalRef=sig_RearInteriorLight_Extend_2_omsg_Transmit_Extended2_oCAN01_7c639d8d_Tx, ComPduIdRef=EcucPduCollection/msg_Transmit_Extended2_oCAN01_e25d69cc_Tx
          ComTxIPdu: ComMinimumDelayTime=0, ComTxIPduUnusedAreasDefault=0
            ComTxModeFalse
              ComTxMode: ComTxModeMode=PERIODIC, ComTxModeTimeOffset=0, ComTxModeTimePeriod=0.1
            ComTxModeTrue
              ComTxMode: ComTxModeMode=PERIODIC, ComTxModeTimeOffset=0, ComTxModeTimePeriod=0.1
        msg_Transmit_oCAN00_0723e95e_Tx: ComIPduDirection=SEND, ComIPduGroupRef=MyECU_oCAN00_Tx_1ae5d671, ComIPduSignalRef=sig_RearInteriorLight_omsg_Transmit_oCAN00_49a633c1_Tx, ComPduIdRef=EcucPduCollection/msg_Transmit_oCAN00_0723e95e_Tx
          ComTxIPdu: ComMinimumDelayTime=0, ComTxIPduUnusedAreasDefault=0
            ComTxModeFalse
              ComTxMode: ComTxModeMode=PERIODIC, ComTxModeTimeOffset=0, ComTxModeTimePeriod=0.1
            ComTxModeTrue
              ComTxMode: ComTxModeMode=PERIODIC, ComTxModeTimeOffset=0, ComTxModeTimePeriod=0.1
      4 x ComIPduGroup:
        MyECU_oCAN00_Rx_4cbf71f7
        MyECU_oCAN00_Tx_1ae5d671
        MyECU_oCAN01_Rx_f4031692
        MyECU_oCAN01_Tx_a259b114
      11 x ComSignal, all with ComSignalInitValue=0:
        sig_LampCnt_omsg_MyECU_Lamp_oCAN00_f37e68ea_Tx: ComBitPosition=7, ComBitSize=8, ComSignalEndianness=BIG_ENDIAN, ComSignalType=UINT8, ComTransferProperty=PENDING, ComSystemTemplateSystemSignalRef=sig_LampCnt
        sig_RearInteriorLight_Copy_1_omsg_Transmit_Copy_1_oCAN00_bb8c8f19_Tx: ComBitPosition=0, ComBitSize=1, ComSignalEndianness=LITTLE_ENDIAN, ComSignalType=BOOLEAN, ComTransferProperty=PENDING, ComSystemTemplateSystemSignalRef=sig_RearInteriorLight_Copy_1
        sig_RearInteriorLight_Extend_1_omsg_Transmit_Extended1_oCAN00_4cf4a247_Tx: ComBitPosition=0, ComBitSize=1, ComSignalEndianness=LITTLE_ENDIAN, ComSignalType=BOOLEAN, ComTransferProperty=PENDING, ComSystemTemplateSystemSignalRef=sig_RearInteriorLight_Extend_1
        sig_RearInteriorLight_Extend_2_omsg_Transmit_Extended2_oCAN01_7c639d8d_Tx: ComBitPosition=0, ComBitSize=1, ComSignalEndianness=LITTLE_ENDIAN, ComSignalType=BOOLEAN, ComTransferProperty=PENDING, ComSystemTemplateSystemSignalRef=sig_RearInteriorLight_Extend_2
        sig_RearInteriorLight_omsg_Transmit_oCAN00_49a633c1_Tx: ComBitPosition=0, ComBitSize=1, ComSignalEndianness=LITTLE_ENDIAN, ComSignalType=BOOLEAN, ComTransferProperty=PENDING, ComSystemTemplateSystemSignalRef=sig_RearInteriorLight
        sig_State_RearInteriorLight_omsg_Receive_oCAN00_63323183_Rx: ComBitPosition=2, ComBitSize=1, ComSignalEndianness=LITTLE_ENDIAN, ComSignalType=BOOLEAN, ComTimeout=0, ComSystemTemplateSystemSignalRef=sig_State_RearInteriorLight
        sig_State_RearLeftDoor_omsg_Receive_oCAN00_84ad4140_Rx: ComBitPosition=0, ComBitSize=1, ComSignalEndianness=LITTLE_ENDIAN, ComSignalType=BOOLEAN, ComTimeout=0, ComSystemTemplateSystemSignalRef=sig_State_RearLeftDoor
        sig_State_RearRightDoor_omsg_Receive_oCAN00_a8945098_Rx: ComBitPosition=1, ComBitSize=1, ComSignalEndianness=LITTLE_ENDIAN, ComSignalType=BOOLEAN, ComTimeout=0, ComSystemTemplateSystemSignalRef=sig_State_RearRightDoor
        sig_State_Copy_1_omsg_Receive_1_oCAN00_0cb08066_Rx: ComBitPosition=0, ComBitSize=1, ComSignalEndianness=LITTLE_ENDIAN, ComSignalType=BOOLEAN, ComTimeout=0, ComSystemTemplateSystemSignalRef=sig_State__Copy_1  # sig_State__Copy_1_omsg_Receive_1_oCAN00
        sig_State_Extend_1_omsg_Receive_Extend_1_oCAN00_184f337d_Rx: ComBitPosition=1, ComBitSize=1, ComSignalEndianness=LITTLE_ENDIAN, ComSignalType=BOOLEAN, ComTimeout=0, ComSystemTemplateSystemSignalRef=sig_State__Extend_1  # sig_State__Extend_1_omsg_Receive_Extend_1_oCAN00
        sig_State_Extend_2_omsg_Receive_Extend_2_oCAN01_a5662110_Rx: ComBitPosition=1, ComBitSize=1, ComSignalEndianness=LITTLE_ENDIAN, ComSignalType=BOOLEAN, ComTimeout=0, ComSystemTemplateSystemSignalRef=sig_State__Extend_2  # sig_State__Extend_2_omsg_Receive_Extend_2_oCAN01
    ComGeneral
  module config ComM
    ComMConfigSet: ComMPncEnabled=false
      CN_CAN00_5e566ad9 (ComMChannel): ComMBusType=COMM_BUS_TYPE_CAN, ComMChannelId=0
        ComMNetworkManagement: ComMNmVariant=FULL
        CN_CAN00_cd7594b0 (ComMUserPerChannel): ComMUserChannel=CN_CAN00_06ecbb07
      CN_CAN01_29515a4f (ComMChannel): ComMBusType=COMM_BUS_TYPE_CAN, ComMChannelId=1
        ComMNetworkManagement: ComMNmVariant=NONE
        CN_CAN01_a812aff6 (ComMUserPerChannel): ComMUserChannel=CN_CAN01_e92ed039
      CN_CAN00_06ecbb07 (ComMUser): ComMUserIdentifier=0
      CN_CAN01_e92ed039 (ComMUser): ComMUserIdentifier=1
    ComMGeneral: ComMPncIdCounting=COMM_PNC_ID_COUNT_FROM_NM_MESSAGE, ComMPncSupport=false
  module config Dcm
    DcmConfigSet
      DcmDsl
        DcmDslProtocol
          DcmDslProtocolRow_29812fbf (DcmDslProtocolRow)
            DcmDslConnection_b0ac4f47 (DcmDslConnection)
              DcmDslMainConnection
                msg_diag_RequestGlobal_oCAN00_25be229e_Rx_6a1ea0f3 (DcmDslProtocolRx):
                  DcmDslProtocolRxAddrType = DCM_FUNCTIONAL_TYPE
                  DcmDslProtocolRxPduId = 1
                  DcmDslProtocolRxComMChannelRef = ComMConfigSet/CN_CAN00_5e566ad9
                  DcmDslProtocolRxPduRef = msg_diag_RequestGlobal_oCAN00_25be229e_Rx
                msg_diag_Request_MyECU_oCAN00_956934ec_Rx_b73501b5 (DcmDslProtocolRx):
                  DcmDslProtocolRxAddrType = DCM_PHYSICAL_TYPE
                  DcmDslProtocolRxPduId = 2
                  DcmDslProtocolRxComMChannelRef = ComMConfigSet/CN_CAN00_5e566ad9
                  DcmDslProtocolRxPduRef = msg_diag_Request_MyECU_oCAN00_956934ec_Rx
                msg_diag_Response_MyECU_oCAN00_f4dcbbcd_Tx_c184e7e6 (DcmDslProtocolTx): DcmDslTxConfirmationPduId=0, DcmDslProtocolTxPduRef=EcucPduCollection/msg_diag_Response_MyECU_oCAN00_f4dcbbcd_Tx
  module config EcuC
    EcucPduCollection: PduIdTypeEnum=UINT8, PduLengthTypeEnum=UINT8
      29 x Pdu:
        MyECU_df2f1767_Rx: PduLength=8, SysTPduToFrameMappingRef=msg_nm_RearECU
        msg_MyECU_Lamp_oCAN00_26f3473b_Tx: PduLength=8, SysTPduToFrameMappingRef=msg_MyECU_Lamp
        msg_MyECU_Lamp_oCAN00_818e1651_Tx: PduLength=8
        msg_Receive_1_oCAN00_4daba59b_Rx: PduLength=1, SysTPduToFrameMappingRef=msg_Receive_1
        msg_Receive_1_oCAN00_e29a6c9c_Rx: PduLength=1
        msg_Receive_Extend_1_oCAN00_3c8d89c5_Rx: PduLength=1
        msg_Receive_Extend_1_oCAN00_42b41e10_Rx: PduLength=1, SysTPduToFrameMappingRef=msg_Receive_Extend_1
        msg_Receive_Extend_2_oCAN01_c505beb0_Rx: PduLength=1
        msg_Receive_Extend_2_oCAN01_ed3e862a_Rx: PduLength=1, SysTPduToFrameMappingRef=msg_Receive_Extend_2
        msg_Receive_oCAN00_2b456e3f_Rx: PduLength=1
        msg_Receive_oCAN00_3867e0b8_Rx: PduLength=1, SysTPduToFrameMappingRef=msg_Receive
        msg_Transmit_Copy_1_oCAN00_4f60d237_Tx: PduLength=8
        msg_Transmit_Copy_1_oCAN00_70bbb9d5_Tx: PduLength=8, SysTPduToFrameMappingRef=msg_Transmit_Copy_1
        msg_Transmit_Extended1_oCAN00_1bd55eb9_Tx: PduLength=8
        msg_Transmit_Extended1_oCAN00_ff88358c_Tx: PduLength=8, SysTPduToFrameMappingRef=msg_Transmit_Extended1
        msg_Transmit_Extended2_oCAN01_5002adb6_Tx: PduLength=8, SysTPduToFrameMappingRef=msg_Transmit_Extended2
        msg_Transmit_Extended2_oCAN01_e25d69cc_Tx: PduLength=8
        msg_Transmit_oCAN00_0723e95e_Tx: PduLength=1
        msg_Transmit_oCAN00_9631a86b_Tx: PduLength=1, SysTPduToFrameMappingRef=msg_Transmit
        msg_diag_RequestGlobal_Tp_oCAN00_7b1e9193_Rx: PduLength=8, SysTPduToFrameMappingRef=msg_diag_RequestGlobal_Tp
        msg_diag_RequestGlobal_oCAN00_25be229e_Rx: PduLength=7
        msg_diag_RequestGlobal_oCAN00_38f4a687_Rx: PduLength=7
        msg_diag_Request_MyECU_Tp_oCAN00_ecbacca2_Rx: PduLength=8, SysTPduToFrameMappingRef=msg_diag_Request_MyECU_Tp
        msg_diag_Request_MyECU_oCAN00_956934ec_Rx: PduLength=8
        msg_diag_Request_MyECU_oCAN00_a823f7ba_Rx: PduLength=8
        msg_diag_Response_MyECU_Tp_oCAN00_0ed9d144_Tx: PduLength=8, SysTPduToFrameMappingRef=msg_diag_Response_MyECU_Tp
        msg_diag_Response_MyECU_oCAN00_45311294_Tx: PduLength=8
        msg_diag_Response_MyECU_oCAN00_f4dcbbcd_Tx: PduLength=8
        msg_nm_MyECU_oCAN00_077ec9e6_Tx: PduLength=8, SysTPduToFrameMappingRef=msg_nm_MyECU
  module config EcuM
    EcuMConfiguration
      EcuMCommonConfiguration
        EcuMDriverInitListOne
        EcuMDriverRestartList
        CN_CAN00_5e566ad9 (EcuMWakeupSource): EcuMWakeupSourceId=5, EcuMComMChannelRef=ComMConfigSet/CN_CAN00_5e566ad9
        CN_CAN01_29515a4f (EcuMWakeupSource): EcuMWakeupSourceId=6, EcuMComMChannelRef=ComMConfigSet/CN_CAN01_29515a4f
      EcuMFlexConfiguration: EcuMFlexModuleConfigurationRef=CanConfigSet
  module config Nm
    CN_CAN00_5e566ad9 (NmChannelConfig): NmComMChannelRef=ComMConfigSet/CN_CAN00_5e566ad9
      CAN00_CAN_5faa4e95 (NmBusType)
        NmStandardBusNmConfig: NmStandardBusType=NM_BUSNM_CANNM  # CAN00_CAN
    NmGlobalConfig
      NmGlobalFeatures: NmNodeIdEnabled=true, NmUserDataEnabled=true
      NmGlobalProperties
  module config PduR
    PduRGeneral
    PduRRoutingTables
      PduRRoutingTable
        12 x PduRRoutingPath:
          msg_MyECU_Lamp_oCAN00_818e1651_Tx
            msg_MyECU_Lamp_oCAN00_26f3473b_Tx (PduRDestPdu): PduRDestPduRef=EcucPduCollection/msg_MyECU_Lamp_oCAN00_26f3473b_Tx
            PduRSrcPdu_8e8b997f (PduRSrcPdu): PduRSrcPduRef=EcucPduCollection/msg_MyECU_Lamp_oCAN00_818e1651_Tx
          msg_Receive_1_oCAN00_4daba59b_Rx
            msg_Receive_1_oCAN00_4daba59b_Rx_2f777849_Rx (PduRDestPdu): PduRDestPduRef=EcucPduCollection/msg_Receive_1_oCAN00_e29a6c9c_Rx
            PduRSrcPdu_2f777849 (PduRSrcPdu): PduRSrcPduRef=EcucPduCollection/msg_Receive_1_oCAN00_4daba59b_Rx
          msg_Receive_Extend_1_oCAN00_42b41e10_Rx
            msg_Receive_Extend_1_oCAN00_42b41e10_Rx_f20a19ef_Rx (PduRDestPdu): PduRDestPduRef=EcucPduCollection/msg_Receive_Extend_1_oCAN00_3c8d89c5_Rx
            PduRSrcPdu_f20a19ef (PduRSrcPdu): PduRSrcPduRef=EcucPduCollection/msg_Receive_Extend_1_oCAN00_42b41e10_Rx
          msg_Receive_Extend_2_oCAN01_ed3e862a_Rx
            msg_Receive_Extend_2_oCAN01_ed3e862a_Rx_5a39f2bb_Rx (PduRDestPdu): PduRDestPduRef=EcucPduCollection/msg_Receive_Extend_2_oCAN01_c505beb0_Rx
            PduRSrcPdu_5a39f2bb (PduRSrcPdu): PduRSrcPduRef=EcucPduCollection/msg_Receive_Extend_2_oCAN01_ed3e862a_Rx
          msg_Receive_oCAN00_3867e0b8_Rx
            msg_Receive_oCAN00_3867e0b8_Rx_16740ed0_Rx (PduRDestPdu): PduRDestPduRef=EcucPduCollection/msg_Receive_oCAN00_2b456e3f_Rx
            PduRSrcPdu_16740ed0 (PduRSrcPdu): PduRSrcPduRef=EcucPduCollection/msg_Receive_oCAN00_3867e0b8_Rx
          msg_Transmit_Copy_1_oCAN00_4f60d237_Tx
            msg_Transmit_Copy_1_oCAN00_70bbb9d5_Tx (PduRDestPdu): PduRDestPduRef=EcucPduCollection/msg_Transmit_Copy_1_oCAN00_70bbb9d5_Tx
            PduRSrcPdu_9950a667 (PduRSrcPdu): PduRSrcPduRef=EcucPduCollection/msg_Transmit_Copy_1_oCAN00_4f60d237_Tx
          msg_Transmit_Extended1_oCAN00_1bd55eb9_Tx
            msg_Transmit_Extended1_oCAN00_ff88358c_Tx (PduRDestPdu): PduRDestPduRef=EcucPduCollection/msg_Transmit_Extended1_oCAN00_ff88358c_Tx
            PduRSrcPdu_271054a4 (PduRSrcPdu): PduRSrcPduRef=EcucPduCollection/msg_Transmit_Extended1_oCAN00_1bd55eb9_Tx
          msg_Transmit_Extended2_oCAN01_e25d69cc_Tx
            msg_Transmit_Extended2_oCAN01_5002adb6_Tx (PduRDestPdu): PduRDestPduRef=EcucPduCollection/msg_Transmit_Extended2_oCAN01_5002adb6_Tx
            PduRSrcPdu_0b8d5a0f (PduRSrcPdu): PduRSrcPduRef=EcucPduCollection/msg_Transmit_Extended2_oCAN01_e25d69cc_Tx
          msg_Transmit_oCAN00_0723e95e_Tx
            msg_Transmit_oCAN00_9631a86b_Tx (PduRDestPdu): PduRDestPduRef=EcucPduCollection/msg_Transmit_oCAN00_9631a86b_Tx
            PduRSrcPdu_087fd70d (PduRSrcPdu): PduRSrcPduRef=EcucPduCollection/msg_Transmit_oCAN00_0723e95e_Tx
          msg_diag_RequestGlobal_oCAN00_38f4a687_Rx
            msg_diag_RequestGlobal_oCAN00_38f4a687_Rx_fdd5755a_Rx (PduRDestPdu): PduRDestPduRef=msg_diag_RequestGlobal_oCAN00_25be229e_Rx
            PduRSrcPdu_fdd5755a (PduRSrcPdu): PduRSrcPduRef=EcucPduCollection/msg_diag_RequestGlobal_oCAN00_38f4a687_Rx
          msg_diag_Request_MyECU_oCAN00_a823f7ba_Rx
            msg_diag_Request_MyECU_oCAN00_a823f7ba_Rx_11d927ad_Rx (PduRDestPdu): PduRDestPduRef=msg_diag_Request_MyECU_oCAN00_956934ec_Rx
            PduRSrcPdu_11d927ad (PduRSrcPdu): PduRSrcPduRef=EcucPduCollection/msg_diag_Request_MyECU_oCAN00_a823f7ba_Rx
          msg_diag_Response_MyECU_oCAN00_f4dcbbcd_Tx
            msg_diag_Response_MyECU_oCAN00_45311294_Tx (PduRDestPdu): PduRDestPduRef=EcucPduCollection/msg_diag_Response_MyECU_oCAN00_45311294_Tx
            PduRSrcPdu_f4835c60 (PduRSrcPdu): PduRSrcPduRef=EcucPduCollection/msg_diag_Response_MyECU_oCAN00_f4dcbbcd_Tx
