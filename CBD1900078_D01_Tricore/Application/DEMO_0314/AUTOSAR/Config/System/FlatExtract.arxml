AUTOSAR XML (schema 00044)
package /COM/VECTOR/CFG/WORKFLOW/SYSDESC/SYNC
  system SYSTEM: category=ECU_EXTRACT
    system mapping MAPPINGS
      data-mappings:
        data-element=CtLed4Type.COMPOSITIONTYPE.sig_RearInteriorLight.RearInteriorLight, system-signal=sig_RearInteriorLight
        data-element=CtLed4Type.COMPOSITIONTYPE.sig_State_RearInteriorLight.State_RearInteriorLight, system-signal=sig_State_RearInteriorLight
    root-software-compositions:
      root sw composition prototype COMPOSITIONTYPE: flat-map=FLATMAP, software-composition=COMPOSITIONTYPE
  composition sw component type COMPOSITIONTYPE  # UB:Derived from original system description
    20 x component:
      BswM: type=BswM
      ComM: type=ComM
      Det: type=Det
      EcuM: type=EcuM
      Os_OsCore{0..5}_swc: type=Os_OsCore{0..5}_swc
      Dcm: type=Dcm
      DemMaster_0: type=DemMaster_0
      DemSatellite_0: type=DemSatellite_0
      CtLed{0..5}Type: type=CtLed{0..5}Type
      CtCddIoHwAb: type=CtCddIoHwAb
    connect BswM.Switch_ESH_ModeSwitch -> BswM.Notification_ESH_ModeNotification
    connect CtCddIoHwAb.PiIoHwRead -> CtLed5Type.PiIoHwRead  # UB:Derived from original system description
  end to end protection set E2EPROTECTIONSET
  port interface mapping set PORTINTERFACEMAPPINGSET
