AUTOSAR XML (schema 4-2-1)
package /COM/VECTOR/CFG/WORKFLOW/SYSDESC/SYNC
  flat map FLATMAP
    7 x flat instance descriptor:
      CtLed{0..5}Type: upstream-reference=EcuSwComposition.CtLed{0..5}Type, ecu-extract-reference=COMPOSITIONTYPE.CtLed{0..5}Type
      CtCddIoHwAb: upstream-reference=EcuSwComposition.CtCddIoHwAb, ecu-extract-reference=COMPOSITIONTYPE.CtCddIoHwAb
