AUTOSAR XML (schema 4-2-2)
package /AURIX2G/EcucDefs/Dio_ib_bswmd/BswModuleDescriptions
  bsw module description Dio
    bsw internal behavior DioBehavior
