AUTOSAR XML (schema 00044)
standard types defined: boolean, uint8
package /Predefined_DEV/ImplementationDataTypes
  impl type NvM_RequestResultType: compu {0=NVM_REQ_OK, 1=NVM_REQ_NOT_OK, 2=NVM_REQ_PENDING, 3=NVM_REQ_INTEGRITY_FAILED, 4=NVM_REQ_BLOCK_SKIPPED, 5=NVM_REQ_NV_INVALIDATED, 6=NVM_REQ_CANCELED, 7=NVM_REQ_REDUNDANCY_FAILED, 8=NVM_REQ_RESTORED_FROM_ROM}, implementation-data-type=uint8
  impl type NvM_ServiceIdType: compu {6=NVM_READ_BLOCK, 7=NVM_WRITE_BLOCK, 8=NVM_RESTORE_BLOCK_DEFAULTS, 9=NVM_ERASE_BLOCK, 11=NVM_INVALIDATE_NV_BLOCK, 12=NVM_READ_ALL}, implementation-data-type=uint8
  impl type Dem_UdsStatusByteType: compu {mask 1: 1=DEM_UDS_STATUS_TF, mask 2: 2=DEM_UDS_STATUS_TFTOC, mask 4: 4=DEM_UDS_STATUS_PDTC, mask 8: 8=DEM_UDS_STATUS_CDTC, mask 16: 16=DEM_UDS_STATUS_TNCSLC, mask 32: 32=DEM_UDS_STATUS_TFSLC, mask 64: 64=DEM_UDS_STATUS_TNCTOC, mask 128: 128=DEM_UDS_STATUS_WIR}, range raw 0..255, implementation-data-type=uint8
package /DataType/Constraint
  range DC_sig_LampCnt: raw 0..255
  range DC_sig_RearInteriorLight: raw 0..1
  range DC_sig_State_RearInteriorLight: raw 0..1
  range DC_sig_State_RearLeftDoor: raw 0..1
  range DC_sig_State_RearRightDoor: raw 0..1
  range DC_sig_RearInteriorLight_Copy_1: raw 0..1
  range DC_sig_State__Copy_1: raw 0..1
  range DC_sig_RearInteriorLight_Extend_1: raw 0..1
  range DC_sig_State__Extend_1: raw 0..1
  range DC_sig_RearInteriorLight_Extend_2: raw 0..1
  range DC_sig_State__Extend_2: raw 0..1
package /DataType/Semantics
  compu method CM_sig_LampCnt: identical
  compu method CM_sig_RearInteriorLight: identical
  compu method CM_sig_State_RearInteriorLight: identical
  compu method CM_sig_State_RearLeftDoor: identical
  compu method CM_sig_State_RearRightDoor: identical
  compu method CM_sig_RearInteriorLight_Copy_1: identical
  compu method CM_sig_State__Copy_1: identical
  compu method CM_sig_RearInteriorLight_Extend_1: identical
  compu method CM_sig_State__Extend_1: identical
  compu method CM_sig_RearInteriorLight_Extend_2: identical
  compu method CM_sig_State__Extend_2: identical
package /DataTypes
  impl type IdtDioValueType: implementation-data-type=uint8, type-emitter=RTE
