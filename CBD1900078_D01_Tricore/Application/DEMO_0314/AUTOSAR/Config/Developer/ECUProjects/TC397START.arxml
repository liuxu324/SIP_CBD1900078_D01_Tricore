AUTOSAR XML (schema 00044)
package /VehicleProject
  system System
    root-software-compositions:
      root sw composition prototype EcuSwComposition: software-composition=ECU_Composition
package /ECUCompositionTypes
  composition sw component type ECU_Composition
    7 x component:
      CtLed{0..5}Type: type=CtLed{0..5}Type
      CtCddIoHwAb: type=CtCddIoHwAb
    connect CtCddIoHwAb.PiIoHwRead -> CtLed5Type.PiIoHwRead
package /EndToEndProtections
  end to end protection set EndToEndProtectionSet
