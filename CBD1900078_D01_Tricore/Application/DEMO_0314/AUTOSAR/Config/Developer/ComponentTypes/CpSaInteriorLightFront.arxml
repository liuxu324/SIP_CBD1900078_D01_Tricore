AUTOSAR XML (schema 00044)
package /ComponentTypes
  application sw component type CpSaInteriorLightFront
    behavior CpSaInteriorLightFront_InternalBehavior
      runnable RCtSaInteriorLightSwitchLight
  swc implementation CpSaInteriorLightFront_Implementation: behavior=CpSaInteriorLightFront_InternalBehavior
