AUTOSAR XML (schema 00044)
package /ComponentTypes
  application sw component type CtLed3Type
    behavior CtLed3Type_InternalBehavior
      timing event TMT_Led3BlinkRunnable: start-on-event=Led3BlinkRunnable, period=0.4
      runnable Led3BlinkRunnable
  swc implementation CtLed3Type_Implementation: behavior=CtLed3Type_InternalBehavior
