AUTOSAR XML (schema 00044)
package /ComponentTypes
  application sw component type CtLed0Type
    behavior CtLed0Type_InternalBehavior
      timing event TMT_Led0BlinkRunnable: start-on-event=Led0BlinkRunnable, period=0.1
      runnable Led0BlinkRunnable
  swc implementation CtLed0Type_Implementation: behavior=CtLed0Type_InternalBehavior
