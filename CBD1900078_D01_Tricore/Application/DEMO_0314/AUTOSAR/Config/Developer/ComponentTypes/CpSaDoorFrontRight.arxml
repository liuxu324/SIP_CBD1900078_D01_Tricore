AUTOSAR XML (schema 00044)
package /ComponentTypes
  application sw component type CpSaDoorFrontRight
    behavior CpSaDoorFrontRight_InternalBehavior
      runnable RCtSaDoorReadDoor
  swc implementation CpSaDoorFrontRight_Implementation: behavior=CpSaDoorFrontRight_InternalBehavior
