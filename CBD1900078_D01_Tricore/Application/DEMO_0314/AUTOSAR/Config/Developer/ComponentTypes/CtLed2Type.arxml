AUTOSAR XML (schema 00044)
package /ComponentTypes
  application sw component type CtLed2Type
    behavior CtLed2Type_InternalBehavior
      timing event TMT_Led2BlinkRunnable: start-on-event=Led2BlinkRunnable, period=0.3
      runnable Led2BlinkRunnable
  swc implementation CtLed2Type_Implementation: behavior=CtLed2Type_InternalBehavior
