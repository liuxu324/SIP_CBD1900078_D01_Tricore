AUTOSAR XML (schema 00044)
package /ComponentTypes
  application sw component type CpSaDoorFrontLeft
    behavior CpSaDoorFrontLeft_InternalBehavior
      runnable RCtSaDoorReadDoor
  swc implementation CpSaDoorFrontLeft_Implementation: behavior=CpSaDoorFrontLeft_InternalBehavior
