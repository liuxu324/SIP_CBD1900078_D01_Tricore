AUTOSAR XML (schema 00044)
package /ComponentTypes
  application sw component type CtLed1Type
    behavior CtLed1Type_InternalBehavior
      timing event TMT_Led1BlinkRunnable: start-on-event=Led1BlinkRunnable, period=0.2
      runnable Led1BlinkRunnable
  swc implementation CtLed1Type_Implementation: behavior=CtLed1Type_InternalBehavior
