AUTOSAR XML (schema 4-2-2)
# Copyright (C) Infineon Technologies (2018)
# All rights reserved.
package /AUTOSAR_Port/BswModuleDescriptions
  bsw module description Port: category=BSW_MODULE, module-id=124, provided-entrys=[Port_Init, Port_RefreshPortDirection, Port_GetVersionInfo, Port_InitCheck]  # PORT Driver
    bsw module dependency McalLibDependency: target-module-id=255, required-entrys=[Mcal_WritePeripEndInitProtReg, Mcal_WriteSafetyEndInitProtRegMask, Mcal_SetBitAtomic]
    bsw internal behavior PortBehavior
      4 x bsw called entity:
        Port_Init: reentrancy-level=NON-REENTRANT, implemented-entry=Port_Init
        Port_RefreshPortDirection: reentrancy-level=NON-REENTRANT, implemented-entry=Port_RefreshPortDirection
        Port_GetVersionInfo: reentrancy-level=MULTICORE-REENTRANT, implemented-entry=Port_GetVersionInfo
        Port_InitCheck: reentrancy-level=NON-REENTRANT, implemented-entry=Port_InitCheck
package /AUTOSAR_Port/BswModuleEntrys
  4 x bsw module entry, all with is-synchronous=true, call-type=REGULAR, execution-context=TASK, sw-service-impl-policy=STANDARD:
    Port_Init: service-id=0, is-reentrant=false
      sw service arg ConfigPtr: category=DATA_REFERENCE, sw-pointer-target-props={target-category=TYPE_REFERENCE, implementation-data-type=Port_ConfigType}
    Port_InitCheck: service-id=5, is-reentrant=false
      return type Return: implementation-data-type=Std_ReturnType
      sw service arg ConfigPtr: category=DATA_REFERENCE, sw-pointer-target-props={target-category=TYPE_REFERENCE, implementation-data-type=Port_ConfigType}
    Port_RefreshPortDirection: service-id=2, is-reentrant=false
    Port_GetVersionInfo: service-id=3, is-reentrant=true
      sw service arg Versioninfo: category=DATA_REFERENCE, sw-pointer-target-props={target-category=TYPE_REFERENCE, implementation-data-type=Std_VersionInfoType}
package /AUTOSAR_Port/Implementations
  bsw implementation Port: programming-language=C, sw-version=3.0.0, vendor-id=17, ar-release-version=4.2.2, behavior=PortBehavior, vendor-specific-module-def=Port
    code-descriptors:
      code Files: artifact-descriptors=[{short-label=ssc::src::Port.c, category=SWSRC}, {short-label=ssc::inc::Port.h, category=SWHDR}]
    4 x compiler:
      TASKING_COMPILE: name=TASKING, options="--core=tc1.6.2 --iso=99 -O2 --eabi-compliant -AGKpvX --switch=auto --integer-enumeration --default-near-size=0 --fp-model=1", vendor=Altium, version=V6.2r2
      GNU_COMPILE: name=GNU, options="-DGNU -Wall -std=c99 -c -O2 -mtc162 -meabi -fno-short-enums -ffunction-sections -fdata-sections -fstrict-volatile-bitfields", vendor=Hightec, version=V4.9.2.0
      DIAB_COMPILE: name=DIAB, options="-tTC162NF:simple -O -XO -Xsection-split=1 -Xkeep-assembly-file=2 -g3 -Xinline=0 -Xdialect-c99 -ei5388,2273,5387 -ei1824 -Xsmall-data=0 -Xsmall-const=0", vendor=Windriver, version=V5.9.6.4
      GHS_COMPILE: name=GHS, options="-cpu=tc1v162 --no_commons --gnu_asm --no_short_enum -c99 -Ospeed -Onounroll -g -c -dwarf2", vendor=GreenHills, version=V2017.5.5
    generated-artifacts:
      5 x dependency on artifact:
        Port_PBCfg_c: artifact-descriptor={short-label=generate::template::src::Port_PBCfg.c, category=SWTEMPLATE}, usages=EXECUTE
        Port_PBCfg_h: artifact-descriptor={short-label=generate::template::inc::Port_PBcfg.h, category=SWTEMPLATE}, usages=EXECUTE
        Port_xdm: artifact-descriptor={short-label=config::Port.xdm, category=SWTOOL}, usages=CODEGENERATION
        Port_Cfg_h: artifact-descriptor={short-label=generate::template::inc::Port_Cfg.h, category=SWTEMPLATE}, usages=COMPILE
        Port_bmd: artifact-descriptor={short-label=autosar::TC39x::TC397x::Port.bmd, category=SWTOOL}, usages=CODEGENERATION
    4 x linker:
      TASKING_LINK: name=TASKING, options="--map-file -OtcXYL --core=mpe:vtc", vendor=Altium, version=V6.2r2
      GNU_LINK: name=GNU, options="-Wl,--mcpu=tc162 -Wl,--gc-sections -nostartfiles -n", vendor=Hightec, version=V4.9.2.0
      DIAB_LINK: name=DIAB, options="-tTC162NF:simple -m6 -Xremove-unused-sections", vendor=Windriver, version=V5.9.6.4
      GHS_LINK: name=GHS, options="-cpu=tc1v162 -ignore_debug_references", vendor=GreenHills, version=V2017.5.5
    resource consumption ResourceConsumption
      4 x memory section:
        VAR_CLEARED_ASIL_B_GLOBAL_32: alignment=32, sw-addrmethod=VAR
        CONST_ASIL_B_GLOBAL_16: alignment=16, sw-addrmethod=CONST
        CONFIG_DATA_ASIL_B_GLOBAL_UNSPECIFIED: alignment=UNSPECIFIED, sw-addrmethod=CONFIG_DATA
        CODE_ASIL_B_GLOBAL: alignment=UNSPECIFIED, sw-addrmethod=CODE
      section name prefix PORT
package /AUTOSAR_Port/ImplementationDataTypes
  6 x impl type, all with category=STRUCTURE:
    Port_ConfigType
      5 x element, all with category=DATA_REFERENCE:
        PortConfigSetPtr: sw-pointer-target-props={target-category=TYPE_REFERENCE, implementation-data-type=Port_n_ConfigType}
        PDiscSet: sw-pointer-target-props={target-category=TYPE_REFERENCE, implementation-data-type=uint32}
        PortPinHwSupportedModes: sw-pointer-target-props={target-category=TYPE_REFERENCE, implementation-data-type=Port_n_ModeType}
        Port_LVDSConfigTypePtr: sw-pointer-target-props={target-category=TYPE_REFERENCE, implementation-data-type=Port_n_LVDSConfigType}
        Port_PCSRConfigTypePtr: sw-pointer-target-props={target-category=TYPE_REFERENCE, implementation-data-type=uint32}
    Port_n_ConfigType
      8 x element, all with category=TYPE_REFERENCE:
        PinControl: implementation-data-type=Port_n_ControlType
        PinLevel: implementation-data-type=Port_n_PinType
        DriverStrength0: implementation-data-type=uint32
        DriverStrength1: implementation-data-type=uint32
        ModeChangeControl: implementation-data-type=Port_n_PinType
        DirChangeControl: implementation-data-type=Port_n_PinType
        PinControl2: implementation-data-type=Port_n_ControlType
        EmergencyStopConf: implementation-data-type=Port_n_PinType
    Port_n_ControlType
      element PCx: implementation-data-type=uint8
    Port_n_LVDSConfigType
      element LPCRx: implementation-data-type=uint32
    Port_n_ModeType
      element U: array-size=16, array-size-semantics=FIXED-SIZE, implementation-data-type=uint8
    Port_n_PinType
      element Px: implementation-data-type=uint32
