AUTOSAR XML (schema 4-0-3)
package /DaVinci_Project
  module config Com
    ComConfig
      sig_RearInteriorLight_omsg_Transmit_oCAN00_49a633c1_Tx (ComSignal): ComSignalType=BOOLEAN
      sig_State_RearInteriorLight_omsg_Receive_oCAN00_63323183_Rx (ComSignal): ComNotification=Rte_COMCbk_sig_State_RearInteriorLight_omsg_Receive_oCAN00_63323183_Rx, ComSignalType=BOOLEAN
  module config Rte
    18 x RteBswModuleInstance:
      BswM
        BswM_MainFunctionTimingEvent0 (RteBswEventToTaskMapping): RteBswUsedOsEventRef=Rte_Ev_Cyclic2_SchMTask_Core0_0_10ms, RteBswUsedOsAlarmRef=Os/Rte_Al_TE2_SchMTask_Core0_0_10ms
      Can
        5 x RteBswEventToTaskMapping, all with RteBswUsedOsEventRef=Rte_Ev_Cyclic2_SchMTask_Core0_0_10ms, RteBswUsedOsAlarmRef=Os/Rte_Al_TE2_SchMTask_Core0_0_10ms:
          Can_MainFunction_BusOffTimingEvent0
          Can_MainFunction_ModeTimingEvent0
          Can_MainFunction_ReadTimingEvent0
          Can_MainFunction_WakeupTimingEvent0
          Can_MainFunction_WriteTimingEvent0
      CanIf
      CanNm
        CanNm_MainFunctionTimingEvent0 (RteBswEventToTaskMapping): RteBswUsedOsEventRef=Rte_Ev_Cyclic2_SchMTask_Core0_0_10ms, RteBswUsedOsAlarmRef=Os/Rte_Al_TE2_SchMTask_Core0_0_10ms
      CanSM
        CanSM_MainFunctionTimingEvent0 (RteBswEventToTaskMapping): RteBswUsedOsEventRef=Rte_Ev_Cyclic2_SchMTask_Core0_0_10ms, RteBswUsedOsAlarmRef=Os/Rte_Al_TE2_SchMTask_Core0_0_10ms
      CanTp
        CanTp_MainFunctionTimingEvent0 (RteBswEventToTaskMapping): RteBswUsedOsEventRef=Rte_Ev_Run_CanTp_CanTp_MainFunction, RteBswUsedOsAlarmRef=Os/Rte_Al_TE_CanTp_CanTp_MainFunction
      Com
        Com_MainFunctionRxTimingEvent0 (RteBswEventToTaskMapping): RteBswUsedOsEventRef=Rte_Ev_Cyclic2_SchMTask_Core0_0_10ms, RteBswUsedOsAlarmRef=Os/Rte_Al_TE2_SchMTask_Core0_0_10ms
        Com_MainFunctionTxTimingEvent0 (RteBswEventToTaskMapping): RteBswUsedOsEventRef=Rte_Ev_Cyclic2_SchMTask_Core0_0_10ms, RteBswUsedOsAlarmRef=Os/Rte_Al_TE2_SchMTask_Core0_0_10ms
      ComM
        ComM_MainFunction_0TimingEvent0 (RteBswEventToTaskMapping): RteBswUsedOsEventRef=Rte_Ev_Cyclic2_SchMTask_Core0_0_20ms, RteBswUsedOsAlarmRef=Os/Rte_Al_TE2_SchMTask_Core0_0_20ms
        ComM_MainFunction_1TimingEvent0 (RteBswEventToTaskMapping): RteBswUsedOsEventRef=Rte_Ev_Cyclic2_SchMTask_Core0_0_20ms, RteBswUsedOsAlarmRef=Os/Rte_Al_TE2_SchMTask_Core0_0_20ms
      Dcm
        Dcm_MainFunctionTimingEvent0 (RteBswEventToTaskMapping): RteBswUsedOsEventRef=Rte_Ev_Cyclic2_SchMTask_Core0_0_10ms, RteBswUsedOsAlarmRef=Os/Rte_Al_TE2_SchMTask_Core0_0_10ms
      Dem
        Dem_MasterMainFunctionTimingEvent0 (RteBswEventToTaskMapping): RteBswUsedOsEventRef=Rte_Ev_Cyclic2_SchMTask_Core0_0_10ms, RteBswUsedOsAlarmRef=Os/Rte_Al_TE2_SchMTask_Core0_0_10ms
        Dem_SatelliteMainFunctionTimingEvent0 (RteBswEventToTaskMapping): RteBswUsedOsEventRef=Rte_Ev_Cyclic2_SchMTask_Core0_0_10ms, RteBswUsedOsAlarmRef=Os/Rte_Al_TE2_SchMTask_Core0_0_10ms
      Det
      Dio
      EcuM
        6 x RteBswEventToTaskMapping:
          EcuM_MainFunctionTimingEvent0: RteBswUsedOsAlarmRef=Os/Rte_Al_TE1_EcuM_EcuM_MainFunction
          EcuM_MainFunctionTimingEvent1: RteBswUsedOsAlarmRef=Os/Rte_Al_TE2_EcuM_EcuM_MainFunction
          EcuM_MainFunctionTimingEvent2: RteBswUsedOsAlarmRef=Os/Rte_Al_TE3_EcuM_EcuM_MainFunction
          EcuM_MainFunctionTimingEvent3: RteBswUsedOsEventRef=Rte_Ev_Cyclic2_SchMTask_Core0_0_10ms, RteBswUsedOsAlarmRef=Os/Rte_Al_TE2_SchMTask_Core0_0_10ms
          EcuM_MainFunctionTimingEvent4: RteBswUsedOsAlarmRef=Os/Rte_Al_TE5_EcuM_EcuM_MainFunction
          EcuM_MainFunctionTimingEvent5: RteBswUsedOsAlarmRef=Os/Rte_Al_TE6_EcuM_EcuM_MainFunction
      McalLib
      Mcu
      Nm
      PduR
      Port
    20 x RteSwComponentInstance:
      BswM_EcuSwComposition
        Timer_BswM_MainFunction (RteEventToTaskMapping): RteUsedOsEventRef=Rte_Ev_Cyclic2_SchMTask_Core0_0_10ms, RteUsedOsAlarmRef=Os/Rte_Al_TE2_SchMTask_Core0_0_10ms
      ComM_EcuSwComposition
        Timer_ComM_MainFunction_0 (RteEventToTaskMapping): RteUsedOsEventRef=Rte_Ev_Cyclic2_SchMTask_Core0_0_20ms, RteUsedOsAlarmRef=Os/Rte_Al_TE2_SchMTask_Core0_0_20ms
        Timer_ComM_MainFunction_1 (RteEventToTaskMapping): RteUsedOsEventRef=Rte_Ev_Cyclic2_SchMTask_Core0_0_20ms, RteUsedOsAlarmRef=Os/Rte_Al_TE2_SchMTask_Core0_0_20ms
      CtCddIoHwAb_EcuSwComposition
      CtLed0Type_EcuSwComposition
        TMT_Led0BlinkRunnable (RteEventToTaskMapping): RteUsedOsAlarmRef=Os/Rte_Al_TE_CtLed0Type_Led0BlinkRunnable
      CtLed1Type_EcuSwComposition
        TMT_Led1BlinkRunnable (RteEventToTaskMapping): RteUsedOsAlarmRef=Os/Rte_Al_TE_CtLed1Type_Led1BlinkRunnable
      CtLed2Type_EcuSwComposition
        TMT_Led2BlinkRunnable (RteEventToTaskMapping): RteUsedOsAlarmRef=Os/Rte_Al_TE_CtLed2Type_Led2BlinkRunnable
      CtLed3Type_EcuSwComposition
        TMT_Led3BlinkRunnable (RteEventToTaskMapping): RteUsedOsAlarmRef=Os/Rte_Al_TE_CtLed3Type_Led3BlinkRunnable
      CtLed4Type_EcuSwComposition
        TMT_Led4BlinkRunnable (RteEventToTaskMapping): RteUsedOsAlarmRef=Os/Rte_Al_TE_CtLed4Type_Led4BlinkRunnable
      CtLed5Type_EcuSwComposition
        TMT_Led5BlinkRunnable (RteEventToTaskMapping): RteUsedOsAlarmRef=Os/Rte_Al_TE_CtLed5Type_Led5BlinkRunnable
      Dcm_EcuSwComposition
        Timer_Dcm_MainFunction (RteEventToTaskMapping): RteUsedOsEventRef=Rte_Ev_Cyclic2_SchMTask_Core0_0_10ms, RteUsedOsAlarmRef=Os/Rte_Al_TE2_SchMTask_Core0_0_10ms
      DemMaster_0_EcuSwComposition
        Timer_Dem_MasterMainFunction (RteEventToTaskMapping): RteUsedOsEventRef=Rte_Ev_Cyclic2_SchMTask_Core0_0_10ms, RteUsedOsAlarmRef=Os/Rte_Al_TE2_SchMTask_Core0_0_10ms
      DemSatellite_0_EcuSwComposition
        Timer_Dem_SatelliteMainFunction (RteEventToTaskMapping): RteUsedOsEventRef=Rte_Ev_Cyclic2_SchMTask_Core0_0_10ms, RteUsedOsAlarmRef=Os/Rte_Al_TE2_SchMTask_Core0_0_10ms
      Det_EcuSwComposition
      EcuM_EcuSwComposition
        Timer_EcuM_MainFunction (RteEventToTaskMapping): RteUsedOsEventRef=Rte_Ev_Cyclic2_SchMTask_Core0_0_10ms, RteUsedOsAlarmRef=Os/Rte_Al_TE2_SchMTask_Core0_0_10ms
      Os_OsCore{0..5}_swc_EcuSwComposition
    RteOsInteraction
      14 x RteUsedOsActivation, all with RteExpectedActivationOffset=0:
        Rte_Al_TE_CtLed{0..5}Type_Led{0..5}BlinkRunnable: RteActivationOsAlarmRef=Os/Rte_Al_TE_CtLed{0..5}Type_Led{0..5}BlinkRunnable, RteActivationOsTaskRef=ApplTask_Core{0..5}
        Rte_Al_TE2_SchMTask_Core0_0_10ms: RteActivationOsAlarmRef=Os/Rte_Al_TE2_SchMTask_Core0_0_10ms, RteActivationOsTaskRef=SchMTask_Core0
        Rte_Al_TE2_SchMTask_Core0_0_20ms: RteActivationOsAlarmRef=Os/Rte_Al_TE2_SchMTask_Core0_0_20ms, RteActivationOsTaskRef=SchMTask_Core0
        Rte_Al_TE_CanTp_CanTp_MainFunction: RteActivationOsAlarmRef=Os/Rte_Al_TE_CanTp_CanTp_MainFunction, RteActivationOsTaskRef=SchMTask_Core0
        Rte_Al_TE{1..3}_EcuM_EcuM_MainFunction: RteActivationOsAlarmRef=Os/Rte_Al_TE{1..3}_EcuM_EcuM_MainFunction, RteActivationOsTaskRef=SchMTask_Core{1..3}
        Rte_Al_TE5_EcuM_EcuM_MainFunction: RteActivationOsAlarmRef=Os/Rte_Al_TE5_EcuM_EcuM_MainFunction, RteActivationOsTaskRef=SchMTask_Core4
        Rte_Al_TE6_EcuM_EcuM_MainFunction: RteActivationOsAlarmRef=Os/Rte_Al_TE6_EcuM_EcuM_MainFunction, RteActivationOsTaskRef=SchMTask_Core5
  module config NvM
  module config Os
    ApplTask_Core0 (OsTask):
      OsTaskActivation = 1
      OsTaskPriority = 50
      OsTaskSchedule = FULL
      OsTaskAccessingApplication = SystemApplication_OsCore{1..5}
    Rte_Al_TE_CtLed0Type_Led0BlinkRunnable (OsAlarm):
      OsAlarmCounterRef = SystemTimer_Core0
      OsAlarmAccessingApplication = SystemApplication_OsCore{1..5}
      OsAlarmAction
        OsAlarmActivateTask: OsAlarmActivateTaskRef=ApplTask_Core0
    ApplTask_Core1 (OsTask):
      OsTaskActivation = 1
      OsTaskPriority = 50
      OsTaskSchedule = FULL
      OsTaskAccessingApplication = SystemApplication_OsCore0
      OsTaskAccessingApplication = SystemApplication_OsCore{2..5}
    Rte_Al_TE_CtLed1Type_Led1BlinkRunnable (OsAlarm):
      OsAlarmCounterRef = SystemTimer_Core1
      OsAlarmAccessingApplication = SystemApplication_OsCore0
      OsAlarmAccessingApplication = SystemApplication_OsCore{2..5}
      OsAlarmAction
        OsAlarmActivateTask: OsAlarmActivateTaskRef=ApplTask_Core1
    ApplTask_Core2 (OsTask):
      OsTaskActivation = 1
      OsTaskPriority = 50
      OsTaskSchedule = FULL
      OsTaskAccessingApplication = SystemApplication_OsCore0
      OsTaskAccessingApplication = SystemApplication_OsCore1
      OsTaskAccessingApplication = SystemApplication_OsCore{3..5}
    Rte_Al_TE_CtLed2Type_Led2BlinkRunnable (OsAlarm):
      OsAlarmCounterRef = SystemTimer_Core2
      OsAlarmAccessingApplication = SystemApplication_OsCore0
      OsAlarmAccessingApplication = SystemApplication_OsCore1
      OsAlarmAccessingApplication = SystemApplication_OsCore{3..5}
      OsAlarmAction
        OsAlarmActivateTask: OsAlarmActivateTaskRef=ApplTask_Core2
    ApplTask_Core3 (OsTask):
      OsTaskActivation = 1
      OsTaskPriority = 50
      OsTaskSchedule = FULL
      OsTaskAccessingApplication = SystemApplication_OsCore{0..2}
      OsTaskAccessingApplication = SystemApplication_OsCore4
      OsTaskAccessingApplication = SystemApplication_OsCore5
    Rte_Al_TE_CtLed3Type_Led3BlinkRunnable (OsAlarm):
      OsAlarmCounterRef = SystemTimer_Core3
      OsAlarmAccessingApplication = SystemApplication_OsCore{0..2}
      OsAlarmAccessingApplication = SystemApplication_OsCore4
      OsAlarmAccessingApplication = SystemApplication_OsCore5
      OsAlarmAction
        OsAlarmActivateTask: OsAlarmActivateTaskRef=ApplTask_Core3
    ApplTask_Core4 (OsTask):
      OsTaskActivation = 1
      OsTaskPriority = 50
      OsTaskSchedule = FULL
      OsTaskAccessingApplication = SystemApplication_OsCore{0..3}
      OsTaskAccessingApplication = SystemApplication_OsCore5
    Rte_Al_TE_CtLed4Type_Led4BlinkRunnable (OsAlarm):
      OsAlarmCounterRef = SystemTimer_Core4
      OsAlarmAccessingApplication = SystemApplication_OsCore{0..3}
      OsAlarmAccessingApplication = SystemApplication_OsCore5
      OsAlarmAction
        OsAlarmActivateTask: OsAlarmActivateTaskRef=ApplTask_Core4
    ApplTask_Core5 (OsTask):
      OsTaskActivation = 1
      OsTaskPriority = 50
      OsTaskSchedule = FULL
      OsTaskAccessingApplication = SystemApplication_OsCore{0..4}
    Rte_Al_TE_CtLed5Type_Led5BlinkRunnable (OsAlarm):
      OsAlarmCounterRef = SystemTimer_Core5
      OsAlarmAccessingApplication = SystemApplication_OsCore{0..4}
      OsAlarmAction
        OsAlarmActivateTask: OsAlarmActivateTaskRef=ApplTask_Core5
    SchMTask_Core0 (OsTask):
      OsTaskActivation = 1
      OsTaskPriority = 20
      OsTaskSchedule = FULL
      OsTaskEventRef = Rte_Ev_Cyclic2_SchMTask_Core0_0_10ms
      OsTaskEventRef = Rte_Ev_Cyclic2_SchMTask_Core0_0_20ms
      OsTaskEventRef = Rte_Ev_Run_CanTp_CanTp_MainFunction
      OsTaskAccessingApplication = SystemApplication_OsCore{1..5}
    3 x OsAlarm, all with OsAlarmCounterRef=SystemTimer_Core0, OsAlarmAccessingApplication=SystemApplication_OsCore1, OsAlarmAccessingApplication=SystemApplication_OsCore2, OsAlarmAccessingApplication=SystemApplication_OsCore3, OsAlarmAccessingApplication=SystemApplication_OsCore4, OsAlarmAccessingApplication=SystemApplication_OsCore5:
      Rte_Al_TE2_SchMTask_Core0_0_10ms
        OsAlarmAction
          OsAlarmSetEvent: OsAlarmSetEventRef=Rte_Ev_Cyclic2_SchMTask_Core0_0_10ms, OsAlarmSetEventTaskRef=SchMTask_Core0
      Rte_Al_TE2_SchMTask_Core0_0_20ms
        OsAlarmAction
          OsAlarmSetEvent: OsAlarmSetEventRef=Rte_Ev_Cyclic2_SchMTask_Core0_0_20ms, OsAlarmSetEventTaskRef=SchMTask_Core0
      Rte_Al_TE_CanTp_CanTp_MainFunction
        OsAlarmAction
          OsAlarmSetEvent: OsAlarmSetEventRef=Rte_Ev_Run_CanTp_CanTp_MainFunction, OsAlarmSetEventTaskRef=SchMTask_Core0
    SchMTask_Core1 (OsTask):
      OsTaskActivation = 1
      OsTaskPriority = 20
      OsTaskSchedule = FULL
      OsTaskAccessingApplication = SystemApplication_OsCore0
      OsTaskAccessingApplication = SystemApplication_OsCore{2..5}
    Rte_Al_TE1_EcuM_EcuM_MainFunction (OsAlarm):
      OsAlarmCounterRef = SystemTimer_Core1
      OsAlarmAccessingApplication = SystemApplication_OsCore0
      OsAlarmAccessingApplication = SystemApplication_OsCore{2..5}
      OsAlarmAction
        OsAlarmActivateTask: OsAlarmActivateTaskRef=SchMTask_Core1
    SchMTask_Core2 (OsTask):
      OsTaskActivation = 1
      OsTaskPriority = 20
      OsTaskSchedule = FULL
      OsTaskAccessingApplication = SystemApplication_OsCore0
      OsTaskAccessingApplication = SystemApplication_OsCore1
      OsTaskAccessingApplication = SystemApplication_OsCore{3..5}
    Rte_Al_TE2_EcuM_EcuM_MainFunction (OsAlarm):
      OsAlarmCounterRef = SystemTimer_Core2
      OsAlarmAccessingApplication = SystemApplication_OsCore0
      OsAlarmAccessingApplication = SystemApplication_OsCore1
      OsAlarmAccessingApplication = SystemApplication_OsCore{3..5}
      OsAlarmAction
        OsAlarmActivateTask: OsAlarmActivateTaskRef=SchMTask_Core2
    SchMTask_Core3 (OsTask):
      OsTaskActivation = 1
      OsTaskPriority = 20
      OsTaskSchedule = FULL
      OsTaskAccessingApplication = SystemApplication_OsCore{0..2}
      OsTaskAccessingApplication = SystemApplication_OsCore4
      OsTaskAccessingApplication = SystemApplication_OsCore5
    Rte_Al_TE3_EcuM_EcuM_MainFunction (OsAlarm):
      OsAlarmCounterRef = SystemTimer_Core3
      OsAlarmAccessingApplication = SystemApplication_OsCore{0..2}
      OsAlarmAccessingApplication = SystemApplication_OsCore4
      OsAlarmAccessingApplication = SystemApplication_OsCore5
      OsAlarmAction
        OsAlarmActivateTask: OsAlarmActivateTaskRef=SchMTask_Core3
    SchMTask_Core4 (OsTask):
      OsTaskActivation = 1
      OsTaskPriority = 20
      OsTaskSchedule = FULL
      OsTaskAccessingApplication = SystemApplication_OsCore{0..3}
      OsTaskAccessingApplication = SystemApplication_OsCore5
    Rte_Al_TE5_EcuM_EcuM_MainFunction (OsAlarm):
      OsAlarmCounterRef = SystemTimer_Core4
      OsAlarmAccessingApplication = SystemApplication_OsCore{0..3}
      OsAlarmAccessingApplication = SystemApplication_OsCore5
      OsAlarmAction
        OsAlarmActivateTask: OsAlarmActivateTaskRef=SchMTask_Core4
    SchMTask_Core5 (OsTask):
      OsTaskActivation = 1
      OsTaskPriority = 20
      OsTaskSchedule = FULL
      OsTaskAccessingApplication = SystemApplication_OsCore{0..4}
    Rte_Al_TE6_EcuM_EcuM_MainFunction (OsAlarm):
      OsAlarmCounterRef = SystemTimer_Core5
      OsAlarmAccessingApplication = SystemApplication_OsCore{0..4}
      OsAlarmAction
        OsAlarmActivateTask: OsAlarmActivateTaskRef=SchMTask_Core5
    3 x OsEvent:
      Rte_Ev_Cyclic2_SchMTask_Core0_0_10ms
      Rte_Ev_Cyclic2_SchMTask_Core0_0_20ms
      Rte_Ev_Run_CanTp_CanTp_MainFunction
    6 x OsApplication, all with OsTrusted=true:
      SystemApplication_OsCore0: OsAppTaskRef=ApplTask_Core0, OsAppAlarmRef=Os/Rte_Al_TE_CtLed0Type_Led0BlinkRunnable, OsAppTaskRef=SchMTask_Core0, OsAppAlarmRef=Os/Rte_Al_TE2_SchMTask_Core0_0_10ms, OsAppAlarmRef=Os/Rte_Al_TE2_SchMTask_Core0_0_20ms, OsAppAlarmRef=Os/Rte_Al_TE_CanTp_CanTp_MainFunction
      SystemApplication_OsCore{1..3}: OsAppTaskRef=ApplTask_Core{1..3}, OsAppAlarmRef=Os/Rte_Al_TE_CtLed{1..3}Type_Led{1..3}BlinkRunnable, OsAppTaskRef=SchMTask_Core{1..3}, OsAppAlarmRef=Os/Rte_Al_TE{1..3}_EcuM_EcuM_MainFunction
      SystemApplication_OsCore4: OsAppTaskRef=ApplTask_Core4, OsAppAlarmRef=Os/Rte_Al_TE_CtLed4Type_Led4BlinkRunnable, OsAppTaskRef=SchMTask_Core4, OsAppAlarmRef=Os/Rte_Al_TE5_EcuM_EcuM_MainFunction
      SystemApplication_OsCore5: OsAppTaskRef=ApplTask_Core5, OsAppAlarmRef=Os/Rte_Al_TE_CtLed5Type_Led5BlinkRunnable, OsAppTaskRef=SchMTask_Core5, OsAppAlarmRef=Os/Rte_Al_TE6_EcuM_EcuM_MainFunction
    Rte_Spinlock_sig_RearInteriorLight_omsg_Transmit_oCAN00_49a633c1_Tx (OsSpinlock):
      OsSpinlockLockMethod = LOCK_CAT2_INTERRUPTS
      OsSpinlockAccessingApplication = SystemApplication_OsCore0
      OsSpinlockAccessingApplication = SystemApplication_OsCore4
  module config EcuC
  ecuc value collection DaVinci_Project: ecuc-values=[Com, Rte, Os, EcuC, NvM]
