AUTOSAR XML (schema 4-0-3)
package /MICROSAR
  bsw implementation vDem42_Impl: programming-language=C, sw-version=1.2.0, vendor-id=30, ar-release-version=4.2.2, vendor-specific-module-def=vDem42
  module definition vDem42 [0..1]: category=VENDOR_SPECIFIC_MODULE_DEFINITION, variants pre-compile  # Configuration of the vDem42 module.
