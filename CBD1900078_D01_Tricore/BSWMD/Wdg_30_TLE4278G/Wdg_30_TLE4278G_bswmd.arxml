AUTOSAR XML (schema 4-0-3)
# COPYRIGHT
# Copyright (c) 2017 by Vector Informatik GmbH. All rights reserved.
# This software is copyright protected and proprietary to Vector Informatik GmbH.
# Vector Informatik GmbH grants to you only those rights as set out in the license conditions.
package /MICROSAR/Wdg_30_TLE4278G
  module definition Wdg [0..*]: category=VENDOR_SPECIFIC_MODULE_DEFINITION, refined-module-def=Wdg, variants pre-compile  # Configuration of the Wdg (Watchdog driver) module.
    container WdgDemEventParameterRefs  # This container includes the references to DemEventParameter elements which shall be invoked using the API Dem_ReportErrorStatus in case the corresponding error occurs. The EventId is taken from the referenced DemEventParameter's DemEventId value.
      choice reference WDG_E_DISABLE_REJECTED: set at pre-compile, destination=[DemEventParameter, DemEventParameter]  # Reference to the DemEventParameter which shall be issued when the error "Initialization or mode switch failed because it would disable the watchdog" has occurred.
      choice reference WDG_E_MODE_FAILED: set at pre-compile, destination=[DemEventParameter, DemEventParameter]  # Reference to the DemEventParameter which shall be issued when the error "Setting a watchdog mode failed (during initialization or mode switch)" has occurred.
    container WdgGeneral  # General configuration parameters of the Wdg.
      boolean WdgDevErrorDetect: set at pre-compile, default-value=true  # This parameter specifies defines whether development error detection for this module is enabled or disabled. True: Development error detection enabled False: Development error detection disabled
      boolean WdgDisableAllowed: set at pre-compile, default-value=false  # This parameter specifies whether disabling the watchdog driver can be disabled during runtime. True: Disabling the watchdog driver at runtime is allowed. False: Disabling the watchdog driver at runtime is not allowed.
      integer WdgIndex: 0..255, set at pre-compile, symbolic-name-value=true  # This value specifies the watchdog driver's ID so that it can be referenced by the watchdog interface.
      float WdgInitialTimeout: 0..65.535, set at pre-compile  # This values specifies the initial timeout for the trigger condition to be initialized during Init function. It shall be not larger than WdgMaxTimeout.
      float WdgMaxTimeout: 0..65.535, set at pre-compile  # This value specifies the maximum timeout to which the watchdog trigger condition can be initialized.
      enumeration WdgRunArea: {RAM, ROM}, set at pre-compile  # Not used. This parameter defines whether the watchdog driver execution area is either from ROM(Flash) or RAM as required with the particular microcontroller. RAM: Watchdog driver runs from RAM. ROM: Watchdog driver runs from ROM.
      function name WdgTriggerLocation: set at pre-compile, default-value=Wdg_30_TLE4278G_Cbk_GptNotificationTrigger  # This parameter defines the location (memory address) of the watchdog trigger routine. Not used.
      boolean WdgVersionInfoApi: set at pre-compile, default-value=false  # This parameter enables/disables the function Wdg_30_TLE4278G_GetVersionInfo() to get major, minor and patch version information. True: VersionInfoApi is enabled. False: VersionInfoApi is disabled.
      string WdgUserConfigFile [0..1]: set at pre-compile, origin=Vector Informatik  # Reference to an external text file that will be included during generation to Wdg_30_TLE4278G_Cfg.h. The content of the user configuration file will be added at the end of the generated module configuration file and allows altering or extending the generated code. Caution: User configuration files can cause the software module to malfunction and must only be used with great care!
    container WdgPublishedInformation  # This container includes all Wdg specific published information parameters
      enumeration WdgTriggerMode: {WDG_BOTH, WDG_TOGGLE, WDG_WINDOW}, set at published-information, default-value=WDG_BOTH  # This parameter defines the watchdog trigger mode (toggle/window/both) WDG_TOGGLE: Toggle trigger mode is used. WDG_WINDOW: Window trigger mode is used. WDG_BOTH: Both watchdog trigger modes are used. Not used.
    container WdgSettingsConfig: multiple-configuration-container=true  # This container includes the configuration items for the different watchdog settings, including those for external watchdog hardware.
      enumeration WdgDefaultMode: {WDGIF_FAST_MODE, WDGIF_OFF_MODE, WDGIF_SLOW_MODE}, set at pre-compile  # This parameter defines the default mode for watchdog driver initialization. WDGIF_FAST_MODE: Watchdog driver is set to WDGIF_FAST_MODE during initialization. WDGIF_OFF_MODE: Watchdog driver is set to WDGIF_OFF_MODE during initialization. WDGIF_SLOW_MODE: Watchdog driver is set to WDGIF_SLOW_MODE during initialization.
      container WdgExternalConfiguration [0..1]  # This container includes the configuration items for an external watchdog hardware.
        choice reference WdgExternalContainerRef [0..1]: set at pre-compile, destination=[DioChannelGroup, SpiSequence]  # Reference to either a DioChannelGroup or an SpiSequence. Not used.
        choice reference WdgTriggerPinRef: set at pre-compile, origin=Vector Informatik, destination=WdgDioPins  # Reference to WdgDioPin which is used to trigger the external watchdog peripheral.
      container WdgGptChannelParameterRef  # Container includes Gpt specific settings.
        float WdgTriggerTimerFreq: 0..1.7976931348623157E+308, set at pre-compile, origin=Vector Informatik  # This values specifies the frequency of GptChannel reference WdgTriggerTimer in Hz.
        integer WdgTickValueMax: 1..18446744073709551615, set at pre-compile, origin=Vector Informatik  # This value specifies the maximum value in ticks, the timer channel is able to count. With the next tick, the timer overflows and rolls over to zero.
        choice reference WdgTriggerTimer: set at pre-compile, origin=Vector Informatik, destination=GptChannelConfiguration  # Reference to GptChannel that is used to time watchdog triggering.
      container WdgSettingsFast  # This container includes hardware dependent settings for the watchdog driver's "fast" mode.
        float WdgTriggerTimeFast: set at pre-compile, origin=Vector Informatik  # This value specifies the trigger period for WDGIF_FAST_MODE.
        float WdgDutyCycle: 0..100, set at pre-compile, origin=Vector Informatik, default-value=50  # This value specifies the duty-cycle of the trigger signal during WDGIF_FAST_MODE. It allows influencing the trigger pulse during the trigger period.
        choice reference WdgDioModeSettingsRef [0..1]: set at pre-compile, origin=Vector Informatik, destination=WdgDioModeSettings  # Reference to WdgDioModeSetting. The referenced mode specific settings (e.g. setting specified levels of mode pins) is applied during transition to WDGIF_FAST_MODE.
      container WdgSettingsSlow  # This container includes hardware dependent settings for the watchdog driver's "slow" mode.
        float WdgTriggerTimeSlow: set at pre-compile, origin=Vector Informatik  # This value specifies the trigger period for WDGIF_SLOW_MODE.
        float WdgDutyCycle: set at pre-compile, origin=Vector Informatik, default-value=50  # This value specifies the duty-cycle of the trigger signal during WDGIF_SLOW_MODE. It allows influencing the trigger pulse during the trigger period.
        choice reference WdgDioModeSettingsRef [0..1]: set at pre-compile, origin=Vector Informatik, destination=WdgDioModeSettings  # Reference to WdgDioModeSetting. The referenced mode specific settings (e.g. setting specified levels of mode pins) is applied during transition to WDGIF_SLOW_MODE. Note: WDGIF_SLOW_MODE only is available in case this reference is configured.
      container WdgSettingsOff  # This container includes hardware dependent settings for the watchdog driver's "off" mode.
        choice reference WdgDioModeSettingsRef [0..1]: set at pre-compile, origin=Vector Informatik, destination=WdgDioModeSettings  # Reference to WdgDioModeSetting. The referenced mode specific settings (e.g. setting specified levels of mode pins) is applied during transition to WDGIF_OFF_MODE.
    container WdgAsr3Compatibility [0..1]  # This container includes ASR3-specific configuration. Note: ASR3-compatibility mode is enabled in case this container exists.
      float WdgTriggerTimeout: 0..65.535, set at pre-compile, origin=Vector Informatik  # This value specifies the timeout for the trigger condition to be set every time when Wdg_Trigger is called.
    container WdgDeviceConfig [1..*]  # This container includes configurations for specific external watchdog peripherals.
      container WdgDioPins [1..*]  # This container includes the pin configuration for an external watchdog peripheral.
        enumeration WdgInitialLevel [0..1]: {STD_LOW, STD_HIGH}, set at pre-compile, origin=Vector Informatik  # This parameter defines the polarity of the trigger pin (referenced in WdgTriggerPinRef). It determines the physical level which is set during initialization. STD_HIGH: Trigger pin is set to physical level HIGH during initialization. (First transition will be a falling edge to LOW.) STD_LOW: Trigger pin is set to physical level LOW during initialization. (First transition will be a rising edge to HIGH.) Note: This parameter only is required in case the WdgDioPin is configured as trigger pin (Referenced in WdgTriggerPinRef).
        choice reference WdgDioPinChannelRef [0..1]: set at pre-compile, origin=Vector Informatik, destination=[DioChannel, DioChannel]  # Reference to DioChannel connected to watchdog input/trigger pin.
      container WdgDioModeSettings [0..*]  # This container includes the mode specific configuration for external watchdog peripheral.
        boolean WdgEnableIrreversible [0..1]: set at pre-compile, origin=Vector Informatik, default-value=false  # This parameter defines whether the enabling of the watchdog hardware is irreversible. In case the connected hardware can not be disabled once it was enabled (set to/initialized with WDGIF_FAST_MODE or WDGIF_SLOW_MODE) the value has to be set to TRUE. TRUE: Enabling the watchdog is irreversible. FALSE: Disabling the watchdog again is possible. Note: This parameter only is relevant in case the this WdgDioModeSettings container is referenced from WdgSettingsOff.
        container WdgDioModeLevels [0..*]  # This container includes the assignment between a WdgDioPin and a physical levels for a specific mode setting.
          enumeration WdgDioPinModeLevel [0..1]: {STD_HIGH, STD_LOW}, set at pre-compile, origin=Vector Informatik  # This parameter defines the physical level which is set at the related pin (WdgDioPinChannelRef) STD_HIGH: Related pin is set to physical level HIGH during initialization. STD_LOW: Related pin is set to physical level HIGH during initialization. Note: Depended on the used hardware derivative this value may vary. (E.g. SII S19400A/B/C/G/H/I require STD_HIGH on Pin WEN to enable the watchdog, S19400D/E/F/J/K/L require STD_LOW on Pin WEN to enable the watchdog.)
          choice reference WdgDioPinRef: set at pre-compile, origin=Vector Informatik, destination=WdgDioPins  # Reference to WdgDioPin.
  bsw implementation Wdg_Impl: programming-language=C, sw-version=4.00.00, used-code-generator=DaVinci Configurator, vendor-id=30, ar-release-version=4.00.03, behavior=Wdg_30_TLE4278GBehavior, preconfigured-configuration=Wdg_Pre, recommended-configuration=Wdg_Rec, vendor-api-infix=TLE4278G, vendor-specific-module-def=Wdg
  module config Wdg_Pre: definition=Wdg
  module config Wdg_Rec: definition=Wdg
    5 x WdgDeviceConfig:
      MAX6369
        4 x WdgDioPins:
          Max6369_PinSet{0..2}
          Max6369_PinWdi: WdgInitialLevel=STD_HIGH
        3 x WdgDioModeSettings:
          Max6369_10ms
            3 x WdgDioModeLevels:
              Set0: WdgDioPinModeLevel=STD_LOW, WdgDioPinRef=Max6369_PinSet0
              Set1: WdgDioPinModeLevel=STD_LOW, WdgDioPinRef=Max6369_PinSet1
              Set2: WdgDioPinModeLevel=STD_HIGH, WdgDioPinRef=Max6369_PinSet2
          Max6369_30ms
            3 x WdgDioModeLevels:
              Set0: WdgDioPinModeLevel=STD_LOW, WdgDioPinRef=Max6369_PinSet0
              Set1: WdgDioPinModeLevel=STD_HIGH, WdgDioPinRef=Max6369_PinSet1
              Set2: WdgDioPinModeLevel=STD_LOW, WdgDioPinRef=Max6369_PinSet2
          Max6369_Disabled
            3 x WdgDioModeLevels:
              Set0: WdgDioPinModeLevel=STD_LOW, WdgDioPinRef=Max6369_PinSet0
              Set1: WdgDioPinModeLevel=STD_HIGH, WdgDioPinRef=Max6369_PinSet1
              Set2: WdgDioPinModeLevel=STD_HIGH, WdgDioPinRef=Max6369_PinSet2
      TLE4278G
        TLE4278G_WDI (WdgDioPins): WdgInitialLevel=STD_HIGH
      S19400
        S19400_Enabled (WdgDioModeSettings)
          S19400_WEN (WdgDioModeLevels): WdgDioPinModeLevel=STD_HIGH, WdgDioPinRef=S19400/S19400_WEN
        S19400_WDI (WdgDioPins)
        S19400_WEN (WdgDioPins)
        S19400_Disabled (WdgDioModeSettings)
          S19400_WEN (WdgDioModeLevels): WdgDioPinModeLevel=STD_LOW, WdgDioPinRef=S19400/S19400_WEN
      TLE7368
        TLE7368_WDI (WdgDioPins): WdgInitialLevel=STD_HIGH
        TLE7368_DISABLE (WdgDioModeSettings): WdgEnableIrreversible=1
          TLE7368_WDI (WdgDioModeLevels): WdgDioPinModeLevel=STD_HIGH, WdgDioPinRef=TLE7368/TLE7368_WDI
        TLE7368_ENABLE (WdgDioModeSettings)
          TLE7368_WDI (WdgDioModeLevels): WdgDioPinModeLevel=STD_LOW, WdgDioPinRef=TLE7368/TLE7368_WDI
      TPS383x
        TPS383x_WDI (WdgDioPins)
