AUTOSAR XML (schema 4-0-3)
package /MICROSAR
  module definition Rtm: category=VENDOR_SPECIFIC_MODULE_DEFINITION, variants pre-compile/link-time  # Configuration of the RTM (Runtime Measurement) module.
    container RtmGeneral  # General configuration parameters of the RTM.
      boolean RtmDevErrorDetect: set at pre-compile, origin=Vector Informatik, default-value=true  # This parameter switches the Development Error Detection and Notification ON or OFF. true: Development error detection is enabled. false: Development error detection is disabled. Note: In general, the development error detection is recommended during pre-test phase. It is not recommended to enable the development error detection in production code due to increased runtime and ROM needs.
      string RtmGetMeasurementTimestampFct: set at pre-compile, origin=Vector Informatik, default-value=Rtm_GetTimeMeasurement  # Name of the function or macro that shall be used by RTM to acquire the current value of a hardware counter. The prototype will be defined in Rtm_Cbk.h. This function has to be provided by the application. Prototype: Rtm_TimestampType Rtm_GetTimeMeasurement(void); The return type Rtm_TimestampType depends on the parameter Rtm32BitTimer.
      integer RtmMeasurementCtrFrequency: 1..4294967295, set at pre-compile, origin=Vector Informatik, default-value=10000  # Number of ticks per [ms] provided by the hardware timer. The frequency of the hardware timer used to acquire measurement timestamps has to be adjusted to provide a compromise between accuracy and maximal measurement duration. A value of 10000 ticks per [ms] is recommended. A higher frequency results in higher measurement accuracy but will also shorten the period which can be measured.
      enumeration RtmCtrDirection: set at pre-compile, origin=Vector Informatik, default-value=RTM_UP  # Defines the counting direction of the hardware counter: -RTM_UP: 0 to MAXVAL -RTM_DOWN: MAXVAL to 0
        RTM_UP  # Upwards
        RTM_DOWN  # Downwards
      float RtmMainfunctionCycleTime: 0.001..1, set at pre-compile, origin=Vector Informatik, default-value=0.01  # Cycle time of RTM main function. A value of 0.01 [s] is recommended. Lower values result in higher update-rates during live measurement but also require more bandwidth to transmit the measurement results. Higher values may lead to erroneous results if the main function’s cycle time has a jitter larger than a half of the hardware counters cycle time.
      string RtmUserConfigFile [0..1]: set at pre-compile, origin=Vector Informatik  # A configuration file is generated by Cfg5. If you want to overwrite settings in the generated configuration file, you can specify a path to a user defined configuration file. Note: The user defined configuration file will be included at the end of the generated file. Therefore definitions in the user defined configuration file can overwrite definitions in the generated configuration file. The contents of the user defined configuration file is copied to the end of <Bsw>_Cfg.h.
      integer RtmTaskSwitchOverhead: 0..5000, set at pre-compile, origin=Vector Informatik, default-value=0  # This parameter defines the duration in [µs] needed for OS task switches.
      integer RtmInterruptCallOverhead: 0..5000, set at pre-compile, origin=Vector Informatik, default-value=0  # This parameter defines the time span between task switch and call of the ISR Category 2 hook function in [µs].
      enumeration RtmCpuLoadControlMode: {Off, C_API, Xcp}, set at pre-compile in variant link-time / link in variant pre-compile, origin=Vector Informatik, default-value=Off  # Define how the Cpu load is measured and the measurement is controlled. If set to "Off", the Cpu load measurement is deactivated. If set to "C_API", the Cpu load measurement is started and stopped and the results are requested with C APIs. If set to "Xcp", the Cpu load is measured by a measurement point. This measurement point can be activated like all other measurement points. Hint: If set to "Xcp", a measurement point called "Rtm_CpuLoadMeasurement" has to exist and must be enabled in order to measure the overall CPU load. Please note that this measurement point should not be called by an application.
      boolean RtmTimerOverrunSupport: set at pre-compile, origin=Vector Informatik, default-value=false  # This parameter switches the Support for Timer Overruns ON or OFF. true: Timer Overrun Handling is enabled. false: Timer Overrun Handling is disabled.
      boolean Rtm32BitTimer: set at pre-compile, origin=Vector Informatik, default-value=false  # Specifies if 32bit timer is used. If set to true: a 32bit timer is used If set to false: a 16bit timer is used
      boolean RtmMulticoreSupport: set at pre-compile, origin=Vector Informatik, default-value=false  # If set to true: measurement on multiple cores is supported If set to false: measurement on one core is supported
      boolean RtmUseNestingCounter: set at pre-compile, origin=Vector Informatik, default-value=true  # The nesting counter is used to detect successive activation of a measurement point before stopping.
      integer RtmUsedCoreMask: 1..65535, set at pre-compile, origin=Vector Informatik, default-value=1  # Specifies selection of cores to be measured. This parameter must not be changed! It is calculated automatically.
      boolean RtmControl: set at pre-compile, origin=Vector Informatik, default-value=false  # If enabled the global variable Rtm_ControlState is provided which allows disabling and enabling the RTM functionality during runtime. The feature may be used to prevent unintended RTM activity by disabling the functionality on a special trigger. If this option is disabled RTM will always be activated in the ECU.
      boolean RtmSafeBswChecks: set at pre-compile, origin=Vector Informatik, default-value=false  # Selects if safety checks are used. These checks improve robustness as e.g. invalid parameters are checked before function is executed. This attribute has to be enabled for safety projects where this component is mapped to an ASIL partition.
      string RtmEcuName: set at pre-compile, origin=Vector Informatik, default-value=Rtm, max-length=50, min-length=1  # This parameter specifies the ECU name within the XCP settings of CANoe.
    container RtmMeasurementPoint [0..*]  # Each measurement point describes one code area whose runtime shall be measured using the RTM module.
      boolean RtmAutostartEnabled: set at pre-compile, origin=Vector Informatik, default-value=false  # Defines if this measurement shall be activated during ECU startup automatically. Autostart may be used for init-functions which are called only during the startup-phase the communication stack, XCP and RTM module are activated. Note: Each autostart measurement causes CPU-load. It is therefore advised to activate autostart only when it is required.
      boolean RtmMeasurementEnabled: set at pre-compile, origin=Vector Informatik, default-value=true  # This parameter defines the availability of a measurement section during pre-compile time. If disabled, the measurement points of this section will be generated as empty macros. Hence this measurement section requires no memory- or runtime resources. Since the measurement settings are still part of the ECU configuration, the measurement enabled settings can be changed later.
      integer RtmRuntimeThreshold [0..1]: 0..65535, set at pre-compile, origin=Vector Informatik  # Threshold alarm time If the current runtime of this measurement section exceeds the time specified, a callback function is called. The threshold alarm is inactive if this parameter is not defined or set to 0.
      string RtmMeasurementGroup [0..1]: configuration-class-affection=affection-kind=NO-AFFECT, set at pre-compile, origin=Vector Informatik, default-value=Default  # The name can be used to organize measurement sections into groups by defining a unique group name. The groups will be visible in CANoe and the generated measurement report.
      boolean RtmDisableInterrupts: configuration-class-affection=affection-kind=NO-AFFECT, set at pre-compile, origin=Vector Informatik, default-value=false  # Defines if interrupts are locked during measurement. If enabled, RTM locks interrupts during measurement using the critical section RTM_EXCLUSIVE_AREA_0. This results in more accurate measurement results but will increase the time spent with locked interrupt.
      integer RtmMeasurementId: 0..65535, set at pre-compile, origin=Vector Informatik, symbolic-name-value=true, default-value=0  # This ID defines the measurement object
      integer RtmAssignedToCore [0..1]: 0..65535, set at pre-compile, origin=Vector Informatik  # Defines on which core the measurement point is running. If not defined the measurement point may measure runtime between two cores, in multi core systems.
      enumeration RtmMeasurementType: {ResponseTime, ExecutionTime_Nested, ExecutionTime_NonNested}, set at pre-compile, origin=Vector Informatik, default-value=ResponseTime  # The measurement type defines the measurement behavior of this measurement point. If set to ResponseTime: - Measures the absolute time between measurement start and stop. If set to ExecutionTime_NonNested: - Measures like ResponseTime minus interruptions by task or ISR. If set to ExecutionTime_Nested: - Measures like ExecutionTime_NonNested minus the execution time of nested measurement points.
  bsw implementation Rtm_Impl: programming-language=C, sw-version=3.01.03, used-code-generator=DaVinci Configurator, vendor-id=30, ar-release-version=4.2.2, behavior=RtmBehavior, preconfigured-configuration=Rtm_Pre, recommended-configuration=Rtm_Rec, vendor-specific-module-def=Rtm
  module config Rtm_Pre: definition=Rtm
  module config Rtm_Rec: definition=Rtm
