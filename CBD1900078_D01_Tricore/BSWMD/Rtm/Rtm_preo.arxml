AUTOSAR XML (schema 4-1-1)
package /MICROSAR
  module config Rtm_Rec: definition=Rtm, implementation-config-variant=VARIANT-PRE-COMPILE
