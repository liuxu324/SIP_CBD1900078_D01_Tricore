AUTOSAR XML (schema 4-2-1)
package /MICROSAR
  module config Os_Rec: definition=Os
    OsMemoryProtection
      4 x OsMemoryRegion:
        EXC_ALL_Core0: OsMemoryRegionStartAddress=0, OsMemoryRegionEndAddress=0xFFFFFFFF, OsMemoryRegionProtectionUnit=OsPhysicalCore0CodeMpu, OsMemoryRegionAccessRights=PS0_X, OsMemoryRegionAccessRights=PS1_X, OsMemoryRegionAccessRights=PS2_X, OsMemoryRegionAccessRights=PS3_X
        READ_ALL_Core0: OsMemoryRegionStartAddress=0, OsMemoryRegionEndAddress=0xFFFFFFFF, OsMemoryRegionProtectionUnit=OsPhysicalCore0DataMpu, OsMemoryRegionAccessRights=PS0_R, OsMemoryRegionAccessRights=PS1_R, OsMemoryRegionAccessRights=PS2_R, OsMemoryRegionAccessRights=PS3_R
        TRUSTED_WRITE_SPR_Core0: OsMemoryRegionEndAddress=0x7FFFFFFF, OsMemoryRegionStartAddress=_OS_CORE0_STACKS_END, OsMemoryRegionProtectionUnit=OsPhysicalCore0DataMpu, OsMemoryRegionAccessRights=PS0_W
        TRUSTED_WRITE_ALL_Core0: OsMemoryRegionStartAddress=0x80000000, OsMemoryRegionEndAddress=0xFFFFFFFF, OsMemoryRegionProtectionUnit=OsPhysicalCore0DataMpu, OsMemoryRegionAccessRights=PS0_W
    OsOS: OsScalabilityClass=SC3
