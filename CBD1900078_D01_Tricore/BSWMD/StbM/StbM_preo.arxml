AUTOSAR XML (schema 4-0-3)
package /MICROSAR
  module config StbM_Pre: definition=StbM
  module config StbM_Rec: definition=StbM, implementation-config-variant=VARIANT-PRE-COMPILE
    StbMGeneral: StbMDevErrorDetect=1, StbMVersionInfo=0
  module config StbM_Rec_Class1: definition=StbM
    StbMTriggeredCustomer: StbMUseGlobalTimeServicePort=1, StbMUseSyncStateServicePort=1
