AUTOSAR XML (schema 4-0-3)
# COPYRIGHT
# Copyright (c) 2017 by Vector Informatik GmbH. All rights reserved.
# This software is copyright protected and proprietary to Vector Informatik GmbH.
# Vector Informatik GmbH grants to you only those rights as set out in the license conditions.
package /MICROSAR/LinTrcv_30_Tle7259
  module definition LinTrcv [0..1]: category=VENDOR_SPECIFIC_MODULE_DEFINITION, refined-module-def=LinTrcv, variants pre-compile/post-build-selectable  # Configuration of LIN Transceiver Driver module
    container LinTrcvChannel [1..*]  # Container gives LIN transceiver driver information about a single LIN transceiver channel. Any LIN transceiver driver has such LIN transceiver channels.
      integer LinTrcvChannelId: 0..255, set at pre-compile, symbolic-name-value=true, default-value=0  # Unique identifier of the LIN Transceiver Channel.
      boolean LinTrcvChannelUsed: set at post-build in variant post-build-selectable / pre-compile in variant pre-compile, default-value=true  # Shall the related LIN transceiver channel be used? | True: Is used False Is not used
      enumeration LinTrcvInitState: {LINTRCV_TRCV_MODE_NORMAL, LINTRCV_TRCV_MODE_SLEEP, LINTRCV_TRCV_MODE_STANDBY}, set at post-build in variant post-build-selectable / pre-compile in variant pre-compile, default-value=LINTRCV_TRCV_MODE_NORMAL  # State of LIN transceiver after call to LinTrcv_Init.
      boolean LinTrcvWakeupByBusUsed: set at post-build in variant post-build-selectable / pre-compile in variant pre-compile, default-value=false  # If LIN transceiver hardware does not support wake up by bus value is always FALSE. If LIN transceiver hardware supports wake up by bus value is TRUE or FALSE depending whether it is used or not. | TRUE = Is used. FALSE = Is not used.
      boolean LinTrcvWakeupByPinUsed: set at post-build in variant post-build-selectable / pre-compile in variant pre-compile, origin=Vector Informatik, default-value=false  # If LIN transceiver hardware does not support wake up by pin value is always FALSE. If LIN transceiver hardware supports wake up by pin value is TRUE or FALSE depending whether it is used or not.
      boolean LinTrcvSleepInitWorkaround: set at pre-compile, origin=Vector Informatik, default-value=false  # Some transceivers cannot be initialized in sleep mode after power on. When enabled and if the channel init state is set to sleep, the driver will set the transceiver to normal mode then to sleep mode. The TX pin level must remain high during the operation to avoid dominant spikes on the LIN bus.
      symbolic name reference LinTrcvIcuChannelRef [0..1]: set at pre-compile, destination=IcuChannel  # Reference to the IcuChannel to enable/disable the interrupts for wakeups.
      symbolic name reference LinTrcvWakeupSourceRef [0..1]: set at post-build in variant post-build-selectable / pre-compile in variant pre-compile, destination=EcuMWakeupSource  # Reference to a wakeup source in the EcuM configuration. This reference is only needed if LinTrcvWakeupByBusUsed is true. Implementation Type: reference to EcuM_WakeupSourceType.
      choice container LinTrcvAccess  # Container gives LIN transceiver driver access about a single LIN transceiver channel.
        container LinTrcvDioAccess [0..1]  # Container gives LIN transceiver driver information about accessing ports and port pins. In addition relation between LIN transceiver hardware pin names and Dio port access information is given. If a LIN transceiver hardware has no Dio interface, there is no instance of this container.
          string LinTrcvHardwareInterfaceName [0..1]: set at pre-compile  # not used, LinTrcvHardwareInterfaceName moved to LinDioChannelAccess under LinTrcvDioAccess choice container.
          choice reference LinTrcvDioSymRefName [0..1]: set at pre-compile, destination=[DioChannel, DioChannelGroup, DioPort]  # not used, LinTrcvDioSymRefName moved to LinDioChannelAccess under LinTrcvDioAccess choice container.
          container LinTrcvDioChannelAccess [1..*]  # This container includes the DIO channel access by single LIN transceiver channel.
            string LinTrcvHardwareInterfaceName: set at pre-compile, origin=Vector Informatik  # LIN transceiver hardware interface name. It is typically the name of a pin. From a Dio point of view it is either a port, a single channel or a channel group. Depending on this fact either LINTRCV_DIO_PORT_SYMBOLIC_NAME or LINTRCV_DIO_CHANNEL_SYMBOLIC_NAME or LINTRCV_DIO_CHANNEL_GROUP_SYMBOLIC_NAME shall reference a Dio configuration. The LIN transceiver driver implementation description shall list up this name for the appropriate LIN transceiver hardware.
            choice reference LinTrcvDioSymRefName: set at pre-compile, origin=Vector Informatik, destination=[DioChannel, DioChannelGroup, DioPort]  # Choice Reference to a DIO Port, DIO Channel or DIO Channel Group. This reference replaces the LINTRCV_DIO_PORT_SYM_NAME, LINTRCV_DIO_CHANNEL_SYM_NAME and LINTRCV_DIO_GROUP_SYM_NAME references in the Lin Trcv SWS.
        container LinTrcvSpiSequence [0..1]  # Container gives LIN transceiver driver information about one SPI sequence. | One SPI sequence used by LIN transceiver driver is in exclusive use for it. No other driver is allowed to access this sequence. LIN transceiver driver may use one sequence to access n LIN transceiver hardwares chips of the same type or n sequences are used to access one single LIN transceiver hardware chip. If a LIN transceiver hardware has no SPI interface, there is no instance of this container.
          symbolic name reference LinTrcvSpiSequenceName: set at pre-compile, destination=SpiSequence  # Reference to a Spi sequence configuration container.
        container LinTrcvSbcAccess [0..1]
          choice reference LinTrcvSbcPeripheralIdRef: set at pre-compile, origin=Vector Informatik, destination=SbcLinTrcvPeripheral  # Reference to the SBC peripheral that is being used by this LinTrcv channel.
    container LinTrcvGeneral  # Container gives LIN transceiver driver basic information.
      boolean LinTrcvDevErrorDetect: set at pre-compile, default-value=true  # Switches development error detection and notification on and off. If switched on, #define LINTRCV_DEV_ERROR_DETECT ON shall be generated. If switched off, #define LINTRCV_DEV_ERROR_DETECT OFF shall be generated. Define shall be part of file LinTrcv_Cfg.h. | True: Is used False: Is not used
      boolean LinTrcvGetVersionInfo: set at pre-compile, default-value=false  # Switches version information API on and off. If switched off, function need not be present in compiled code. | True: Is used False: Is not used
      integer LinTrcvIndex: 0..255, set at pre-compile, default-value=0  # Specifies the InstanceId of this module instance. If only one instance is present it shall have the Id 0.
      integer LinTrcvWaitCount: 0..4294967295, set at pre-compile, default-value=0  # Wait count for transceiver state changes.
      boolean LinTrcvWakeUpSupport: set at pre-compile, default-value=false  # Informs whether wake up is supported or not. In case wake up is not supported by LIN transceiver hardware the setting shall be false. The wake up ability may be switched on or off for each channel of one LIN transceiver by LinTrcvWakeupSourceRef. | True: Is used False: Is not used
      string LinTrcvUserConfigFile [0..1]: set at pre-compile, origin=Vector Informatik  # Reference to an external text file that will be included during generation to LinTrcv_Cfg.h. The content of the user configuration file will be added at the end of the generated module configuration file and allows altering or extending the generated code. Caution: User configuration files can cause the software module to malfunction and must only be used with great care.
      boolean LinTrcvSafeBswChecks: set at pre-compile, origin=Vector Informatik, default-value=false  # Selects if safety checks are used. These checks improve robustness as e.g. invalid parameters are checked before function is executed. This attribute has to be enabled for safety projects where this component is mapped to an ASIL partition.
  bsw implementation LinTrcv_Impl: programming-language=C, sw-version=6.02.00, used-code-generator=DaVinci Configurator, vendor-id=30, ar-release-version=4.00.03, behavior=LinTrcv_30_Tle7259Behavior, preconfigured-configuration=LinTrcv_Pre, recommended-configuration=LinTrcv_Rec, vendor-api-infix=Tle7259, vendor-specific-module-def=LinTrcv
  module config LinTrcv_Rec: definition=LinTrcv
  module config LinTrcv_Pre: definition=LinTrcv
  module config LinTrcv_Pre_Class1: definition=LinTrcv
    LinTrcvChannel
      LinTrcvAccess
        LinTrcvDioAccess
          3 x LinTrcvDioChannelAccess:
            PinEN: LinTrcvHardwareInterfaceName=DioPinEn
            PinRX: LinTrcvHardwareInterfaceName=DioPinRx
            PinTX: LinTrcvHardwareInterfaceName=DioPinTx  # DioPinTx
