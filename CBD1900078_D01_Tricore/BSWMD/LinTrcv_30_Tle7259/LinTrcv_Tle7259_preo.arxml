AUTOSAR XML (schema 4-0-3)
package /MICROSAR/LinTrcv_30_Tle7259
  module config LinTrcv_Rec: definition=LinTrcv, implementation-config-variant=VARIANT-PRE-COMPILE
