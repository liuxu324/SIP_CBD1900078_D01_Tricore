AUTOSAR XML (schema 4-0-2)
package /MICROSAR
  module config Crc_Rec: definition=Crc, implementation-config-variant=VARIANT-PRE-COMPILE
