AUTOSAR XML (schema 4-3-0)
package /MICROSAR
  bsw implementation vSet_Impl: programming-language=C, used-code-generator=DaVinci Configurator, vendor-id=30, ar-release-version=4.03.00, preconfigured-configuration=vSet_Pre, recommended-configuration=vSet_Rec, vendor-specific-module-def=vSet
  module definition vSet: category=VENDOR_SPECIFIC_MODULE_DEFINITION, post-build-variant-support=true, variants pre-compile  # Vector Common Settings
    container vSetGeneral: multiplicity set at pre-compile  # General parameters.
      enumeration vSetDummyStatementKind [0..1]: {None, VoidCast, SelfAssignment, UserDefined}, scope=ECU, multiplicity set at pre-compile, origin=Vector Informatik, set at pre-compile, default-value=None  # Dummy statements used to avoid compiler warnings about e.g. unused parameters.
    container vSetPlatform: multiplicity set at pre-compile  # General platform and compiler specific parameters.
      enumeration vSetByteOrder [0..1]: scope=ECU, multiplicity set at pre-compile, origin=Vector Informatik, set at pre-compile  # Byte order on memory level.
        BIG_ENDIAN  # Big Endian
        LITTLE_ENDIAN  # Little Endian
      enumeration vSetBitOrder [0..1]: scope=ECU, multiplicity set at pre-compile, origin=Vector Informatik, set at pre-compile  # Bit order on register level.
        LSB_to_MSB  # LSB to MSB
        MSB_to_LSB  # MSB to LSB
      enumeration vSetCPUType [0..1]: scope=ECU, multiplicity set at pre-compile, origin=Vector Informatik, set at pre-compile  # Register width of the CPU in bit.
        CPU8Bit  # 8 Bit
        CPU16Bit  # 16 Bit
        CPU32Bit  # 32 Bit
        CPU64Bit  # 64 Bit
      enumeration vSetSizeOfEnum [0..1]: scope=ECU, multiplicity set at pre-compile, origin=Vector Informatik, set at pre-compile  # Size of type enum in bit.
        Size8Bit  # 8 Bit
        Size16Bit  # 16 Bit
        Size32Bit  # 32 Bit
      enumeration vSetSizeOfInt [0..1]: scope=ECU, multiplicity set at pre-compile, origin=Vector Informatik, set at pre-compile  # Size of type int in bit.
        Size16Bit  # 16 Bit
        Size32Bit  # 32 Bit
      enumeration vSetSizeOfROMPointer [0..1]: scope=ECU, multiplicity set at pre-compile, origin=Vector Informatik, set at pre-compile  # Size of ROM pointer in bit.
        Size16Bit  # 16 Bit
        Size24Bit  # 24 Bit
        Size32Bit  # 32 Bit
        Size64Bit  # 64 Bit
      enumeration vSetSizeOfRAMPointer [0..1]: scope=ECU, multiplicity set at pre-compile, origin=Vector Informatik, set at pre-compile  # Size of RAM pointer in bit.
        Size16Bit  # 16 Bit
        Size24Bit  # 24 Bit
        Size32Bit  # 32 Bit
        Size64Bit  # 64 Bit
    container vSetCalibration: multiplicity set at pre-compile  # General calibration specific parameters.
      integer vSetPBCalibrationVirtualStartAddress [0..1]: 0..4294967295, scope=ECU, multiplicity set at pre-compile, origin=Vector Informatik, set at pre-compile, default-value=0  # Start address of the virtual memory segment for calibration of post-build loadable parameters. The memory segment is used by standard calibration tools like vCDMStudio to display and manage post-build loadable parameters in a physical representation. The segment is only available in the HEX-file and the data base of the calibration tool. It is not transferred to the ECU's memory. The address should not lie in the address range of the ECU. Recommended is an address beyond the ECU's address range because the virtual memory segment size depends on the concrete configuration and is calculated automatically.
  module config vSet_Pre: definition=vSet
  module config vSet_Rec: definition=vSet
