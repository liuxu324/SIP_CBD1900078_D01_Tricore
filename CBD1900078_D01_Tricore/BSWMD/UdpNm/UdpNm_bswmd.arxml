AUTOSAR XML (schema 4-1-1)
# COPYRIGHT
# Copyright (c) 2018 by Vector Informatik GmbH. All rights reserved.
# This software is copyright protected and proprietary to Vector Informatik GmbH.
# Vector Informatik GmbH grants to you only those rights as set out in the license conditions.
package /MICROSAR
  module definition UdpNm [0..1]: category=VENDOR_SPECIFIC_MODULE_DEFINITION, refined-module-def=UdpNm, variants pre-compile
    container UdpNmGlobalConfig  # Global configuration parameters of the UdpNm.
      boolean UdpNmBusSynchronizationEnabled: set at pre-compile, default-value=false  # This parameter defines if the bus synchronization support is enabled. This feature is rquired for gateway nodes only. This option allows the transmission of an asynchronous NM message at any time wihtin Network Mode. This may be required for the synchronized shutdown of networks. Therefore this option is usually only enabled in gateways. RESTRICTIONS: This parameter is derived from NmBusSynchronizationEnabled. This parameter is only relevant if UdpNmPassiveModeEnabled == false.
      boolean UdpNmComControlEnabled: set at pre-compile, default-value=false  # This parameter defines if the Communication Control support is enabled. If this option is enabled an additional API is available that allows to enable and disable the transmission of Network Management Messages in the Normal Operation state. While the transmission is disabled the network cannot be released. RESTRICTIONS: Derived from NmComControlEnabled.
      boolean UdpNmComUserDataSupport: set at pre-compile, default-value=false  # This parameter defines if the user data handling by a PDU handled within an upper layer is supported.
      boolean UdpNmCoordinatorEnabled: set at pre-compile, default-value=false  # This parameter defines if the coordinator support is enabled.
      integer UdpNmCoordinatorId: 0..3, set at pre-compile, default-value=0  # This value specifies the NM coordination ID for this gateway. IDs: 0x00: passive coordinator only 0x01 - 0x03: coordinator priority Value is only valid if UdpNmCoordinatorEnabled is enabled.
      boolean UdpNmCoordinatorSyncSupport: set at pre-compile, default-value=false  # This parameter defines if the coordinator synchronization support is enabled.
      boolean UdpNmDevErrorDetect: set at pre-compile, default-value=false  # This parameter switches the Development Error Detection and Notification ON or OFF. true: Development error detection is enabled. false: Development error detection is disabled. Note: In general, the development error detection is recommended during pre-test phase. It is not recommended to enable the development error detection in production code due to increased runtime and ROM needs. If it is enabled development errors are reported to the Development Error Tracer (Det). The following development errors are reported: - service call without intialization of network management - service call with invalid channel handle - service call with invalid PDU ID - reception of an NM PDU in Bus Sleep Mode - network timeout (i.e. the network management timoeut timer has timed out in Repeat Message State or Normal Operation State) - null pointer has been passed as argument
      boolean UdpNmImmediateRestartEnabled: set at pre-compile, default-value=false  # This parameter defines if the asynchronous transmission of a NM PDU upon bus-communication request in Prepare-Bus-Sleep mode is enabled. Enabling this option may lead to a burst of NM messages if all Nodes get a bus-communication request approximately at the same time. RESTRICTIONS: This parameter is only relevant if UdpNmPassiveModeEnabled is False
      boolean UdpNmNodeDetectionEnabled: set at pre-compile, default-value=false  # This parameter defines if the node detection feature is enabled. If a Tester is present in the network 'UdpNmNodeDetectionEnabled' offers the opportunity to detect all present network nodes. RESTRICTIONS: Derived from NmNodeDetectionEnabled. This parameter is only relevant if UdpNmPassiveModeEnabled is false. This parameter is only valid if UdpNmPduNidPosition is not UDPNM_PDU_OFF for all channels.
      boolean UdpNmNodeIdEnabled: set at pre-compile, default-value=false  # This parameter specifies if the Node ID is enabled. Parameters value is derived from configuration parameter NmNodeIdEnabled.
      integer UdpNmNumberOfChannels: 1..255, set at pre-compile, default-value=1  # This value specifies the number of configured UdpNm channels.
      boolean UdpNmPassiveModeEnabled: set at pre-compile, default-value=false  # This parameter defines if the Passive Mode is supported. If this option is set, the node is not able to send NM messages. This option can be used for nodes that do not require to keep the bus awake. RESTRICTIONS: Needs to have the same value as NmPassiveModeEnabled for all UdpNm channels.
      boolean UdpNmPduRxIndicationEnabled: set at pre-compile, default-value=false  # This parameter defines if the PDU Rx Indication is called. If this option is enabled a callback function for every received PDU will be triggered. RESTRICTIONS: Derived from NmPduRxIndicationEnabled.
      boolean UdpNmPnEiraCalcEnabled [0..1]: set at pre-compile, default-value=false  # Specifies if UdpNm calculates the PN request information for internal and external requests. (EIRA) true: PN request are calculated false: PN request are not calculated
      float UdpNmPnResetTime [0..1]: 0.001..65.535, set at pre-compile, default-value=1  # Specifies the runtime of the reset timer in seconds. This reset time is valid for the reset of PN requests in the EIRA and in the ERA. The value shall be the same for every channel. Thus it is a global config parameter.
      boolean UdpNmRemoteSleepIndEnabled: set at pre-compile, default-value=false  # This parameter defines if the remote sleep indication support is enabled. This feature is required for gateway nodes only. 'UdpNmRemoteSleepIndEnabled' is used in gateways to detect when the synchronized shutdown of networks has to be carried out. It comprises Remote Sleep Indication, Remote Sleep Cancelation and checking of the Remote Sleep Indication State. Remote Sleep Indication is notified when your network node is the only one in the whole network that requests bus-communication for 'UdpNmRemote SleepIndTime'. Remote Sleep Cancelation is notified if any other network node requires the communication bus while Remote Sleep Indication takes place in your network node. RESTRICTIONS: Derived from NmRemoteSleepIndEnabled. This parameter is only relevant if UdpNmPassiveModeEnabled is false.
      boolean UdpNmRepeatMsgIndEnabled: set at pre-compile, default-value=false  # This parameter defines if the notification that a RepeatMessageRequest bit has been received is enabled. This option enables a callback to the NM Interface whenever a state change due to a repeat message request or a repeat message bit occurs. RESTRICTIONS: If (UdpNmNodeDetectionEnabled == false) then (UdpNmRepeatMsgIndEnabled = false). Derived from NmRepeatMsgIndEnabled.
      boolean UdpNmStateChangeIndEnabled: set at pre-compile, default-value=false  # This parameter defines if the UdpNm state change notification is enabled. This option allows to track every change in the NM state machine by the means of a callback function triggered on every state change. RESTRICTIONS: Derived from NmStateChangeIndEnabled.
      boolean UdpNmUserDataEnabled: set at pre-compile, default-value=false  # This parameter defines if the user data support is enabled. This option provides read and write access to the user data. Location of user data in the NM message depends on the message configuration. RESTRICTIONS: Derived from NmUserDataEnabled.
      boolean UdpNmVersionInfoApi: set at pre-compile, default-value=false  # This parameter enables/disables the function UdpNm_GetVersionInfo() to get major, minor and patch version information.
      boolean UdpNmUlImmediateTxSupport: set at pre-compile, origin=Vector Informatik, default-value=false  # This parameter defines if the Upper Layer (PduR) is able to trigger the transmission of an NM PDU with a specific payload passed during the function call of UdpNm_Transmit(). According to AUTOSAR requirement SWS_UdpNm_00315 the API UdpNm_Transmit() shall be implemented empty and always return E_OK. When the feature is enabled the behavior of the API changes and the Upper Layer is able to trigger the transmission of an NM PDU containing the payload passed by the function call. The return value then depends on the success of the transmission request to the lower layers of UdpNm (SoAd).
      reference UdpNmPnEiraRxNSduRef [0..1]: set at pre-compile, destination=Pdu  # Reference to a Pdu in the COM-Stack. Only one SduRef is required for UdpNm because the EIRA is the aggregation over all Ethernet Channels.
      container UdpNmChannelConfig [1..*]  # This container includes the channel specific configuration parameter of the UdpNm.
        float UdpNmMainFunctionPeriod: 0.001..0.255, set at pre-compile, default-value=0.01  # This value specifies the period the UdpNm_MainFunction for this channel is called.
        float UdpNmMsgCycleOffset: 0..65.535, set at pre-compile, default-value=0  # This value specifies the offset in the periodic transmission node. It determines the start delay of the transmission. Whenever the transmission of network management messages is started the transmission start is delayed by this value. RESTRICTIONS: This parameter is only relevant if (UdpNmPassiveModeEnabled == False)
        float UdpNmMsgCycleTime: 0.001..65.535, set at pre-compile, default-value=0.1  # This value specifies the period of a NM PDU. It determines the periodic rate in the "periodic transmission mode with bus load reduction" and is the basis for transmit scheduling in the "periodic transmission mode without bus load reduction". RESTRICTIONS: This parameter is only relevant if (UdpNmPassiveModeEnabled == False)
        float UdpNmMsgTimeoutTime: 0.001..65.535, set at pre-compile, default-value=0.06  # This value specifies the transmission timeout of NM PDUs. If there is no transmission confirmation by the SoAd within this timeout, the UdpNm module shall give an error notification. RESTRICTIONS: This parameter is only relevant if (UdpNmPassiveModeEnabled == False). It should be a multiple of UdpNmMainFunctionPeriod and smaller than UdpNmMsgCycleTime. If UdpNmBusLoadReductionActive is True, it also should be smaller than UdpNmMsgReducedTime.
        integer UdpNmNodeId: 0..255, set at pre-compile, default-value=0  # This value specifies the node identifier of local node. The 'NodeId' is transmitted within the network management message if UdpNmPduNidPosition != UDPNM_PDU_OFF) The node identifier is used for the detection of present nodes and can be read by the application at any time. Note: This value is transmitted within the NM message.
        enumeration UdpNmPduCbvPosition: {UDPNM_PDU_BYTE_0, UDPNM_PDU_BYTE_1, UDPNM_PDU_OFF}, set at pre-compile, default-value=UDPNM_PDU_OFF  # This value specifies the position of the control bit vector within the NM PDU. The value of the parameter represents the location of the control bit vector in the NM PDU (UDPNM_PDU_BYTE_0 means byte 0, UDPNM_PDU_BYTE_1 means byte 1, UDPNM_PDU_OFF means that the Control Bit Vector is not part of the NM PDU). RESTRICTIONS: If (UdpNmPduCbvPosition != UDPNM_PDU_OFF) then (UdpNmPduCbvPosition != UdpNmPduNidPosition) and (UdpNmPduLength >= UdpNmPduCbvPosition). If (UdpNmPduNidPosition == UDPNM_PDU_OFF) then (UdpNmPduCbvPosition != UDPNM_PDU_BYTE_1).
        integer UdpNmPduLength: 0..65535, set at pre-compile, default-value=0  # This value specifies the length of the NM PDU. The value is auto-calculated dependent on 'UdpNmPduCbvPosition', 'UdpNmPduNidPosition' and 'UdpNmUserDataLength'. According to AUTOSAR RfC 70333 the PDU Length shall not be restricted to 8 Byte anymore like specified in AUTOSAR SWS (last released version 4.2.2). Therefore it is possilbe to use PDUs larger than 8 Byte.
        enumeration UdpNmPduNidPosition: {UDPNM_PDU_BYTE_0, UDPNM_PDU_BYTE_1, UDPNM_PDU_OFF}, set at pre-compile, default-value=UDPNM_PDU_OFF  # This value specifies the position of the source node identifier within the NM PDU. The value of the parameter represents the location of the source node identifier in the NM PDU (UDPNM_PDU_BYTE_0 means byte 0, UDPNM_PDU_BYTE_1 means byte 1, UDPNM_PDU_OFF means that the source node identifier is not part of the NM PDU). RESTRICTIONS: If (UdpNmPduNidPosition != UDPNM_PDU_OFF) then (UdpNmPduNidPosition != UdpNmPduCbvPosition) and (UdpNmPduLength >= UdpNmPduNidPosition). If (UdpNmPduCbvPosition == UDPNM_PDU_OFF) then (UdpNmPduNidPosition != UDPNM_PDU_BYTE_1).
        boolean UdpNmPnEnabled [0..1]: set at pre-compile, default-value=false  # Enables or disables support of partial networking. false: Partial networking Range not supported true: Partial networking supported
        boolean UdpNmPnEraCalcEnabled [0..1]: set at pre-compile, default-value=false  # Specifies if UdpNm calculates the PN request information for external requests. (ERA) false: PN request are not calculated true: PN request are calculated
        boolean UdpNmPnHandleMultipleNetworkRequests [0..1]: set at pre-compile, default-value=false  # This parameter defines whether UdpNm_NetworkRequest calls have an effect in Network Mode. If disabled UdpNm_NetworkRequest is ignored in Network Mode. If enabled UdpNm_NetworkRequest triggers a change from Network Mode to Repeat Message. RESTRICTIONS: This parameter is only relevant if (UdpNmPnEnabled == True)
        float UdpNmRemoteSleepIndTime: 0.001..65.535, set at pre-compile, default-value=0.5  # This value specifies the timeout for Remote Sleep Indication. Remote Sleep Indication is notified when the network node of the own ECU is the only one in the whole network that requests bus communication for this timing value. Typically it should be equal to: n * UdpNmMsgCycleTime, where n denotes the number of NM-Messages that are normally sent before Remote Sleep Indication is detected. The value of n decremented by one determines the amount of lost NM-Messages that can be tolerated by the Remote Sleep Indication procedure. RESTRICTIONS: This parameter is only relevant if (UdpNmRemoteSleepIndEnabled == True) If (UdpNmRemoteSleepIndEnabled == True) then (UdpNmRemoteSleepIndTime > 0)
        float UdpNmRepeatMessageTime: 0..65.535, set at pre-compile, default-value=0.4  # This value specifies the timeout for Repeat Message State. It defines how long the NM shall stay in the Repeat Message State. Within Repeat Message State the NM messages are always transmitted cyclically - even if 'Bus Load Reduction' is enabled. Typically it should be equal to: n * UdpNmMsgCycleTime, where n denotes the number of NM-Messages that are normally sent in the Repeat Message State. The value of n decremented by one determines the amount of lost NM-Messages that can be tolerated by the node detection procedure. The value 0 denotes that no Repeat Message State is configured. It means that Repeat Message State is transient what implicates that it is left immediately after entrance and in result no start-up stability is guaranteed and no node detection procedure is possible. If UdpNmPassiveModeEnabled == True, then a value of UdpNmRepeatMessageTime = 0 is recommended.
        float UdpNmTimeoutTime: 0.002..65.535, set at pre-compile, default-value=1  # This value specifies the Network Timeout for the reception and transmission of network management messages. If in Network Mode (Repeat Message State, Normal Operation State or Ready Sleep State) your network node does not require the communication bus anymore and no more NM messages are received within this time 'Prepare Bus-Sleep' is entered. It shall be equal for all nodes in the cluster. It shall be greater than UdpNmMsgCycleTime. Typically it should be equal to n * UdpNmMsgCycleTime, where n denotes the number of NM-Message cycle times in the Ready Sleep State before transition into the Bus-Sleep Mode is initiated. The value of n decremented by one determines the amount of lost NM-Messages that can be tolerated by the coordination algorithm.
        integer UdpNmUserDataLength: 0..65535, set at pre-compile, default-value=0  # This value specifies the length of the user data contained in the NM PDU. According to AUTOSAR RfC 70333 the PDU Length shall not be restricted to 8 Byte anymore like specified in AUTOSAR SWS (last released version 4.2.2). Therefore the User Data Length is extended in line with the extension of the PDU Length.
        float UdpNmWaitBusSleepTime: 0.001..65.535, set at pre-compile, default-value=0.75  # This value specifies the timeout for bus calm down phase (Prepare Bus-Sleep Mode). The bus calm down period is a safety zone between bus-communication of application messages and shutdown of the communication bus. It shall be equal for all nodes in the cluster. It shall be long enough to make all Tx-buffer empty.
        integer UdpNmImmediateNmTransmissions: 0..255, set at pre-compile, origin=Vector Informatik, default-value=0  # This value specifies the number of immediate NM PDUs which shall be transmitted. If the value is zero no immediate NM PDUs are transmitted. The cycle time of immediate NM PDUs is defined by UdpNmImmediateNmCycleTime.
        float UdpNmImmediateNmCycleTime [0..1]: 0.001..65.535, set at pre-compile, origin=Vector Informatik, default-value=0.1  # This value specifies the immediate NM PDU cycle time which is used for UdpNmImmediateNmTransmissions NM PDU transmissions. This parameter is only valid if UdpNmImmediateNmTransmissions is greater than one.
        boolean UdpNmAllNmMessagesKeepAwake [0..1]: set at pre-compile, origin=Vector Informatik, default-value=false  # Specifies if UdpNm drops irrelevant NM PDUs. false: Only NM PDUs with a PNI bit = true and containing a PN request for this ECU triggers the standard RX indication handling true: Every NM PDU triggers the standard RX indication handling RESTRICTIONS: This parameter is only relevant if (UdpNmPnEnabled == True)
        boolean UdpNmActiveWakeupBitEnabled [0..1]: set at pre-compile, origin=Vector Informatik, default-value=false  # Enables/Disables the handling of the Active Wakeup Bit in the UdpNm module.
        integer UdpNmCarWakeUpBitPosition [0..1]: 0..7, set at pre-compile, origin=Vector Informatik  # Specifies the Bit position of the CWU within the NM PDU.
        integer UdpNmCarWakeUpBytePosition [0..1]: 0..7, set at pre-compile, origin=Vector Informatik  # Specifies the Byte position of the CWU within the NM PDU.
        boolean UdpNmCarWakeUpFilterEnabled [0..1]: set at pre-compile, origin=Vector Informatik, default-value=false  # If CWU filtering is supported, only the CWU bit within the NM PDU with source node identifier UdpNmCarWakeUpFilterNodeId is considered as CWU request. | FALSE - CWU filtering is not supported TRUE - CWU filtering is supported.
        integer UdpNmCarWakeUpFilterNodeId [0..1]: 0..255, set at pre-compile, origin=Vector Informatik  # Source node identifier for CWU filtering. If CWU filtering is supported, only the CWU bit within the NM PDU with source node identifier UdpNmCarWakeUpFilterNodeId is considered as CWU request.
        boolean UdpNmCarWakeUpRxEnabled: set at pre-compile, origin=Vector Informatik, default-value=false  # Enables or disables support of CarWakeUp bit evaluation in received NM PDUs. | FALSE - CarWakeUp not supported. TRUE - CarWakeUp supported.
        reference UdpNmPnEraRxNSduRef [0..1]: set at pre-compile, destination=Pdu  # Reference to a Pdu in the COM-Stack. The SduRef is required for every UdpNm Channel, because ERA is reported per channel.
        symbolic name reference UdpNmComMNetworkHandleRef: set at pre-compile, destination=ComMChannel  # Reference to the unique channel defined by the ComMChannel. It provides access to the unique channel index value in ComMChannelId.
        container UdpNmRxPdu [1..*]  # This container includes the configuration of Rx PDU properties that are used for the UdpNm Channel.
          integer UdpNmRxPduId: 0..4294967296, set at pre-compile, symbolic-name-value=true, default-value=0  # ID of the RxPdu that will be used by a RxIndication of the lower layer.
          reference UdpNmRxPduRef: set at pre-compile, destination=Pdu  # The reference to a PDU in the global PDU structure described in the AUTOSAR ECU Configuration Specification. This reference will be used by the UdpNm module to derive the PDU Id.
        container UdpNmTxPdu [0..1]  # This container includes the configuration of Tx PDU properties that are used for the UdpNm Channel.
          integer UdpNmTxConfirmationPduId: 0..4294967296, set at pre-compile, symbolic-name-value=true, default-value=0  # Id of the TxPdu that will be used by a TxConfirmation from the lower layer.
          reference UdpNmTxPduRef: set at pre-compile, destination=Pdu  # The reference to a PDU in the global PDU structure described in the AUTOSAR ECU Configuration Specification. This reference will be used by the UdpNm module to derive the PDU Id.
        container UdpNmUserDataTxPdu [0..1]  # This optional container is used to configure the UserNm PDU. This container is only available if UdpNmComUserDataSupport is enabled.
          integer UdpNmTxUserDataPduId: 0..65535, set at pre-compile, symbolic-name-value=true, default-value=0  # This parameter defines the Handle ID of the NM User Data I-PDU.
          reference UdpNmTxUserDataPduRef: set at pre-compile, destination=Pdu  # Reference to the NM User Data I-PDU in the global PDU collection.
      container UdpNmDemEventParameterRefs [0..1]  # Container for the references to DemEventParameter elements which shall be invoked using the API Dem_ReportErrorStatus API in case the corresponding error occurs. The EventId is taken from the referenced DemEventParameter's DemEventId value. The standardized errors are provided in the container and can be extended by vendor specific error references.
        symbolic name reference UDPNM_E_NETWORK_TIMEOUT [0..1]: set at pre-compile, destination=DemEventParameter  # Reference to the DemEventParameter which shall be issued when the error "NM-Timeout Timer has abnormally expired outside of the Ready Sleep State" has occured.
        symbolic name reference UDPNM_E_TCPIP_TRANSMIT_ERROR [0..1]: set at pre-compile, destination=DemEventParameter  # Reference to the DemEventParameter which shall be issued when the error "A call to the TCP/IP stack has failedA call to the TCP/IP stack has failed" has occured.
      container UdpNmPnInfo [0..1]  # This container includes the PN information configuration.
        integer UdpNmPnInfoLength: 0..7, set at pre-compile, default-value=0  # Specifies the length of the PN request information in the NM message.
        integer UdpNmPnInfoOffset: 0..7, set at pre-compile, default-value=0  # Specifies the offset of the PN request information in the NM message.
        container UdpNmPnFilterMaskByte [0..7]  # PN information configuration Vector specific: not used
          integer UdpNmPnFilterMaskByteIndex: 0..6, set at pre-compile, default-value=0  # Specifies the offset of the PN request information in the NM message.
          integer UdpNmPnFilterMaskByteValue: 0..255, set at pre-compile, default-value=0  # Parameter to configure the filter mask byte.
  bsw implementation UdpNm_Impl: programming-language=C, sw-version=3.03.01, used-code-generator=DaVinci Configurator, vendor-id=30, ar-release-version=4.01.01, behavior=UdpNmBehavior, preconfigured-configuration=UdpNm_Pre, recommended-configuration=UdpNm_Rec, vendor-specific-module-def=UdpNm
  module config UdpNm_Pre: definition=UdpNm
  module config UdpNm_Rec: definition=UdpNm
