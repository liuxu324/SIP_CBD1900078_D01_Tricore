AUTOSAR XML (schema 4-1-1)
package /MICROSAR
  module config UdpNm_Rec: definition=UdpNm, implementation-config-variant=VARIANT-PRE-COMPILE
