AUTOSAR XML (schema 4-0-3)
package /MICROSAR
  module config TcpIp_Pre: definition=TcpIp
  module config TcpIp_Rec: definition=TcpIp, implementation-config-variant=VARIANT-PRE-COMPILE
    TcpIpGeneral: TcpIpDevErrorDetect=(unset), TcpIpVersionInfoApi=(unset), TcpIpVersionInfoApiMacro=(unset)
