AUTOSAR XML (schema 4-0-3)
package /MICROSAR/Lin_Tricore
  module config Lin_Pre: definition=Lin
    LinPlatformConfig:
      LinRegisterAddresses = 0xF0000600UL 0xF0000700UL 0xF0000800UL 0xF0000900UL 0xF0000A00UL 0xF0000B00UL 0xF0000C00UL 0xF0000D00UL 0xF0000E00UL 0xF0000F00UL 0xF02C0A00UL 0xF02C0B00UL 0xF02C0C00UL 0xF02C0D00UL 0xF02C0E00UL 0xF02C0F00UL 0xF02C1000UL 0xF02C1100UL 0xF02C1200UL 0xF02C1300UL 0xF02C1400UL 0xF02C1500UL 0xF02C1600UL 0xF02C1700UL
      LinClockRegister = F_OSC=0x04 F_ASCLINF=0x02 F_ASCLINS=0x04
