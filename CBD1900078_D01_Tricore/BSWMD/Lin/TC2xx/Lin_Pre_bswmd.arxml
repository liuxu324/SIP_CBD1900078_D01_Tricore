AUTOSAR XML (schema 4-0-3)
package /MICROSAR/Lin_Tricore
  module config Lin_Pre: definition=Lin
    LinPlatformConfig:
      LinRegisterAddresses = 0xF0000600UL 0xF0000700UL 0xF0000800UL 0xF0000900UL
      LinClockRegister = F_CLC=0x01 F_OSC=0x02 F_ERAY=0x04 F_ASCLINF=0x08 F_ASCLINS=0x10
