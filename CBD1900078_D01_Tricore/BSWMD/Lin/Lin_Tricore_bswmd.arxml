AUTOSAR XML (schema 4-0-3)
package /MICROSAR/Lin_Tricore
  module definition Lin [0..*]: category=VENDOR_SPECIFIC_MODULE_DEFINITION, refined-module-def=Lin, variants post-build-loadable/pre-compile/post-build-selectable  # Configuration of the Lin (LIN driver) module.
    container LinGeneral  # General configuration parameters of the Lin.
      boolean LinDevErrorDetect: set at pre-compile, default-value=true  # This parameter switches the Development Error Detection and Notification ON or OFF. true: Development error detection is enabled. false: Development error detection is disabled. Note: In general, the development error detection is recommended during pre-test phase. It is not recommended to enable the development error detection in production code due to increased runtime and ROM needs.
      integer LinIndex: 0..255, set at pre-compile, default-value=0  # This value specifies the Instance Id of this module instance. If only one instance is present it shall have the Id 0.
      integer LinTimeoutDuration: 0..65535, set at pre-compile, default-value=100  # This value specifies the maximum number of loops for blocking function until a timeout is raised in short term wait loops.
      boolean LinVersionInfoApi: set at pre-compile, default-value=false  # This parameter enables/disables the function Lin_GetVersionInfo() to get major, minor and patch version information.
      enumeration LinTypeOfInterruptFunction: {CATEGORY2, CATEGORY1, VOIDFUNCVOID}, set at pre-compile, origin=Vector Informatik, default-value=CATEGORY2  # This parameter specifies the type of Interrupt Function. Category 1: Interrupt Function has to be added to the interrupt vector table. Category 2: Interrupt Function is defined with ISR() define. void Func(void): Interrupt Function is defined as void Func(void) function.
      string LinUserConfigFile [0..1]: set at pre-compile, origin=Vector Informatik, max-length=255, min-length=0  # Reference to an external text file that will be included during generation to <Module>_Cfg.h. The content of the user configuration file will be added at the end of the generated module configuration file and allows altering or extending the generated code. Caution: User configuration files can cause the software module to malfunction and must only be used with great care!
      boolean LinRuntimeMeasurementSupport: set at pre-compile, origin=Vector Informatik, default-value=false  # If enabled runtime measurement points are added to the BSW module code and are added to the module configuration of MICROSAR RTM. The available measurement points can be seen and configured in the RTM module configuration. Availability of the MICROSAR RTM module is a prerequisite to make use of the runtime measurement functionality. Runtime measurement should be disabled in production code as measurement points may inflict additional runtime.
      boolean LinSafeBswChecks: set at pre-compile, origin=Vector Informatik, default-value=false  # Selects if safety checks are used. These checks improve robustness as e.g. invalid parameters are checked before function is executed. This attribute has to be enabled for safety projects where this component is mapped to an ASIL partition.
    container LinGlobalConfig  # Global configuration parameters of the Lin.
      container LinChannel [1..*]  # Channel specific configuration parameters of the Lin.
        integer LinChannelBaudRate: 1000..20000, set at post-build in variant post-build-loadable+post-build-selectable / pre-compile in variant pre-compile, default-value=19200  # This value specifies the baud rate of the LIN channel.
        integer LinChannelId: 0..254, set at pre-compile, symbolic-name-value=true, default-value=0  # This value specifies the identifier of this LIN channel.
        boolean LinChannelWakeupSupport: set at pre-compile, default-value=false  # This parameter defines if the LIN channel supports wake up functionality.
        integer LinUart: 0..255, set at pre-compile, origin=Vector Informatik, default-value=0  # This value specifies which hardware channel shall be used by this LIN driver channel. Make sure that each hardware channel is only used once.
        float LinClockFrequency [0..1]: 1..50000000, set at post-build in variant post-build-loadable+post-build-selectable / pre-compile in variant pre-compile, origin=Vector Informatik, default-value=8000000  # This is the LIN frequency, used instead of LinClockRef to McuClockReferencePoint container. It shall be given in Hz.
        enumeration LinAlternateInputSelect: {INPUT_0, INPUT_1, INPUT_2, INPUT_3, INPUT_4, INPUT_5, INPUT_6, INPUT_7}, set at post-build in variant post-build-loadable+post-build-selectable / pre-compile in variant pre-compile, origin=Vector Informatik, default-value=INPUT_0  # Specify the alternate input for the RX signal. Possible values range from Alternate Input 0 to Alternate Input 7.
        enumeration LinClockSource: set at post-build in variant post-build-loadable+post-build-selectable / pre-compile in variant pre-compile, origin=Vector Informatik, default-value=F_CLC  # AscLin clock source selection. Specifies the clock source of the used ASCLIN module for baudrate generation and timeout handling. The register CSR register is configured with the used clock source during initialization. The configured ASCLIN clock frequency value of parameter LinAscLinClock must match the frequency of the selected clock source.
          F_CLC  # Kernel clock frequency
          F_OSC  # XTAL Oscillator frequency
          F_ERAY  # ERAY frequency
          F_ASCLINF  # ASCLIN fast independent frequency
          F_ASCLINS  # ASCLIN slow independent frequency
          F_MAX  # Maximal System Frequency
        reference LinClockRef: set at post-build in variant post-build-loadable+post-build-selectable / pre-compile in variant pre-compile, destination=McuClockReferencePoint  # This parameter defines a reference to the LIN clock source configuration, which is set in the MCU driver configuration.
        symbolic name reference LinChannelEcuMWakeupSource [0..1]: set at pre-compile, destination=EcuMWakeupSource  # Channel EcuM Wakeup Source | This parameter defines a reference to a Wakeup Source within the EcuM configuration which is reported on detection of a wakeup on this LIN channel.
      container LinDemEventParameterRefs [0..1]  # This container has the references to DemEventParameter elements which shall be invoked using the API Dem_ReportErrorStatus API in case the corresponding error occurs. The EventId is taken from the referenced DemEventParameter's DemEventId value.
        symbolic name reference LIN_E_TIMEOUT [0..1]: set at pre-compile, destination=DemEventParameter  # This parameter references to the DemEventParameter which shall be issued when the error "Timeout caused by hardware error" has occured. If the reference is not configured the error shall be reported as DET error.
    container LinPlatformConfig  # Derivate depend configuration Parameter.
      multiline string LinRegisterAddresses: set at pre-compile, origin=Vector Informatik, default-value=0  # Lin Base Addresses of Platform. One line per channel.
      multiline string LinClockRegister: set at pre-compile, origin=Vector Informatik, default-value=0  # CSR.CLKSEL register value (LinClockSource=value)
  bsw implementation Lin_Impl: programming-language=C, sw-version=7.04.00, used-code-generator=DaVinci Configurator, vendor-id=30, ar-release-version=4.00.03, behavior=LinBehavior, preconfigured-configuration=Lin_Pre, recommended-configuration=Lin_Rec, vendor-specific-module-def=Lin
  module config Lin_Pre: definition=Lin
  module config Lin_Rec: definition=Lin
