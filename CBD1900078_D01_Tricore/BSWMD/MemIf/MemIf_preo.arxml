AUTOSAR XML (schema 4-0-3)
package /MICROSAR
  module config MemIf_Rec: definition=MemIf, implementation-config-variant=VARIANT-PRE-COMPILE
