AUTOSAR XML (schema 4-0-3)
# COPYRIGHT
# Copyright (c) 2017 by Vector Informatik GmbH. All rights reserved.
# This software is copyright protected and proprietary to Vector Informatik GmbH.
# Vector Informatik GmbH grants to you only those rights as set out in the license conditions.
package /MICROSAR
  module definition FiM [0..1]: category=VENDOR_SPECIFIC_MODULE_DEFINITION, refined-module-def=FiM, variants pre-compile/post-build-loadable  # Configuration of the FiM (Function Inhibition Manager) module.
    container FiMConfigSet  # This container includes the configuration parameters and sub containers of the FIM module supporting multiple configuration sets.
      container FiMEventSummary [0..0]  # NOT USED This container includes the summarized EventId definition record consisting of a summarized event ID and a specific EventId.
        symbolic name reference FiMInputSumEventRef [1..*]: set at pre-compile, destination=DemEventParameter  # NOT USED
        symbolic name reference FiMOutputSumEventRef: set at pre-compile, destination=FiMSummaryEventId  # NOT USED
      container FiMFID [1..*]  # This container includes symbolic names of all FIDs.
        integer FiMFunctionId: 0..65535, set at pre-compile, symbolic-name-value=true, default-value=0  # This value specifies the ID which represents a functionality. FiMFunctionId is the unique identifier assigned during FIM configuration.
      container FiMInhibitionConfiguration [1..*]: post-build-changeable=true  # This container includes all configuration parameters concerning the relationship between a DEM event and FID.
        enumeration FiMInhInhibitionMask: {FIM_LAST_FAILED, FIM_NOT_TESTED, FIM_TESTED, FIM_TESTED_AND_FAILED, FIM_PENDING}, set at post-build in variant post-build-loadable / pre-compile in variant pre-compile, default-value=FIM_TESTED  # This parameter defines the inhibition mask for a DEM event - FID relation.
        reference FiMInhFunctionIdRef: set at post-build in variant post-build-loadable / pre-compile in variant pre-compile, destination=FiMFID  # Reference to a FiMFID container.
        container FiMInhEventId  # This container includes the configuration parameter used for an existing DEM event and summarized events as well.
          choice container FiMInhRefChoice  # This choice container specifies either a reference to a DEM event or FiMSummaryEventId.
            container FiMInhChoiceDemRef  # This container includes a reference to a DEM event.
              symbolic name reference FiMInhEventRef: set at post-build in variant post-build-loadable / pre-compile in variant pre-compile, destination=DemEventParameter  # Reference to a DemEventParameter within the DEM configuration.
            container FiMInhChoiceSumRef [0..0]  # NOT USED
              symbolic name reference FiMInhSumRef [1..*]: set at pre-compile, destination=FiMSummaryEventId  # NOT USED
      container FiMSummaryEventId [0..0]  # NOT USED This container defines the name of a summarized event.
        integer FiMEventSumId: 0..65535, set at pre-compile, symbolic-name-value=true, default-value=0  # NOT USED The summarized EventId definition record defines the existence of a summarized event with a specific name. This summarized event can be referenced in the EventSummary (as FimSummaryEventId) and Inhibition configuration (as FimInhEventId).
    container FiMGeneral  # General configuration parameters of the FIM.
      boolean FiMDataFixed: set at pre-compile, default-value=false  # This parameter defines if calibration of inhibit relations is enabled. The scope of the parameter is to meet the requirement (FIM008) to have the option to calibrate inhibit data on the one hand side and also to provide the option to protect inhibit data for consistency reasons. If FiMDataFixed is enabled, then calibration is enabled. If FiMDataFixed is disabled, then calibration is disabled. Note: This parameter enabled is not supported!
      boolean FiMDevErrorDetect: set at pre-compile, default-value=true  # This parameter switches the Development Error Detection and Notification ON or OFF. true: Development error detection is enabled. false: Development error detection is disabled. Note: In general, the development error detection is recommended during pre-test phase. It is not recommended to enable the development error detection in production code due to increased runtime and ROM needs.
      boolean FiMEventUpdateTriggeredByDem: set at pre-compile, default-value=true  # This parameter defines the way the FIM obtains status of DEM events. If the parameter is enabled the DEM has to inform the FIM on changed events. If the parameter is disabled the FIM polls the event changes from the DEM. Note: This parameter disabled is not supported!
      integer FiMMaxEventFidLinks: 1..65535, set at pre-compile, default-value=1  # This value specifies the total maximum number of links between DEM events and FID/InhibitionConfiguration combinations.
      integer FiMMaxEventsPerFid: 1..65535, set at pre-compile, default-value=1  # This value specifies the maximum number of DEM events/InhibitionConfiguration combinations that can be linked to a single FID.
      integer FiMMaxFidsPerEvent: 1..65535, set at pre-compile, default-value=1  # This value specifies the maximum number of FID/InhibitionConfiguration combinations that can be linked to a single DEM event.
      integer FiMMaxSummaryEvents [0..1]: 0..65535, set at pre-compile, default-value=0  # NOT USED This value specifies the maximum number of summarized events that can be configured.
      integer FiMMaxSummaryLinks [0..1]: 0..65535, set at pre-compile, default-value=0  # NOT USED This value specifies the total maximum number of links between EventIds and summarized events.
      integer FiMMaxTotalLinks [0..1]: 1..65535, set at pre-compile, default-value=1  # NOT USED This value specifies the total maximum number of links between DEM events and FIDs plus the number of links between events and summarized events.
      float FiMTaskTime: 0..0.1, set at pre-compile, origin=AUTOSAR_ECUC V1.0.0, default-value=0.01  # This value specifies the time for the periodic cyclic task of the FiM_MainFunction.
      boolean FiMVersionInfoApi: set at pre-compile, default-value=false  # This parameter enables/disables the function FiM_GetVersionInfo() to get major, minor and patch version information.
      string FiMUserConfigFile [0..1]: set at pre-compile, origin=Vector Informatik  # Reference to an external user configuration file that will be included during generation. The content of the user configuration file will be added at the end of the generated module configuration file and allows altering or extending the generated code. Caution: User configuration files can cause the software module to malfunction and must only be used with great care!
      boolean FiMOBDSupport [0..1]: set at pre-compile, origin=Vector Informatik, default-value=false  # This parameter defines if OBD support for FIM module is enabled. OBD support can only be enabled, if OBD support is licensed.
      boolean FiMUseRte: set at pre-compile, origin=Vector Informatik, default-value=true  # Globally disable the usage of RTE callbacks. All port interfaces are suppressed, and all callouts must be replaced by direct function calls.
      boolean FiMOptimizationForInhibitionMasks [0..1]: set at post-build in variant post-build-loadable / pre-compile in variant pre-compile, origin=Vector Informatik, default-value=false  # If enabled, the code generator will try to optimize usage of inhibition masks. For example different inhibition configurations with identical event id and function id are combined to a single inhibition configuration (e.g., FIM_NOT_TESTED/FIM_LAST_FAILED to FIM_NOT_TESTED_OR_FAILED).
      boolean FiMSafeBswChecks: set at pre-compile, origin=Vector Informatik, default-value=false  # Selects if safety checks are used. These checks improve robustness as e.g. invalid parameters are checked before function is executed. This attribute has to be enabled for safety projects where this component is mapped to an ASIL partition.
  bsw implementation FiM_Impl: programming-language=C, sw-version=5.01.00, used-code-generator=DaVinci Configurator, vendor-id=30, ar-release-version=4.03.00, behavior=FiMBehavior, preconfigured-configuration=FiM_Pre, recommended-configuration=FiM_Rec, vendor-specific-module-def=FiM
  module config FiM_Pre: definition=FiM
  module config FiM_Rec: definition=FiM
