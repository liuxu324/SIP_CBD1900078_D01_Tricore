AUTOSAR XML (schema 4-0-3)
package /MICROSAR
  module config FiM_Rec: definition=FiM, implementation-config-variant=VARIANT-PRE-COMPILE
    FiMGeneral: FiMDevErrorDetect=1
  module config FiM_Pre: definition=FiM
