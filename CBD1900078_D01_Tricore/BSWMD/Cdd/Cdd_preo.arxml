AUTOSAR XML (schema 4-0-3)
package /MICROSAR/Cdd_AsrCdd
  module config Cdd_Pre: definition=Cdd
  module config Cdd_Rec: definition=Cdd, implementation-config-variant=VARIANT-PRE-COMPILE
