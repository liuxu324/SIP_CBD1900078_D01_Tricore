AUTOSAR XML (schema 4-0-3)
package /MICROSAR
  module config Nm_Pre: definition=Nm
  module config Nm_Rec: definition=Nm, implementation-config-variant=VARIANT-PRE-COMPILE
