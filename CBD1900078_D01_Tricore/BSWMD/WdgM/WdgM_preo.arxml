AUTOSAR XML (schema 4-0-3)
package /MICROSAR
  module config WdgM_Rec: definition=WdgM, implementation-config-variant=VARIANT-PRE-COMPILE
