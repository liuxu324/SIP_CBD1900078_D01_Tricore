AUTOSAR XML (schema 4-0-3)
package /MICROSAR
  module definition RamTst [0..1]: category=VENDOR_SPECIFIC_MODULE_DEFINITION, refined-module-def=RamTst, variants pre-compile/link-time  # Configuration of the RamTst module.
    container RamTstCommon  # This container holds a list of all available functions in the RamTst module. Each function is turned ON or OFF before compiling so that only the desired functions and test algorithms are in the compiled code.
      boolean RamTstAllowApi: set at pre-compile, default-value=true  # Enable RamTst_Allow | This control enables/disables the usage of the service RamTst_Allow().
      boolean RamTstChangeNumOfTestedCellsApi: set at pre-compile, default-value=true  # Enable RamTst_ChangeNumberOfTestedCells | This control enables/disables the usage of the service RamTst_ChangenumberOfTestedCells().
      boolean RamTstDevErrorDetect: set at pre-compile, default-value=true  # Development Mode | This control enables/disables development error detection.
      boolean RamTstGetAlgParamsApi: set at pre-compile, default-value=true  # Enable RamTst_GetAlgParams | This control enables/disables the usage of the service RamTst_GetAlgParams().
      boolean RamTstGetExecutionStatusApi: set at pre-compile, default-value=true  # Enable RamTst_GetExecutionStatus | This control enables/disables the usage of the service RamTst_GetExecutionStatus().
      boolean RamTstGetNumberOfTestedCellsApi: set at pre-compile, default-value=true  # Enable RamTst_GetNumberOfTestedCells | This control enables/disables the usage of the service RamTst_GetNumberOfTestedCells().
      boolean RamTstGetTestAlgorithmApi: set at pre-compile, default-value=true  # Enable RamTst_GetTestAlgorithm | This control enables/disables the usage of the service RamTst_GetTestAlgorithm().
      boolean RamTstGetTestResultApi: set at pre-compile, default-value=true  # Enable RamTst_GetTestResult | This control enables/disables the usage of the service RamTst_GetTestResult().
      boolean RamTstGetTestResultPerBlockApi: set at pre-compile, default-value=true  # Enable RamTst_GetTestResultPerBlock | This control enables/disables the usage of the service RamTst_GetTestResultPerBlock().
      boolean RamTstGetVersionInfoApi: set at pre-compile, default-value=false  # Enable RamTst_GetVersionInfo | This control enables/disables the usage of the service RamTst_GetVersionInfo().
      boolean RamTstResumeApi: set at pre-compile, default-value=true  # Enable RamTst_Resume | This control enables/disables the usage of the service RamTst_Resume().
      boolean RamTstRunFullTestApi: set at pre-compile, default-value=true  # Enable RamTst_RunFullTest | This control enables/disables the usage of the service RamTst_RunFullTest().
      boolean RamTstRunPartialTestApi: set at pre-compile, default-value=true  # Enable RamTst_RunPartialTest | This control enables/disables the usage of the service RamTst_RunPartialTest().
      boolean RamTstSelectAlgParamsApi: set at pre-compile, default-value=true  # Enable RamTst_SelectAlgParams | This control enables/disables the usage of the service RamTst_SelectAlgParams().
      boolean RamTstStopApi: set at pre-compile, default-value=true  # Enable RamTst_Stop | This control enables/disables the usage of the service RamTst_Stop().
      boolean RamTstSuspendApi: set at pre-compile, default-value=true  # Enable RamTst_Suspend | This control enables/disables the usage of the service RamTst_Suspend().
      boolean RamTstDevErrorReporting: set at pre-compile, origin=Vector Informatik, default-value=true  # Development Error Reporting | This control enables/disables the reporting of errors to the DET. If disabled, in case of an error the called service returns to the caller without any actions.
      string RamTstNotificationInclude: set at pre-compile, origin=Vector Informatik, default-value=Appl_RamTst.h  # Include File | This field contains the name of the include file that contains the declarations of the Test Completed Notification and the RAM Error Notification.
      float RamTstMainFunctionPeriod: 0.001..1, set at pre-compile, origin=Vector Informatik, default-value=0.01  # Call Cycle of RamTst_MainFunction | Specify fixed call cycle for RamTst_MainFunction. This information affects RTE's (SchM's) settings. RamTst itself does not depend on a fixed cycle time; in can be triggered at arbitrary rates. Scheduled function for executing the RAM Test in the background, needs a period, which is configurable via this parameter.
      container RamTstAlgorithms  # Test Algorithms | This container holds all of the available test algorithms for the specific microcontroller. Each test algorithm is selected ON or OFF before compiling so that only the desired test algorithms are in the compiled code.
        boolean RamTstAbrahamTestSelected: set at pre-compile, default-value=true  # Use Abraham Test Algorithm | This control enables/disables the Abraham test algorithm. When disabled, the algorithm will not be available in the algorithm parameter set configuration and the according code will be removed from the implementation.
        boolean RamTstCheckerboardTestSelected: set at pre-compile, default-value=true  # Use Checkerboard Test Algorithm | This control enables/disables the Checkerboard test algorithm. When disabled, the algorithm will not be available in the algorithm parameter set configuration and the according code will be removed from the implementation.
        boolean RamTstGalpatTestSelected: set at pre-compile, default-value=true  # Use Galpat Test Algorithm | This control enables/disables the Galpat test algorithm. When disabled, the algorithm will not be available in the algorithm parameter set configuration and the according code will be removed from the implementation.
        boolean RamTstMarchTestSelected: set at pre-compile, default-value=true  # Use March Test Algorithm (MATS) | This control enables/disables the March test algorithm. When disabled, the algorithm will not be available in the algorithm parameter set configuration and the according code will be removed from the implementation.
        boolean RamTstTranspGalpatTestSelected: set at pre-compile, default-value=true  # Use Transparanent Galpat Test Algorithm | This control enables/disables the Transparent Galpat test algorithm. When disabled, the algorithm will not be available in the algorithm parameter set configuration and the according code will be removed from the implementation.
        boolean RamTstWalkPathTestSelected: set at pre-compile, default-value=true  # Use WalkPath Test Algorithm | This control enables/disables the WalkPath test algorithm. When disabled, the algorithm will not be available in the algorithm parameter set configuration and the according code will be removed from the implementation.
      container RamTstConfigParams  # This container specifies configuration parameters which are set at pre-compile or link time.
        integer RamTstDefaultAlgParamsId: 0..255, set at link in variant link-time / pre-compile in variant pre-compile, default-value=0  # This control selects the numeric ID of the default algorithm parameter set that is active after initialization of the module.
        integer RamTstMinNumberOfTestedCells: 1..4294967295, set at link in variant link-time / pre-compile in variant pre-compile, default-value=32  # Min Number Of Tested Cells | This control contains the minimum number of RAM cells to be tested in one background test cycle. This value depends on the memory to be checked. Adjust this value to your architecture (e.g. 32 if you use a 32-Bit controller).
        integer RamTstNumberOfAlgParamSets: 1..255, set at link in variant link-time / pre-compile in variant pre-compile, default-value=1  # Number of configured parameter sets for the available test algorithms.
        function name RamTstTestCompletedNotification: set at link in variant link-time / pre-compile in variant pre-compile, default-value=RamTst_TestCompletedNotification  # Test Completed Notification | This field contains the function name of the function to be called after a test run has been completed. If this field is 'NULL_PTR', the Test Completed Notification is disabled.
        function name RamTstTestErrorNotification: set at link in variant link-time / pre-compile in variant pre-compile, default-value=RamTst_ErrorNotification  # RAM Error Notification | This field contains the function name of the function to be called if an error occurs during a test run. If this field is 'NULL_PTR', the RAM Error Notification is disabled.
        symbolic name reference RamTstDefaultAlgParams: set at pre-compile, origin=Vector Informatik, destination=RamTstAlgParams  # Default Algorithm Parameter Set | This control selects the default algorithm parameter set that is active after initialization of the module.
        container RamTstAlgParams [1..255]  # Test Configuration | This container holds parameters for configuring an algorithm. For each algorithm selected in the RamTst_Algorithms container there can be one or more RamTstAlgParams containers. The multiplicity of the included container RamTstBlockParams depends on the number of separate blocks of RAM which are defined for the particular test configuration.
          integer RamTstAlgParamsId: 0..255, set at link in variant link-time / pre-compile in variant pre-compile, symbolic-name-value=true, default-value=0  # This field contains the numeric ID of an algorithm parameter set. The value can not be edited manually, but it can be influenced by the list position. Use the buttons 'Move Up' and 'Move Down' to move an entry in the list.
          enumeration RamTstAlgorithm: set at link in variant link-time / pre-compile in variant pre-compile, default-value=RAMTST_CHECKERBOARD_TEST  # Test Algorithm | This field selects the test algorithm to be used for testing the currently active algorithm parameter set. The values available for selection depend on which test algorithms are enabled.
            RAMTST_ABRAHAM_TEST  # Abraham
            RAMTST_CHECKERBOARD_TEST  # Checkerboard
            RAMTST_GALPAT_TEST  # Galpat
            RAMTST_MARCH_TEST  # March (MATS)
            RAMTST_TRANSP_GALPAT_TEST  # Transparent Galpat
            RAMTST_WALK_PATH_TEST  # WalkPath
          integer RamTstExtNumberOfTestedCells: 1..4294967295, set at link in variant link-time / pre-compile in variant pre-compile, default-value=1  # This parameter defines the absolute maximum value for the number of cells. It should be equal to the sum of the block sizes as defined by the block descriptions. [NOT USED]
          integer RamTstMaxNumberOfTestedCells: 1..4294967295, set at link in variant link-time / pre-compile in variant pre-compile, default-value=128  # Maximum Number Of Tested Cells | This parameter configures the maximum number of tested cells that can be selected by the service RamTst_ChangeNumberOfTestedCells() for the current algorithm parameter set.
          integer RamTstNumberOfBlocks: 1..65535, set at link in variant link-time / pre-compile in variant pre-compile, default-value=1  # Number Of Blocks | Number of RAM blocks configured in this algorithm parameter set.
          integer RamTstNumberOfTestedCells: 1..4294967295, set at link in variant link-time / pre-compile in variant pre-compile, default-value=32  # Number Of Tested Cells | This field configures the number of cells to be tested in a background test for each scheduled call of the main function. This value shall be a multiple of the minimum number of tested cells.
          container RamTstBlockParams [1..10]  # This container holds the description for one block of RAM. For each RAM block to be tested by a given algorithm, there is one container which describes the block. Multiple instances of this container are included in each container RamTst_AlgParams. | Constraint: It must be smaller than the RamTstEndAddress.
            integer RamTstBlockId: 0..65535, set at link in variant link-time / pre-compile in variant pre-compile, symbolic-name-value=true, default-value=0  # Block ID | This field contains the numeric ID of a RAM block to test. The value can not be edited manually, but it can be influenced by the list position in the table one level higher. Use the buttons 'Move Up' and 'Move Down' to move an entry in the list.
            integer RamTstEndAddress: 1..4294967295, set at link in variant link-time / pre-compile in variant pre-compile, default-value=4294967295  # End Address | This parameter configures the end address of the currently selected RAM block.
            integer RamTstFillPattern [0..1]: 0..4294967295, set at link in variant link-time / pre-compile in variant pre-compile, default-value=4294967295  # Fill Pattern | This field contains the value that will be written into tested RAM cells in case a destructive RAM test is executed. This field is deactivated if the test policy 'Non_Destructive' is selected.
            integer RamTstStartAddress: 0..4294967295, set at link in variant link-time / pre-compile in variant pre-compile, default-value=0  # Start Address | This parameter configures the start address of the currently selected RAM block.
            enumeration RamTstTestPolicy: {RAMTEST_DESTRUCTIVE, RAMTEST_NON_DESTRUCTIVE}, set at link in variant link-time / pre-compile in variant pre-compile, default-value=RAMTEST_NON_DESTRUCTIVE  # Test Policy | This parameter selects the test policy for the current RAM block. If the block is tested destructive, it will be overwritten with the value configured in the parameter 'Fill Pattern' after testing. If the block is tested non-destructive, it will contain exactly the same value as before the test.
    container RamTstDemEventParameterRefs  # Container for the references to DemEventParameter elements which shall be invoked using the API Dem_ReportErrorStatus in case the corresponding error occurs. The EventId is taken from the referenced DemEventParameter's DemEventId value. | The standardized errors are provided in the container and can be extended by vendor-specific error references.
      symbolic name reference RAMTST_E_RAM_FAILURE: set at pre-compile, destination=DemEventParameter  # Reference to the DemEventParameter which shall be issued when the error "RAM failure" has occurred.
    container RamTstPublishedInformation  # Container holding all RamTst specific published information parameter.
      integer RamTstCellSize: 1..64, set at published-information, default-value=32  # Size of RAM cells (in bits) which can be tested individually by the given implementation.
  bsw implementation RamTst_Impl: programming-language=C, sw-version=2.02.00, used-code-generator=cMSR, vendor-id=30, ar-release-version=4.00.03, behavior=RamTstBehavior, preconfigured-configuration=RamTst_Pre, recommended-configuration=RamTst_Rec, vendor-specific-module-def=RamTst
  module config RamTst_Pre: definition=RamTst
  module config RamTst_Rec: definition=RamTst
