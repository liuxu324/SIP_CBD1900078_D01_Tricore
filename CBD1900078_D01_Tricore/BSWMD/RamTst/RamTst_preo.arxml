AUTOSAR XML (schema 4-0-3)
package /MICROSAR
  module config RamTst_Pre: definition=RamTst
  module config RamTst_Rec: definition=RamTst, implementation-config-variant=VARIANT-PRE-COMPILE
    RamTstCommon: RamTstDevErrorDetect=1, RamTstGetVersionInfoApi=0
      RamTstConfigParams: RamTstTestCompletedNotification=NULL_PTR, RamTstTestErrorNotification=NULL_PTR
  module config RamTst_Rec_Class1: definition=RamTst
