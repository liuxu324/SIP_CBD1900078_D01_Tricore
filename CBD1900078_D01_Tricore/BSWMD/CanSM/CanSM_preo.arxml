AUTOSAR XML (schema 4-0-3)
package /MICROSAR
  module config CanSM_Rec: definition=CanSM, implementation-config-variant=VARIANT-PRE-COMPILE
