AUTOSAR XML (schema 4-0-3)
# COPYRIGHT
# Copyright (c) 2019 by Vector Informatik GmbH. All rights reserved.
# This software is copyright protected and proprietary to Vector Informatik GmbH.
# Vector Informatik GmbH grants to you only those rights as set out in the license conditions.
package /MICROSAR/vMem_30_XXspi01
  bsw implementation vMem_Impl: programming-language=C, sw-version=1.00.00, used-code-generator=DaVinci Configurator, vendor-id=30, ar-release-version=4.00.03, behavior=vMemBehavior, preconfigured-configuration=vMem_Pre, recommended-configuration=vMem_Rec, vendor-api-infix=XXspi01, vendor-specific-module-def=vMem
  module definition vMem [0..*]: category=VENDOR_SPECIFIC_MODULE_DEFINITION, refined-module-def=vMem, variants pre-compile  # Configuration of the vMem driver (internal or external memory driver) module. Its multiplicity describes the present number of memory drivers, so there will be one container for each memory driver.
    container vMemGeneral  # Container for general configuration parameters of the memory driver. These parameters are always pre-compile.
      boolean vMemDevErrorDetect: set at pre-compile, origin=Vector Informatik, default-value=true  # This parameter switches the Development Error Detection and Reporting ON or OFF. true: Development error detection and reporting is enabled. false: Development error detection and reporting is disabled. Note: In general, the development error detection is recommended during pre-test phase. It is not recommended to enable the development error detection in production code due to increased runtime and ROM needs.
      boolean vMemSafeBswChecks: set at pre-compile, origin=Vector Informatik, default-value=false  # Selects if safety checks are used. These checks improve robustness as e.g. invalid parameters are checked before function is executed. This attribute has to be enabled for safety projects where this component is mapped to an ASIL partition.
      boolean vMemVersionInfoApi: set at pre-compile, origin=Vector Informatik, default-value=false  # This parameter enables/disables the function GetVersionInfo() to get major, minor and patch version information.
      string vMemUserConfigFile: set at pre-compile, origin=Vector Informatik  # Reference to an external text file that will be included during generation to vMem_30_XXspi01_Cfg.h. The content of the user configuration file will be added at the end of the generated module configuration file and allows altering or extending the generated code. Caution: User configuration files can cause the software module to malfunction and must only be used with great care!
    container vMemInstance [1..65536]  # This container includes the memory driver instance specific configuration parameters. Its multiplicity describes the number of memory driver instances of this memory driver, so there will be one container for each memory driver instance.
      integer vMemInstanceId: 0..65535, set at pre-compile, origin=Vector Informatik, symbolic-name-value=true, default-value=0  # This value specifies the unique numeric identifier which is used to reference a memory driver instance. It is used in order to distinguish between several memory driver instances with the same physical addresses. This value will be assigned to the symbolic name derived of the vMemInstance container short name.
      reference vMemDeviceInformationRef: set at pre-compile, origin=Vector Informatik, destination=vMemDeviceInformation  # Reference to vMemDeviceInformation
      container vMemSectorList  # List of programmable sectors and pages.
        container vMemSector [1..*]  # Configuration description of a programmable sector or sector batch. Sector batch means that homogenous and coherent sectors can be configured as one vMemSector element. It is recommended to group as many identical sectors as possible together.
          integer vMemNumberOfSectors: 1..65536, set at pre-compile, origin=Vector Informatik, default-value=1  # Number of continuous sectors with identical values for vMemSectorSize and vMemPageSize. If this parameter is configured to be greater than 1, this will result in a so called "sector batch".
          integer vMemPageSize: 1..4294967296, set at pre-compile, origin=Vector Informatik  # Size of one page of this sector in bytes. A page is the smallest writeable unit.
          integer vMemSectorSize: 1..4294967296, set at pre-compile, origin=Vector Informatik  # Size of this sector in bytes. A sector is the smallest erasable unit.
          integer vMemStartAddress: 0..4294967295, set at pre-compile, origin=Vector Informatik  # Physical start address of this sector. In case of a sector batch this physical start address is the address of the first sector. The physical start address of the other sectors can be calculated by usage of parameter vMemSectorSize.
          container vMemBurstSettings [0..1]  # Container for burst setting configuration parameters of the memory driver. A sector burst can be used for improved performance.
            integer vMemEraseBurstSize: 0..4294967296, set at pre-compile, origin=Vector Informatik, default-value=65536  # Size of sector erase burst in bytes. A sector burst can be used for improved performance and is typically (a subset of) a sector batch. Additionally the size also prescribes a necessary alignment: The phyiscal start address must be aligned to the size value, i.e. it must an integral multiple of the burst size.
            integer vMemWriteBurstSize: 0..4294967296, set at pre-compile, origin=Vector Informatik, default-value=128  # Size of page write/program burst in bytes. A sector burst can be used for improved performance and is typically (a subset of) a sector batch. Additionally the size also prescribes a necessary alignment: The phyiscal start address must be aligned to the size value, i.e. it must an integral multiple of the burst size.
            integer vMemPageBurstRamAlignment: 1..256, set at pre-compile, origin=Vector Informatik, default-value=1  # In order to make use of page write bursts, a device might require a specific alignment of the data buffer (containing the data to be programmed to NV memory). E.g. a device specific assembly buffer must be filled dword (32bit) wise. To avoid additionaly over head the buffer passed to write routine shall be correctly aligned according to this setting in order to use bursts. Unless no alignment is necessary (value equals 1), the implementation shall check for expected alignment, and it shall reject a burst request if this check failed.
      container vMemSpiAccess  # This container includes the configuration to access the specific flash device hardware instance via Spi.
        reference vMemSpiWriteSequenceRef: set at pre-compile, origin=Vector Informatik, destination=SpiSequence  # Reference to SpiSequence that is used to perform write operations.
        reference vMemSpiReadStatusSequenceRef: set at pre-compile, origin=Vector Informatik, destination=SpiSequence  # Reference to SpiSequence that is used to read the status of the flash device.
        reference vMemSpiReadSequenceRef: set at pre-compile, origin=Vector Informatik, destination=SpiSequence  # Reference to SpiSequence that is used to perform read operations.
        reference vMemSpiReadResultSequenceRef [0..1]: set at pre-compile, origin=Vector Informatik, destination=SpiSequence  # Reference to SpiSequence that is used to read the result information of an operation. Note: This reference is optional and only is required in case the referenced device is configured to to perform a result check. (See vMemResultCheck of vMemDeviceInformationRef target reference)
        reference vMemSpiEraseSequenceRef: set at pre-compile, origin=Vector Informatik, destination=SpiSequence  # Reference to SpiSequence that is used to perform erase operations.
        reference vMemSpiClearResultSequenceRef [0..1]: set at pre-compile, origin=Vector Informatik, destination=SpiSequence  # Reference to SpiSequence that is used to clear the result information. Note: This reference is optional and only is required in case the referenced device is configured to to perform a result check. (See vMemResultCheck of vMemDeviceInformationRef target reference)
        reference vMemSpiExtendedProgressCheckRef [0..1]: set at pre-compile, origin=Vector Informatik, destination=SpiSequence  # Reference to SpiSequence that is used to perform the extended progress check. Note: This reference is optional and only is required in case the referenced device requires to perform an extended check. (See vMemFlashCommandList of vMemDeviceInformationRef target reference)
    container vMemDeviceInformation [1..*]  # This container includes the device configuration.
      integer vMemSize: 0..4294967295, set at pre-compile, origin=Vector Informatik  # This value specifies the size of the device.
      boolean vMemResultCheck: set at pre-compile, origin=Vector Informatik  # This parameter defines whether a result check is performed for write / erase operations. True: Result check is performed. False: No result check is performed.
      integer vMemResultRegisterEraseErrorBitMask [0..1]: 0..255, set at pre-compile, origin=Vector Informatik, default-value=0  # This value specifies the bit mask to extract the relevant bit(s) that indicate a failed erase operation.
      integer vMemResultRegisterProgramErrorBitMask [0..1]: 0..255, set at pre-compile, origin=Vector Informatik, default-value=0  # This value specifies the bit mask to extract the relevant bit(s) that indicate a failed write operation.
      integer vMemStatusRegisterBusyFlagBitMask: 0..255, set at pre-compile, origin=Vector Informatik, default-value=0  # This value specifies the bit mask to extract the bit(s) that indicate(s) the device busy status.
      integer vMemStatusRegisterLength: 0..65535, set at pre-compile, origin=Vector Informatik  # This value specifies the length of the status register.
      integer vMemExtendedProgressCheckFlagBitMask [0..1]: 0..255, set at pre-compile, origin=Vector Informatik, default-value=0  # This value specifies the bit mask to extract the relevant bit(s) for extended progress check.
      container vMemFlashCommandList  # This container includes the device-specific flash commands.
        container vMemFlashCommand [1..*]  # This container includes the configuration of a device-specific flash command.
          enumeration vMemCmdType: {VMEM_READ, VMEM_WRITE, VMEM_ERASE, VMEM_READ_STATUS, VMEM_READ_RESULT, VMEM_CLEAR_RESULT, VMEM_WRITE_ENABLE, VMEM_EXTENDED_PROGRESS_CHECK}, set at pre-compile, origin=Vector Informatik  # This parameter defines the type of the vMemFlashCommand.
          integer vMemCmdValue: 0..255, set at pre-compile, origin=Vector Informatik, default-value=0  # This value specifies the command of the vMemFlashCommand.
  module config vMem_Pre: definition=vMem
  module config vMem_Rec: definition=vMem
