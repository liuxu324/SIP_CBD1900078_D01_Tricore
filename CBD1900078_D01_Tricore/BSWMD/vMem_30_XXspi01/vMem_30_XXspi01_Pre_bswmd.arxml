AUTOSAR XML (schema 4-0-3)
# COPYRIGHT
# Copyright (c) 2019 by Vector Informatik GmbH. All rights reserved.
# This software is copyright protected and proprietary to Vector Informatik GmbH.
# Vector Informatik GmbH grants to you only those rights as set out in the license conditions.
package /MICROSAR/vMem_30_XXspi01
  module config vMem_Pre: definition=vMem
    14 x vMemDeviceInformation, all with vMemStatusRegisterLength=1, vMemStatusRegisterBusyFlagBitMask=1:
      Cypress_S25FL064: vMemSize=8388608, vMemResultCheck=1, vMemResultRegisterEraseErrorBitMask=64, vMemResultRegisterProgramErrorBitMask=32  # Cypress/Spansion S25FL064
        vMemFlashCommandList
          7 x vMemFlashCommand:
            ClearResultRegister: vMemCmdType=VMEM_CLEAR_RESULT, vMemCmdValue=48
            Erase: vMemCmdType=VMEM_ERASE, vMemCmdValue=32
            Read: vMemCmdType=VMEM_READ, vMemCmdValue=3
            ReadResultRegister: vMemCmdType=VMEM_READ_RESULT, vMemCmdValue=7
            ReadStatusRegister: vMemCmdType=VMEM_READ_STATUS, vMemCmdValue=5
            Write: vMemCmdType=VMEM_WRITE, vMemCmdValue=2
            WriteEnable: vMemCmdType=VMEM_WRITE_ENABLE, vMemCmdValue=6
      Cypress_S25FL256: vMemSize=33554432, vMemResultCheck=1, vMemResultRegisterEraseErrorBitMask=32, vMemResultRegisterProgramErrorBitMask=64  # Cypress/Spansion S25FL256
        vMemFlashCommandList
          7 x vMemFlashCommand:
            ClearResultRegister: vMemCmdType=VMEM_CLEAR_RESULT, vMemCmdValue=48
            Erase: vMemCmdType=VMEM_ERASE, vMemCmdValue=220
            Read: vMemCmdType=VMEM_READ, vMemCmdValue=19
            ReadResultRegister: vMemCmdType=VMEM_READ_RESULT, vMemCmdValue=5
            ReadStatusRegister: vMemCmdType=VMEM_READ_STATUS, vMemCmdValue=5
            Write: vMemCmdType=VMEM_WRITE, vMemCmdValue=18
            WriteEnable: vMemCmdType=VMEM_WRITE_ENABLE, vMemCmdValue=6
      Cypress_S25FL512: vMemSize=67108864, vMemResultCheck=1, vMemResultRegisterEraseErrorBitMask=32, vMemResultRegisterProgramErrorBitMask=64  # Cypress/Spansion S25FL512
        vMemFlashCommandList
          7 x vMemFlashCommand:
            ClearResultRegister: vMemCmdType=VMEM_CLEAR_RESULT, vMemCmdValue=48
            Erase: vMemCmdType=VMEM_ERASE, vMemCmdValue=220
            Read: vMemCmdType=VMEM_READ, vMemCmdValue=19
            ReadResultRegister: vMemCmdType=VMEM_READ_RESULT, vMemCmdValue=5
            ReadStatusRegister: vMemCmdType=VMEM_READ_STATUS, vMemCmdValue=5
            Write: vMemCmdType=VMEM_WRITE, vMemCmdValue=18
            WriteEnable: vMemCmdType=VMEM_WRITE_ENABLE, vMemCmdValue=6
      Cypress_S25FS512: vMemSize=67108864, vMemResultCheck=1, vMemResultRegisterEraseErrorBitMask=32, vMemResultRegisterProgramErrorBitMask=64  # Cypress/Spansion S25FS512
        vMemFlashCommandList
          7 x vMemFlashCommand:
            ClearResultRegister: vMemCmdType=VMEM_CLEAR_RESULT, vMemCmdValue=48
            Erase: vMemCmdType=VMEM_ERASE, vMemCmdValue=220
            Read: vMemCmdType=VMEM_READ, vMemCmdValue=19
            ReadResultRegister: vMemCmdType=VMEM_READ_RESULT, vMemCmdValue=5
            ReadStatusRegister: vMemCmdType=VMEM_READ_STATUS, vMemCmdValue=5
            Write: vMemCmdType=VMEM_WRITE, vMemCmdValue=18
            WriteEnable: vMemCmdType=VMEM_WRITE_ENABLE, vMemCmdValue=6
      Issi_IS25LP016D: vMemSize=2097152, vMemResultCheck=1, vMemResultRegisterEraseErrorBitMask=8, vMemResultRegisterProgramErrorBitMask=4, vMemExtendedProgressCheckFlagBitMask=1  # Issi IS25LP016D
        vMemFlashCommandList
          8 x vMemFlashCommand:
            ClearResultRegister: vMemCmdType=VMEM_CLEAR_RESULT, vMemCmdValue=130
            Erase: vMemCmdType=VMEM_ERASE, vMemCmdValue=215
            Read: vMemCmdType=VMEM_READ, vMemCmdValue=3
            ReadResultRegister: vMemCmdType=VMEM_READ_RESULT, vMemCmdValue=129
            ReadStatusRegister: vMemCmdType=VMEM_READ_STATUS, vMemCmdValue=5
            Write: vMemCmdType=VMEM_WRITE, vMemCmdValue=2
            WriteEnable: vMemCmdType=VMEM_WRITE_ENABLE, vMemCmdValue=6
            ExtendedProgressCheck: vMemCmdType=VMEM_EXTENDED_PROGRESS_CHECK, vMemCmdValue=129
      Issi_IS25LP032D: vMemSize=4194304, vMemResultCheck=1, vMemResultRegisterEraseErrorBitMask=8, vMemResultRegisterProgramErrorBitMask=4, vMemExtendedProgressCheckFlagBitMask=1  # Issi IS25LP032D
        vMemFlashCommandList
          8 x vMemFlashCommand:
            ClearResultRegister: vMemCmdType=VMEM_CLEAR_RESULT, vMemCmdValue=130
            Erase: vMemCmdType=VMEM_ERASE, vMemCmdValue=215
            Read: vMemCmdType=VMEM_READ, vMemCmdValue=3
            ReadResultRegister: vMemCmdType=VMEM_READ_RESULT, vMemCmdValue=129
            ReadStatusRegister: vMemCmdType=VMEM_READ_STATUS, vMemCmdValue=5
            Write: vMemCmdType=VMEM_WRITE, vMemCmdValue=2
            WriteEnable: vMemCmdType=VMEM_WRITE_ENABLE, vMemCmdValue=6
            ExtendedProgressCheck: vMemCmdType=VMEM_EXTENDED_PROGRESS_CHECK, vMemCmdValue=129
      Macronix_MX25L64: vMemSize=8388608, vMemResultCheck=0  # Macronix MX25L64
        vMemFlashCommandList
          5 x vMemFlashCommand:
            Erase: vMemCmdType=VMEM_ERASE, vMemCmdValue=32
            Read: vMemCmdType=VMEM_READ, vMemCmdValue=3
            Write: vMemCmdType=VMEM_WRITE, vMemCmdValue=2
            WriteEnable: vMemCmdType=VMEM_WRITE_ENABLE, vMemCmdValue=6
            ReadStatusRegister: vMemCmdType=VMEM_READ_STATUS, vMemCmdValue=5
      Micron_MT25QL256: vMemSize=33554432, vMemResultCheck=1, vMemResultRegisterEraseErrorBitMask=32, vMemResultRegisterProgramErrorBitMask=16, vMemExtendedProgressCheckFlagBitMask=128  # Micron MT25QL256
        vMemFlashCommandList
          8 x vMemFlashCommand:
            ClearResultRegister: vMemCmdType=VMEM_CLEAR_RESULT, vMemCmdValue=80
            Erase: vMemCmdType=VMEM_ERASE, vMemCmdValue=220
            Read: vMemCmdType=VMEM_READ, vMemCmdValue=19
            ReadResultRegister: vMemCmdType=VMEM_READ_RESULT, vMemCmdValue=112
            ReadStatusRegister: vMemCmdType=VMEM_READ_STATUS, vMemCmdValue=5
            Write: vMemCmdType=VMEM_WRITE, vMemCmdValue=18
            WriteEnable: vMemCmdType=VMEM_WRITE_ENABLE, vMemCmdValue=6
            ExtendedProgressCheck: vMemCmdType=VMEM_EXTENDED_PROGRESS_CHECK, vMemCmdValue=112
      Micron_MT25QL01G: vMemSize=134217728, vMemResultCheck=1, vMemResultRegisterEraseErrorBitMask=32, vMemResultRegisterProgramErrorBitMask=16, vMemExtendedProgressCheckFlagBitMask=128  # Micron MT25QL01G
        vMemFlashCommandList
          8 x vMemFlashCommand:
            ClearResultRegister: vMemCmdType=VMEM_CLEAR_RESULT, vMemCmdValue=80
            Erase: vMemCmdType=VMEM_ERASE, vMemCmdValue=220
            Read: vMemCmdType=VMEM_READ, vMemCmdValue=19
            ReadResultRegister: vMemCmdType=VMEM_READ_RESULT, vMemCmdValue=112
            ReadStatusRegister: vMemCmdType=VMEM_READ_STATUS, vMemCmdValue=5
            Write: vMemCmdType=VMEM_WRITE, vMemCmdValue=18
            WriteEnable: vMemCmdType=VMEM_WRITE_ENABLE, vMemCmdValue=6
            ExtendedProgressCheck: vMemCmdType=VMEM_EXTENDED_PROGRESS_CHECK, vMemCmdValue=112
      Micron_MT25QU256: vMemSize=33554432, vMemResultCheck=1, vMemResultRegisterEraseErrorBitMask=32, vMemResultRegisterProgramErrorBitMask=16, vMemExtendedProgressCheckFlagBitMask=128  # Micron MT25QU256
        vMemFlashCommandList
          8 x vMemFlashCommand:
            ClearResultRegister: vMemCmdType=VMEM_CLEAR_RESULT, vMemCmdValue=80
            Erase: vMemCmdType=VMEM_ERASE, vMemCmdValue=220
            Read: vMemCmdType=VMEM_READ, vMemCmdValue=19
            ReadResultRegister: vMemCmdType=VMEM_READ_RESULT, vMemCmdValue=112
            ReadStatusRegister: vMemCmdType=VMEM_READ_STATUS, vMemCmdValue=5
            Write: vMemCmdType=VMEM_WRITE, vMemCmdValue=18
            WriteEnable: vMemCmdType=VMEM_WRITE_ENABLE, vMemCmdValue=6
            ExtendedProgressCheck: vMemCmdType=VMEM_EXTENDED_PROGRESS_CHECK, vMemCmdValue=112
      Micron_N25Q128A: vMemSize=16777216, vMemResultCheck=1, vMemResultRegisterEraseErrorBitMask=32, vMemResultRegisterProgramErrorBitMask=16, vMemExtendedProgressCheckFlagBitMask=128  # Micron N25Q128A
        vMemFlashCommandList
          8 x vMemFlashCommand:
            ClearResultRegister: vMemCmdType=VMEM_CLEAR_RESULT, vMemCmdValue=80
            Erase: vMemCmdType=VMEM_ERASE, vMemCmdValue=216
            Read: vMemCmdType=VMEM_READ, vMemCmdValue=3
            ReadResultRegister: vMemCmdType=VMEM_READ_RESULT, vMemCmdValue=112
            ReadStatusRegister: vMemCmdType=VMEM_READ_STATUS, vMemCmdValue=5
            Write: vMemCmdType=VMEM_WRITE, vMemCmdValue=2
            WriteEnable: vMemCmdType=VMEM_WRITE_ENABLE, vMemCmdValue=6
            ExtendedProgressCheck: vMemCmdType=VMEM_EXTENDED_PROGRESS_CHECK, vMemCmdValue=112
      Winbond_W25Q32J: vMemSize=4194304, vMemResultCheck=0  # Winbond W25Q32J
        vMemFlashCommandList
          5 x vMemFlashCommand:
            Erase: vMemCmdType=VMEM_ERASE, vMemCmdValue=32
            Read: vMemCmdType=VMEM_READ, vMemCmdValue=3
            ReadStatusRegister: vMemCmdType=VMEM_READ_STATUS, vMemCmdValue=5
            Write: vMemCmdType=VMEM_WRITE, vMemCmdValue=2
            WriteEnable: vMemCmdType=VMEM_WRITE_ENABLE, vMemCmdValue=6
      Winbond_W25Q64J: vMemSize=8388608, vMemResultCheck=0  # Winbond W25Q64J
        vMemFlashCommandList
          5 x vMemFlashCommand:
            Erase: vMemCmdType=VMEM_ERASE, vMemCmdValue=32
            Read: vMemCmdType=VMEM_READ, vMemCmdValue=3
            ReadStatusRegister: vMemCmdType=VMEM_READ_STATUS, vMemCmdValue=5
            Write: vMemCmdType=VMEM_WRITE, vMemCmdValue=2
            WriteEnable: vMemCmdType=VMEM_WRITE_ENABLE, vMemCmdValue=6
      Winbond_W25Q64F: vMemSize=8388608, vMemResultCheck=0  # Winbond W25Q64F
        vMemFlashCommandList
          5 x vMemFlashCommand:
            Erase: vMemCmdType=VMEM_ERASE, vMemCmdValue=32
            Read: vMemCmdType=VMEM_READ, vMemCmdValue=3
            ReadStatusRegister: vMemCmdType=VMEM_READ_STATUS, vMemCmdValue=5
            Write: vMemCmdType=VMEM_WRITE, vMemCmdValue=2
            WriteEnable: vMemCmdType=VMEM_WRITE_ENABLE, vMemCmdValue=6
