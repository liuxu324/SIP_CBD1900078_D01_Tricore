AUTOSAR XML (schema 4-0-3)
package /MICROSAR
  module definition IoHwAb [0..1]: category=VENDOR_SPECIFIC_MODULE_DEFINITION, refined-module-def=IoHwAb, variants pre-compile  # I/O Hardware Abstraction | Configuration of the I/O Hardware Abstraction module
    container IoHwAbGeneral  # General Configuration | This container contains common configuration options for the I/O Hardware Abstraction module.
      boolean IoHwAbDevErrorDetect: set at pre-compile, origin=Vector Informatik, default-value=true  # Development Mode | This parameter enables/disables development error detection and reporting.
      boolean IoHwAbVersionInfoApi: set at pre-compile, origin=Vector Informatik, default-value=false  # Enable IoHwAb_GetVersionInfo | Pre-processor switch to enable/disable the API to read out the modules version information. Note: The function will be removed from the code completely.
      boolean IoHwAbUseInitFunction: set at pre-compile, origin=Vector Informatik, default-value=true  # Enable IoHwAb_Init | Pre-processor switch to enable/disable the Initialization-API. Note: The function will be removed from the code completely.
      string IoHwAbCfgIncludeList [0..*]: set at pre-compile, origin=Vector Informatik, default-value=Dio.h  # Include List for used basic software component headers.
    container IoHwAbDatatypes  # Data Types | Container for the data types configuration. There is a set of base types that cannot be changed, but can be used to create implementation specific types (Type references, Arrays or Structs/Records).
      container IoHwAbImplementationTypes  # Implementation Types | Container for the implementation specific datatypes. Implementation specific datatypes can be configured/assembled by using base datatypes.
        container IoHwAbTypeReference [0..*]  # Type Reference | Container for configuring a type reference. A type reference is a deviation from a base type, i.e. the generated files (e.g. Rte_Type.h) will contain a typedef like the following example: typedef sint8 BatteryVoltageValue;
          choice reference IoHwAbTypeReferenceTypeRef: set at pre-compile, origin=Vector Informatik, destination=IoHwAbBaseType  # Type Reference | Parameter for the selection of the datatype of the type reference.
          container IoHwAbInvalidValue [0..1]  # Optional container for configuring an invalid value for a IoHwAb type reference.
            choice container IoHwAbInvalidValueType  # This choice container is used for instantiating the appropriate type for the invalid value of the referenced data element. Example: If the type of the referenced base data type is either an "uint8" or a type reference of an "uint8", the container "IoHwAbInvalidValueUint8" shall be chosen.
              container IoHwAbInvalidValueBoolean [0..1]  # Container for configuring an invalid value of a type "boolean".
                boolean IoHwAbInvalidValue: set at pre-compile, origin=Vector Informatik  # This field contains the initial value of a type "boolean".
              container IoHwAbInvalidValueFloat32 [0..1]  # Container for configuring an invalid value of a type "float32".
                float IoHwAbInvalidValue: set at pre-compile, origin=Vector Informatik  # This field contains the initial value of a type "float32".
              container IoHwAbInvalidValueFloat64 [0..1]  # Container for configuring an invalid value of a type "float64".
                float IoHwAbInvalidValue: set at pre-compile, origin=Vector Informatik  # This field contains the initial value of a type "float64".
              container IoHwAbInvalidValueUint8 [0..1]  # Container for configuring an invalid value of a type "uint8".
                integer IoHwAbInvalidValue: 0..255, set at pre-compile, origin=Vector Informatik  # This field contains the initial value of a type "uint8".
              container IoHwAbInvalidValueUint16 [0..1]  # Container for configuring an invalid value of a type "uint16".
                integer IoHwAbInvalidValue: 0..65535, set at pre-compile, origin=Vector Informatik  # This field contains the initial value of a type "uint16".
              container IoHwAbInvalidValueUint32 [0..1]  # Container for configuring an invalid value of a type "uint32".
                integer IoHwAbInvalidValue: 0..4294967295, set at pre-compile, origin=Vector Informatik  # This field contains the initial value of a type "uint32".
              container IoHwAbInvalidValueSint8 [0..1]  # Container for configuring an invalid value of a type "sint8".
                integer IoHwAbInvalidValue: -128..127, set at pre-compile, origin=Vector Informatik  # This field contains the initial value of a type "sint8".
              container IoHwAbInvalidValueSint16 [0..1]  # Container for configuring an invalid value of a type "sint16".
                integer IoHwAbInvalidValue: -32768..32767, set at pre-compile, origin=Vector Informatik  # This field contains the initial value of a type "sint16".
              container IoHwAbInvalidValueSint32 [0..1]  # Container for configuring an invalid value of a type "sint32".
                integer IoHwAbInvalidValue: -2147483648..2147483647, set at pre-compile, origin=Vector Informatik  # This field contains the initial value of a type "sint32".
        container IoHwAbArray [0..*]  # Array | Container for configuring an array type. An array type is the typedef of an array containing n data elements of a base type or a type reference, i.e. the generated files (e.g. Rte_Type.h) will contain a typedef like the following example: typedef uint8 AlternatorPower_au8[13];
          integer IoHwAbArraySize: 0..18446744073709551615, set at pre-compile, origin=Vector Informatik, default-value=5  # Number of Array elements | Parameter for the configuration of the array size, i.e. the number of elements of the selected datatype.
          choice reference IoHwAbArrayTypeRef: set at pre-compile, origin=Vector Informatik, destination=[IoHwAbBaseType, IoHwAbTypeReference]  # Type Reference | Parameter for the selection of the datatype of the array elements.
        container IoHwAbRecord [0..*]  # Struct | Container for configuring a record/struct type. An record type is the typedef of a struct containing data elements of a base type or a type reference, i.e. the generated files (e.g. Rte_Type.h) will contain a typedef like the following example: typedef struct { uint16 Period; uint16 ActiveTime; }DutyCycle;
          container IoHwAbRecordElement [1..*]  # Struct Element | Container for configuring a record/struct element.
            integer IoHwAbRecordElementPosition: 0..255, set at pre-compile, origin=Vector Informatik, default-value=0  # Position | This parameter contains the position of the of the record element inside the record.
            choice reference IoHwAbRecordElementTypeRef: set at pre-compile, origin=Vector Informatik, destination=[IoHwAbBaseType, IoHwAbTypeReference]  # Type Reference | Parameter for the selection of the datatype of the struct/record elements.
      container IoHwAbBaseType [9..9]  # Base Data Types | Container for the base data types. These types are a representation of the standard types and cannot be changed.
        enumeration IoHwAbBaseDataType: set at pre-compile, origin=Vector Informatik, default-value=IOHWAB_UINT8  # Base Type | Label for the referenced base type. This type should be used within the user blocks instead of the base type itself.
          IOHWAB_UINT8  # uint8
          IOHWAB_UINT16  # uint16
          IOHWAB_UINT32  # uint32
          IOHWAB_SINT8  # sint8
          IOHWAB_SINT16  # sint16
          IOHWAB_SINT32  # sint32
          IOHWAB_BOOL  # boolean
          IOHWAB_FLOAT32  # float32
          IOHWAB_FLOAT64  # float64
    container IoHwAbRunnable [0..*]  # Runnable Entitiy | Container for configuring a Runnable Entity that will be generated as - Runnable into the SWC Description File of the I/O Hardware Abstraction - Function-body in the C-Source that can be filled with user code A Runnable Entity is called cyclically by the RTE. Note: More information on Runnables can be found in the 'Virtual Functional Bus' document.
      integer IoHwAbTriggerPeriod: 0..65535, set at pre-compile, origin=Vector Informatik, default-value=10  # Trigger Period | This field contains the trigger time of the Runnable Entity.
      enumeration IoHwAbTimebase: set at pre-compile, origin=Vector Informatik, default-value=IoHwAbMSec  # Timebase | This field contains the timebase of the trigger's time.
        IoHwAbSec  # sec
        IoHwAbMSec  # msec
      reference IoHwAbPortAccessRef [0..*]: set at pre-compile, origin=Vector Informatik, destination=IoHwAbSRPortPrototype  # Port Access | This parameter configures the port acces of the runnable. It allows to assign Port Prototypes that shall be accessed by this runnable.
    container IoHwAbSRPortPrototype [0..*]  # Sender/Receiver Port Prototype | Container for configuring a Sender/Receiver Port Prototype. This container is the instantiation of a Sender/Receiver Port Interface. Note: More information on Sender/Receiver Port Interfaces can be found in the 'Virtual Functional Bus' document.
      enumeration IoHwAbSRDirection: set at pre-compile, origin=Vector Informatik, default-value=IOHWAB_RECEIVER  # Direction | This parameter configures whether the BSW is the sender (PPort - provides values of data-elements) or the receiver (RPort - reads/consumes values of data-elements ) of the configured signal.
        IOHWAB_SENDER  # Sender
        IOHWAB_RECEIVER  # Receiver
      reference IoHwAbSRPortInterfaceRef: set at pre-compile, origin=Vector Informatik, destination=IoHwAbSRPortInterface  # Port Interface | This parameter configures which port prototype to use for this Interface. The selected port prototype will be used to instantiate the interface.
      choice reference IoHwAbSRUsedMcalEntity [0..1]: set at pre-compile, origin=Vector Informatik, destination=[DioChannel, DioChannelGroup]  # This parameter documents which 'MCAL entity' has been used for creating this port prototype.
      container IoHwAbInitValue [0..*]  # Container for configuring initial values of the data elements of the corresponding SR PortInterface. Note: Only the initial values of BaseTypes and TypeReferences can be configured.
        reference IoHwAbDataElementRef: set at pre-compile, origin=Vector Informatik, destination=IoHwAbDataElement  # This parameter configures which data element to use for this initial value.
        choice container IoHwAbInitValueType  # This choice container is used for instantiating the appropriate type for the initial value of the referenced data element. Example: If the type of the referenced data element is either an "uint8" or a type reference of an "uint8", the container "IoHwAbInitValueUint8" shall be chosen.
          container IoHwAbInitValueFloat32 [0..1]  # Container for configuring an initial value of a type "float32".
            float IoHwAbInitValue: set at pre-compile, origin=Vector Informatik  # This field contains the initial value of a type "float32".
          container IoHwAbInitValueBoolean [0..1]  # Container for configuring an initial value of a type "boolean".
            boolean IoHwAbInitValue: set at pre-compile, origin=Vector Informatik  # This field contains the initial value of a type "boolean".
          container IoHwAbInitValueUint16 [0..1]  # Container for configuring an initial value of a type "uint16".
            integer IoHwAbInitValue: 0..65535, set at pre-compile, origin=Vector Informatik  # This field contains the initial value of a type "uint16".
          container IoHwAbInitValueFloat64 [0..1]  # Container for configuring an initial value of a type "float64".
            float IoHwAbInitValue: set at pre-compile, origin=Vector Informatik  # This field contains the initial value of a type "float64".
          container IoHwAbInitValueUint8 [0..1]  # Container for configuring an initial value of a type "uint8".
            integer IoHwAbInitValue: 0..255, set at pre-compile, origin=Vector Informatik  # This field contains the initial value of a type "uint8".
          container IoHwAbInitValueUint32 [0..1]  # Container for configuring an initial value of a type "uint32".
            integer IoHwAbInitValue: 0..4294967295, set at pre-compile, origin=Vector Informatik  # This field contains the initial value of a type "uint32".
          container IoHwAbInitValueSint8 [0..1]  # Container for configuring an initial value of a type "sint8".
            integer IoHwAbInitValue: -128..127, set at pre-compile, origin=Vector Informatik  # This field contains the initial value of a type "sint8".
          container IoHwAbInitValueSint16 [0..1]  # Container for configuring an initial value of a type "sint16".
            integer IoHwAbInitValue: -32768..32767, set at pre-compile, origin=Vector Informatik  # This field contains the initial value of a type "sint16".
          container IoHwAbInitValueSint32 [0..1]  # Container for configuring an initial value of a type "sint32".
            integer IoHwAbInitValue: -2147483648..2147483647, set at pre-compile, origin=Vector Informatik  # This field contains the initial value of a type "sint32".
          container IoHwAbInitValueArrayOrRecord [0..1]  # Container for configuring an initial value of an array or a record.
            string IoHwAbInitValue: set at pre-compile, origin=Vector Informatik, default-value={}  # This field contains the initial value of an array or a record. All values ​​should, as usual with the array / struct notation, stand one after the other, separated by a comma within a curly bracket, Example - array with size 3 and init values 0, 1 and 2: {0,1,2}
    container IoHwAbCSPortPrototype [0..*]  # Client/Server Port Prototype | Container for configuring a Client/Server Port Prototype. This container is the instantiation of a Client/Server Port Interface. Note: More information on Client/Server Port Interfaces can be found in the 'Virtual Functional Bus' document.
      enumeration IoHwAbCSDirection: set at pre-compile, origin=Vector Informatik, default-value=IOHWAB_CLIENT  # Direction | This parameter configures whether the BSW is the Client (RPort - requires (=uses or invokes) the operations defined in the interface from an AUTOSAR service) or the Server (PPort - provides (=implements) the operations defined in the interface to an AUTOSAR service) of the configured signal. Note: Currently, the I/O Hardware Abstraction only supports Server Ports.
        IOHWAB_CLIENT  # Client
        IOHWAB_SERVER  # Server
      reference IoHwAbCSPortInterfaceRef: set at pre-compile, origin=Vector Informatik, destination=IoHwAbCSPortInterface  # Port Interface | This parameter configures which port prototype to use for this Interface. The selected port prototype will be used to instantiate the interface.
    container IoHwAbSRPortInterface [0..*]  # Sender/Receiver Interface | Container for configuring a Sender/Receiver Port Interface. This container holds the configuration elements for configuring a Sender/Receiver 'template'-interface. This interface is being instantiated by a Sender/Receiver Port Prototype. Note: More information on Sender/Receiver Port Interfaces can be found in the 'Virtual Functional Bus' document.
      enumeration IoHwAbTemplate: {IoHwAb_Template_None, IoHwAb_Template_ReadDioChannel, IoHwAb_Template_WriteDioChannel, IoHwAb_Template_ReadDioChannelGroup, IoHwAb_Template_WriteDioChannelGroup}, set at pre-compile, origin=Vector Informatik, default-value=IoHwAb_Template_None  # Used Template | This parameter documents which 'template' has been used for creating this port interface.
      container IoHwAbDataElement [1..*]  # Data Element | This container configures a data element of the Sender/Receiver Interface.
        enumeration IoHwAbInvalidationPolicy: {DontInvalidate, Keep, Replace}, set at pre-compile, origin=Vector Informatik, default-value=DontInvalidate  # This parameter configures whether the sending component can actively invalidate a particular data element or which strategy of handling invalid values is applied on the receiver side.
        choice reference IoHwAbDataElementTypeRef: set at pre-compile, origin=Vector Informatik, destination=[IoHwAbBaseType, IoHwAbTypeReference, IoHwAbArray, IoHwAbRecord]  # Parameter for the selection of the datatype of the Port Element.
    container IoHwAbCSPortInterface [0..*]  # Client/Server Port Interface | Container for configuring a Client/Server Port Interface. This container holds the configuration elements for configuring a Client/Server 'template'-interface. This interface is being instantiated by a Client/Server Port Prototype. Note: More information on Client/Server Port Interfaces can be found in the 'Virtual Functional Bus' document.
      enumeration IoHwAbTemplate: {IoHwAb_Template_None}, set at pre-compile, origin=Vector Informatik, default-value=IoHwAb_Template_None  # Parameter not used. This parameter documents which 'template' has been used for creating this port interface.
      container IoHwAbOperation [1..*]  # Container for configuring a Client/Server Port Operation.
        container IoHwAbOperationArgument [0..*]  # Argument | This container contains the configuration of am Operation Element of a Client/Server Operation. This Operation Element will be generated as function parameter in the I/O Hardware Abstraction implementation.
          enumeration IoHwAbArgDirection: set at pre-compile, origin=Vector Informatik, default-value=IOHWAB_IN  # Parameter Direction | Direction of the function parameter: - In: parameter is given by value - Out/InOut: parameter given 'by reference' (actually, it is given as a pointer to a variable)
            IOHWAB_IN  # In
            IOHWAB_OUT  # Out
            IOHWAB_INOUT  # In/Out
          integer IoHwAbOperationArgumentPosition: 0..255, set at pre-compile, origin=Vector Informatik, default-value=0  # Position | This parameter contains the position of the of the operation argument.
          choice reference IoHwAbArgTypeRef: set at pre-compile, origin=Vector Informatik, destination=[IoHwAbBaseType, IoHwAbTypeReference, IoHwAbArray, IoHwAbRecord]  # Type | Parameter for the selection of the datatype of the Operation Element.
      container IoHwAbApplicationError [1..*]  # Application Error | This container configures the name an application error, which may be result of a server call via the port interface. The configured application errors are available to all operations declared in this interface.
        integer IoHwAbErrorCode: 1..63, set at pre-compile, origin=Vector Informatik, default-value=1  # Error Code | This parameter configures the numeric value of an application error.
    container IoHwAbSchedulable [0..*]  # Schedulable Entitiy | Container for configuring a BSW Schedulable Entity that will be generated as - Schedulable Entity into the Internal Behavior File of the I/O Hardware Abstraction - Function-body in the C-Source that can be filled with user code A Runnable Entity is called cyclically by the SchM.
      integer IoHwAbBswTriggerPeriod: 0..65535, set at pre-compile, origin=Vector Informatik, default-value=10  # Trigger Period | This contains the trigger time of the Schedulable Entity.
      enumeration IoHwAbBswTimebase: set at pre-compile, origin=Vector Informatik, default-value=IoHwAbMSec  # Timebase | This field contains the timebase of the trigger's time.
        IoHwAbSec  # sec
        IoHwAbMSec  # msec
  bsw implementation IoHwAb_Impl: programming-language=C, sw-version=3.00.00, used-code-generator=cMSR, vendor-id=30, ar-release-version=4.00.03, behavior=IoHwAbBehavior, preconfigured-configuration=IoHwAb_Pre, recommended-configuration=IoHwAb_Rec, vendor-specific-module-def=IoHwAb
  module config IoHwAb_Pre: definition=IoHwAb
    IoHwAbDatatypes
      9 x IoHwAbBaseType:
        float64: IoHwAbBaseDataType=IOHWAB_FLOAT64
        float32: IoHwAbBaseDataType=IOHWAB_FLOAT32
        sint32: IoHwAbBaseDataType=IOHWAB_SINT32
        sint16: IoHwAbBaseDataType=IOHWAB_SINT16
        sint8: IoHwAbBaseDataType=IOHWAB_SINT8
        uint32: IoHwAbBaseDataType=IOHWAB_UINT32
        uint16: IoHwAbBaseDataType=IOHWAB_UINT16
        uint8: IoHwAbBaseDataType=IOHWAB_UINT8
        boolean: IoHwAbBaseDataType=IOHWAB_BOOL
  module config IoHwAb_Rec: definition=IoHwAb
  module config IoHwAb_Pre_Class2: definition=IoHwAb
    IoHwAbCSPortPrototype: IoHwAbCSDirection=IOHWAB_SERVER
  module config IoHwAb_Template_ReadDioChannel: definition=IoHwAb
    IoHwAbDatatypes
      IoHwAbImplementationTypes
        IoHwAb_DioChannelValueType (IoHwAbTypeReference): IoHwAbTypeReferenceTypeRef=boolean
    IoHwAbSRReadDioChannelIf (IoHwAbSRPortInterface): IoHwAbTemplate=IoHwAb_Template_ReadDioChannel
      DioValue (IoHwAbDataElement): IoHwAbDataElementTypeRef=IoHwAb_DioChannelValueType
    IoHwAbSRReadDioChannel (IoHwAbSRPortPrototype): IoHwAbSRDirection=IOHWAB_SENDER, IoHwAbSRPortInterfaceRef=IoHwAbSRReadDioChannelIf
  module config IoHwAb_Template_WriteDioChannel: definition=IoHwAb
    IoHwAbDatatypes
      IoHwAbImplementationTypes
        IoHwAb_DioChannelValueType (IoHwAbTypeReference): IoHwAbTypeReferenceTypeRef=boolean
    IoHwAbSRWriteDioChannelIf (IoHwAbSRPortInterface): IoHwAbTemplate=IoHwAb_Template_WriteDioChannel
      DioValue (IoHwAbDataElement): IoHwAbDataElementTypeRef=IoHwAb_DioChannelValueType
    IoHwAbSRWriteDioChannel (IoHwAbSRPortPrototype): IoHwAbSRDirection=IOHWAB_RECEIVER, IoHwAbSRPortInterfaceRef=IoHwAbSRWriteDioChannelIf
  module config IoHwAb_Template_ReadDioChannelGroup: definition=IoHwAb
    IoHwAbDatatypes
      IoHwAbImplementationTypes
        IoHwAb_DioChannelGroupValueType (IoHwAbTypeReference): IoHwAbTypeReferenceTypeRef=uint16
    IoHwAbSRReadDioChannelGroupIf (IoHwAbSRPortInterface): IoHwAbTemplate=IoHwAb_Template_ReadDioChannelGroup
      DioValue (IoHwAbDataElement): IoHwAbDataElementTypeRef=IoHwAb_DioChannelGroupValueType
    IoHwAbSRReadDioChannelGroup (IoHwAbSRPortPrototype): IoHwAbSRDirection=IOHWAB_SENDER, IoHwAbSRPortInterfaceRef=IoHwAbSRReadDioChannelGroupIf
  module config IoHwAb_Template_WriteDioChannelGroup: definition=IoHwAb
    IoHwAbDatatypes
      IoHwAbImplementationTypes
        IoHwAb_DioChannelGroupValueType (IoHwAbTypeReference): IoHwAbTypeReferenceTypeRef=uint16
    IoHwAbSRWriteDioChannelGroupIf (IoHwAbSRPortInterface): IoHwAbTemplate=IoHwAb_Template_WriteDioChannelGroup
      DioValue (IoHwAbDataElement): IoHwAbDataElementTypeRef=IoHwAb_DioChannelGroupValueType
    IoHwAbSRWriteDioChannelGroup (IoHwAbSRPortPrototype): IoHwAbSRDirection=IOHWAB_RECEIVER, IoHwAbSRPortInterfaceRef=IoHwAbSRWriteDioChannelGroupIf
