AUTOSAR XML (schema 4-0-3)
package /MICROSAR
  module config SoAd_Pre: definition=SoAd
  module config SoAd_Rec: definition=SoAd, implementation-config-variant=VARIANT-PRE-COMPILE
    SoAdGeneral: SoAdDevErrorDetect=1, SoAdDoIpVersionInfoApi=0, SoAdVersionInfoApi=0, SoAdTcpIpVersionInfoApi=0, SoAdProdErrorDetect=1
