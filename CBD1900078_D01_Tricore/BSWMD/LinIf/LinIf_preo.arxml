AUTOSAR XML (schema 4-0-3)
package /MICROSAR
  module config LinIf_Rec: definition=LinIf, implementation-config-variant=VARIANT-PRE-COMPILE
