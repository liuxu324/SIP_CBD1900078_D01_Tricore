AUTOSAR XML (schema 4-0-3)
package /MICROSAR
  bsw implementation LinIf_Impl: programming-language=C, sw-version=6.00.00, used-code-generator=DaVinci Configurator, vendor-id=30, ar-release-version=4.00.03, behavior=LinIfBehavior, preconfigured-configuration=LinIf_Pre, recommended-configuration=LinIf_Rec, vendor-specific-module-def=LinIf
  module definition LinIf [0..1]: category=VENDOR_SPECIFIC_MODULE_DEFINITION, refined-module-def=LinIf, variants post-build-loadable/pre-compile/post-build-selectable  # Configuration of the LINIF (LIN Interface) module.
    container LinIfGeneral  # General configuration parameters of the LINIF.
      boolean LinIfCancelTransmitSupported: set at pre-compile, default-value=false  # This parameter enables the LinIf_CancelTransmit API.The LinIf_CancelTransmit API does not contain any functionality, but may be required by upper layer modules.
      boolean LinIfDevErrorDetect: set at pre-compile, default-value=true  # This parameter switches the Development Error Detection and Notification ON or OFF. true: Development error detection is enabled. false: Development error detection is disabled. Note: In general, the development error detection is recommended during pre-test phase. It is not recommended to enable the development error detection in production code due to increased runtime and ROM needs.
      boolean LinIfMultipleDriversSupported: set at pre-compile, default-value=false  # This parameter defines if multiple drivers are included in the LIN Interface or not. The reason for this parameter is to reduce the size of LIN Interface if multiple drivers are not used.
      boolean LinIfMultipleTrcvDriverSupported: set at pre-compile, default-value=false  # This parameter defines if multiple transceiver drivers are included in the LIN Interface or not. The reason for this parameter is to reduce the size of LIN Interface if multiple transceiver drivers are not used.
      boolean LinIfNcOptionalRequestSupported: set at pre-compile, default-value=true  # This parameter defines if the node configuration commands Assign NAD and Conditional Change NAD are supported. Optional node configuration services are always supported by Vector LINIF (depending on schedule table command definitions in the current configuration).
      string LinIfPublicCddHeaderFile [0..*]: set at pre-compile, max-length=32, min-length=1  # This parameter defines header files for callback functions which shall be included in case of CDDs. All CDD callback functions configured in LinIfGotoSleepConfirmationFctUL, LinIfScheduleRequestConfirmationFctUL, LinIfWakeupConfirmationUL, LinIfTxConfirmationUL, LinIfTxTriggerTransmitUL and LinIfUserRxIndicationUL must be declared in these header files. Range of characters is 1.. 32.
      boolean LinIfTpSupported: set at pre-compile, default-value=false  # This parameter defines if the LINTP is included in the LIN Interface or not. The reason for this parameter is to reduce the size of LIN Interface if the TP is not used. LinTp can only be enabled if it is contained in the current license.
      boolean LinIfTrcvDriverSupported: set at pre-compile, default-value=false  # This parameter defines if LIN transceiver drivers are included in the LIN Interface or not. The reason for this parameter is to reduce the size of LIN Interface if transceiver drivers are not used.
      boolean LinIfVersionInfoApi: set at pre-compile, default-value=false  # This parameter enables/disables the function LinIf_GetVersionInfo() to get major, minor and patch version information.
      boolean LinIfEvtFrameSupported: set at pre-compile, origin=Vector Informatik, default-value=false  # This parameter defines if event triggered (EVT) frames are supported in the LIN Interface or not. The reason for this parameter is to reduce the size of LIN Interface if EVT frames are not used.
      boolean LinIfSporadicFrameSupported: set at pre-compile, origin=Vector Informatik, default-value=false  # This parameter defines if sporadic frames are supported in the LIN Interface or not. The reason for this parameter is to reduce the size of LIN Interface if sporadic frames are not used.
      string LinIfUserConfigFile [0..1]: set at pre-compile, origin=Vector Informatik  # Reference to an external text file that will be included during generation to LinIf_Cfg.h. The content of the user configuration file will be added at the end of the generated module configuration file and allows altering or extending the generated code. Caution: User configuration files can cause the software module to malfunction and must only be used with great care.
      boolean LinIfRuntimeMeasurementSupport: set at pre-compile, origin=Vector Informatik, default-value=false  # If enabled runtime measurement points are added to the BSW module code and are added to the module configuration of MICROSAR RTM. The available measurement points can be seen and configured in the RTM module configuration. Availability of the MICROSAR RTM module is a prerequisite to make use of the runtime measurement functionality. Runtime measurement should be disabled in production code as measurement points may inflict additional runtime.
      boolean LinIfScheduleEndNotificationSupported: set at pre-compile, origin=Vector Informatik, default-value=false  # If enabled the LinIf will report the end of the current schedule table to the LinSm when the last frame header of the schedule table has been transmitted. This allows the upper layers to change to a different schedule table after processing the current one completely.
      boolean LinIfJ2602ResponseToleranceSupport [0..1]: set at pre-compile, origin=Vector Informatik, default-value=false  # This parameter enables the configuration of frame response tolerances to values different than the fixed 40% of the LIN standard. If enabled, the maximum header duration in bits, the response tolerance of Tx frames and the response tolerance of all Rx frames have to be configured. These values are used to calculate the maximum duration time of frames. The intended use of this feature is the support of SAE J2602 response tolerances.
      boolean LinIfSafeBswChecks: set at pre-compile, origin=Vector Informatik, default-value=false  # Selects if safety checks are used. These checks improve robustness as e.g. invalid parameters are checked before function is executed. This attribute has to be enabled for safety projects where this component is mapped to an ASIL partition.
      boolean LinIfScheduleInfoApi [0..1]: set at pre-compile, origin=Vector Informatik, default-value=false  # This parameter enables/disables the function LinIf_GetScheduleInfo() to get detailed information about the current schedule table handler state.
      boolean LinIfBusMirroringSupported: set at pre-compile, origin=Vector Informatik, default-value=false  # States if Bus Mirroring is enabled in the LIN Interface or not. The reason for this parameter is to reduce the size of LIN Interface if the Bus Mirroring is not used. This parameter is introduced in AUTOSAR 4.4.
      container LinIfOptimization [0..1]  # Optional optimization configuration parameters of the LINIF. These parameters affect the generated data using the ComStackLib module.
        boolean LinIfOptimizeConstArrays2Define: set at pre-compile, origin=Vector Informatik, default-value=false  # This parameter activates/deactivates the capability to generate CONFIG-CLASS PRE-COMPILE ROM arrays as constant define. TRUE: ROM arrays are generated as constant define if all values are identical. Code: the code size is smaller. RAM: no change expected. ROM: the ROM size is minimized. Runtime: the runtime is increased. FALSE: ROM arrays are generated as data even if all values are identical.
        enumeration LinIfMinimizeNumericalDataTypes: {NONE, MINIMIZE_NUMERICAL_DATA_TYPES_WITHOUT_CAST, MINIMIZE_NUMERICAL_DATA_TYPES_WITH_CAST}, set at pre-compile, origin=Vector Informatik, default-value=MINIMIZE_NUMERICAL_DATA_TYPES_WITH_CAST  # This parameter is used to minimize the datatypes of CONFIG-CLASS PRE-COMPILE numerical data based on the used values. NONE: The datatype is not minimized. MINIMIZE_NUMERICAL_DATA_TYPES_WITHOUT_CAST: The datatype of numerical data is minimized. Unsigned data types are not changed to signed datatypes. Code: the code size is reduced. RAM: the RAM size is reduced. ROM: the ROM size is reduced. Runtime: no change expected. MINIMIZE_NUMERICAL_DATA_TYPES_WITH_CAST: The datatype of numerical data is minimized. Unsigned data types can be optimized to signed datatypes. Code: the code size is reduced. RAM: the RAM size is reduced. ROM: the ROM size is reduced. Runtime: no change expected.
        enumeration LinIfConstDataDeduplication: {NONE, DEDUPLICATE_CONST_DATA_WITHOUT_CAST, DEDUPLICATE_CONST_DATA_WITH_CAST}, set at pre-compile, origin=Vector Informatik, default-value=DEDUPLICATE_CONST_DATA_WITH_CAST  # This parameter is used to deduplicate CONFIG-CLASS PRE-COMPILE ROM data. NONE: The generated data is not deduplicated. DEDUPLICATE_CONST_DATA_WITHOUT_CAST: The data is deduplicated without using casts. Code: no change expected. RAM: no change expected. ROM: the ROM size can be minimized. Runtime: no change expected. DEDUPLICATE_CONST_DATA_WITH_CAST: The data is deduplicated using casts. Code: no change expected. RAM: no change expected. ROM: the ROM size can be minimized more than in DEDUPLICATE_CONST_DATA_WITHOUT_CAST. Runtime: no change expected.
    container LinIfGlobalConfig  # Global configuration parameters of the LINIF. | It is a MultipleConfigurationContainer, i.e. this container and its sub-containers exit once per configuration set.
      float LinIfTimeBase: 0.001..0.255, set at link in variant post-build-loadable / pre-compile in variant pre-compile+post-build-selectable, default-value=0.005  # This value specifies the call cycle of LinIf_MainFunction(). It has to be equal to the time_base value of the underlying LDF. It is a common divisor of all LinIfClusterTimeBase values.
      container LinIfChannel [1..*]  # Channel specific configuration parameters of the LINIF.
        integer LinIfChannelId: 0..255, set at link in variant post-build-loadable+post-build-selectable / pre-compile in variant pre-compile, symbolic-name-value=true, default-value=0  # This value specifies the unique channel index value beginning with 0. | Implementation Type: NetworkHandleType
        enumeration LinIfGotoSleepConfirmationUL: {CDD, LIN_SM}, set at post-build in variant post-build-loadable+post-build-selectable / pre-compile in variant pre-compile, default-value=LIN_SM  # This parameter defines the upper layer (UL) module to which the confirmation of the goto-sleep command shall be reported.
        enumeration LinIfScheduleRequestConfirmationUL: {CDD, LIN_SM}, set at post-build in variant post-build-loadable+post-build-selectable / pre-compile in variant pre-compile, default-value=LIN_SM  # This parameter defines the upper layer (UL) module to which the confirmation of the successfully performed schedule table change shall be reported.
        enumeration LinIfStartupState: {NORMAL, SLEEP}, set at link in variant post-build-loadable / post-build in variant post-build-selectable / pre-compile in variant pre-compile, default-value=SLEEP  # Defines the state of this LIN channel after initialization.
        enumeration LinIfWakeupConfirmationUL: {CDD, LIN_SM}, set at post-build in variant post-build-loadable+post-build-selectable / pre-compile in variant pre-compile, default-value=LIN_SM  # This parameter defines the upper layer (UL) module to which the confirmation of the wake-up shall be reported.
        float LinIfWakeupDelay: 0..0.1, set at post-build in variant post-build-loadable+post-build-selectable / pre-compile in variant pre-compile, origin=Vector Informatik, default-value=0.1  # This parameter specifies the delay after wakeup frame transmission (internal wakeup) before scheduling is started. The default value of 100ms is according to LIN 2.x / ISOLIN specification.
        function name LinIfGotoSleepConfirmationFctUL [0..1]: set at post-build in variant post-build-loadable+post-build-selectable / pre-compile in variant pre-compile, origin=Vector Informatik  # This parameter defines the name of the upper layer <User_GotoSleepConfirmation>. This parameter depends on the parameter LinIfGotoSleepConfirmationUL. It is only used if LinIfGotoSleepConfirmationUL has value CDD.
        function name LinIfScheduleRequestConfirmationFctUL [0..1]: set at post-build in variant post-build-loadable+post-build-selectable / pre-compile in variant pre-compile, origin=Vector Informatik  # This parameter defines the name of the upper layer <User_ScheduleRequestConfirmation>. This parameter depends on the parameter LinIfScheduleRequestConfirmationUL. It is only used if LinIfScheduleRequestConfirmationUL has value CDD.
        function name LinIfWakeupConfirmationFctUL [0..1]: set at post-build in variant post-build-loadable+post-build-selectable / pre-compile in variant pre-compile, origin=Vector Informatik  # This parameter defines the name of the upper layer <User_WakeupConfirmation>. This parameter depends on the parameter LinIfWakeupConfirmationUL. It is only used if LinIfWakeupConfirmationUL has value CDD.
        integer LinIfJ2602HeaderTolerance [0..1]: 34..48, set at post-build in variant post-build-loadable+post-build-selectable / pre-compile in variant pre-compile, origin=Vector Informatik, default-value=48  # This parameter defines the maximum header length in bits. The default value of 48 bits is according to the LIN standard. The intended use of this parameter is the support of SAE J2602 header tolerance values. This parameter is only applicable if the general SAE J2602 response tolerance support is enabled.
        integer LinIfJ2602ResponseToleranceTx [0..1]: 0..40, set at post-build in variant post-build-loadable+post-build-selectable / pre-compile in variant pre-compile, origin=Vector Informatik, default-value=40  # This parameter defines the maximum response tolerance of Tx frames in percent. The default value of 40% is according to the LIN standard. The intended use of this parameter is the support of SAE J2602 response tolerance values. This parameter is only applicable if the general SAE J2602 response tolerance support is enabled.
        boolean LinIfScheduleChangeNextTimeBase [0..1]: set at post-build in variant post-build-loadable+post-build-selectable / pre-compile in variant pre-compile, origin=Vector Informatik, default-value=false  # This parameter defines the point in time where a schedule table switch is performed. If it's disabled, a schedule table switch is performed at the end of the current schedule table slot. If this parameter is enabled, a schedule table switch is performed when the message transmission / reception within the current slot is finished. This parameter is introduced due to AUTOSAR 4.3.0.
        float LinIfWakeupDelayExternal: 0..0.1, set at post-build in variant post-build-loadable+post-build-selectable / pre-compile in variant pre-compile, origin=Vector Informatik, default-value=0.1  # This parameter specifies the delay after wakeup frame reception (external wakeup) before scheduling is started. The default value of 100ms is according to LIN 2.x / ISOLIN specification.
        symbolic name reference LinIfChannelRef: set at link in variant post-build-loadable / post-build in variant post-build-selectable / pre-compile in variant pre-compile, destination=LinChannel  # Reference to the used channel in Lin. | Replaces LINIF_CHANNEL_INDEX
        symbolic name reference LinIfComMNetworkHandleRef: set at link in variant post-build-loadable / post-build in variant post-build-selectable / pre-compile in variant pre-compile, destination=ComMChannel  # ComM Network Handle Ref | Reference to a network handle in ComM.
        container LinIfFrame [0..*]: post-build-changeable=true  # Generic container for all types of LIN frames. The ShortName of this container is used as LinIfFrameName.
          enumeration LinIfChecksumType: {CLASSIC, ENHANCED}, set at post-build in variant post-build-loadable+post-build-selectable / pre-compile in variant pre-compile, default-value=ENHANCED  # This parameter defines the type of checksum that the frame is using.
          enumeration LinIfFrameType: {ASSIGN, ASSIGN_FRAME_ID_RANGE, ASSIGN_NAD, CONDITIONAL, EVENT_TRIGGERED, FREE, MRF, SAVE_CONFIGURATION, SPORADIC, SRF, UNASSIGN, UNCONDITIONAL}, set at post-build in variant post-build-loadable+post-build-selectable / pre-compile in variant pre-compile, default-value=UNCONDITIONAL  # This parameter defines the type of frame (e.g. sporadic frame). | The sporadic slot is not found among the frame types. A sporadic slot is a set of sporadic frames.
          integer LinIfLength: 1..8, set at post-build in variant post-build-loadable+post-build-selectable / pre-compile in variant pre-compile, default-value=8  # This value specifies the length of the LIN frame in bytes.
          integer LinIfPid: 0..255, set at post-build in variant post-build-loadable+post-build-selectable / pre-compile in variant pre-compile, default-value=0  # This value specifies the protected ID of the LIN frame. There is no reason to calculate the parity in run-time.
          container LinIfFixedFrameSdu [0..1]  # This container includes the bytes send within a Fixed Frame. The container is only required in case the LinIfFrameType is one of the following: ASSIGN ASSIGN_FRAME_ID_RANGE ASSIGN_NAD CONDITIONAL FREE SAVE_CONFIGURATION UNASSIGN | This container represent an eight byte array. The Byte order shall be MSB first.
            container LinIfFixedFrameSduByte [8..8]  # This container represents a byte within the 8 byte array.
              integer LinIfFixedFrameSduBytePos: 0..7, set at post-build in variant post-build-loadable+post-build-selectable / pre-compile in variant pre-compile, default-value=0  # This value specifies the index of the byte in the fixed frame.
              integer LinIfFixedFrameSduByteVal: 0..255, set at post-build in variant post-build-loadable+post-build-selectable / pre-compile in variant pre-compile, default-value=0  # This value specifies the byte value in the fixed frame.
          choice container LinIfPduDirection  # This container specifies the direction of the frame.
            container LinIfInternalPdu [0..1]  # This choice container specifies a Diagnostic or Configuration frame : no Message ID (no PduId).
            container LinIfRxPdu [0..1]  # This choice container specifies a received PDU/frame.
              function name LinIfRxIndicationUL [0..1]: set at post-build in variant post-build-loadable+post-build-selectable / pre-compile in variant pre-compile  # This parameter defines the name of the <User_RxIndication>. This parameter depends on the parameter LinIfUserRxIndicationUL. If LinIfUserRxIndicationUL equals PDUR, the name of the <User_RxIndication> is fixed to PduR_LinIfRxIndication. If LinIfUserRxIndicationUL equals CDD, the name of the <User_RxIndication> is selectable. | If LinIfUserRxIndicationUL equals PDUR, the name of the <User_RxIndication> is fixed. If LinIfUserRxIndicationUL equals CDD, the name of the <User_RxIndication> is selectable.
              enumeration LinIfUserRxIndicationUL: {CDD, PDUR}, set at post-build in variant post-build-loadable+post-build-selectable / pre-compile in variant pre-compile, default-value=PDUR  # This parameter defines the upper layer (UL) module to which the indication of the successfully received LINRXPDUID has to be routed via <User_RxIndication>. | This <User_RxIndication> has to be invoked when the indication of the configured LINRXPDUID will be received by a Rx indication event from the LIN Driver module.
              integer LinIfJ2602ResponseToleranceRx [0..1]: 0..40, set at post-build in variant post-build-loadable+post-build-selectable / pre-compile in variant pre-compile, origin=Vector Informatik, default-value=40  # This parameter defines the maximum response tolerance of a Rx frame in percent. The default value of 40% is according to the LIN standard. The intended use of this parameter is the support of SAE J2602 response tolerance values. This parameter is only applicable if the general SAE J2602 response tolerance support is enabled.
              reference LinIfRxPduRef: set at post-build in variant post-build-loadable+post-build-selectable / pre-compile in variant pre-compile, destination=Pdu  # Reference to the global PDU that is received in this frame.
            container LinIfSlaveToSlavePdu [0..1]  # This choice container specifies a slave-to-slave PDU/frame. Master does only send the header but doesn't receive the response. | Added for completeness
            container LinIfTxPdu [0..1]  # This choice container specifies a transmitted PDU/frame.
              function name LinIfTxConfirmationUL [0..1]: set at post-build in variant post-build-loadable+post-build-selectable / pre-compile in variant pre-compile  # This parameter defines the name of the <User_TxConfirmation>. This parameter depends on the parameter LinIfUserTxUL. If LinIfUserTxUL equals PDUR, the name of the <User_TxConfirmation> is fixed to PduR_LinIfTxConfirmation. If LinIfUserTxUL equals CDD, the name of the <User_TxConfirmation> is selectable. | If LinIfUserTxUL equals PDUR, the name of the <User_TxConfirmation> is fixed. If LinIfUserTxUL equals CDD, the name of the <User_TxConfirmation> is selectable.
              integer LinIfTxPduId: 0..65535, set at link in variant post-build-loadable+post-build-selectable / pre-compile in variant pre-compile, symbolic-name-value=true, default-value=0  # This value specifies the identifier of the PDU for the upper layer.
              function name LinIfTxTriggerTransmitUL [0..1]: set at post-build in variant post-build-loadable+post-build-selectable / pre-compile in variant pre-compile  # This parameter defines the name of the <User_TriggerTransmit>. This parameter depends on the parameter LinIfUserTxUL. If LinIfUserTxUL equals PDUR, the name of the <User_TriggerTransmit> is fixed to PduR_LinIfTriggerTransmit. If LinIfUserTxUL equals CDD, the name of the <User_TriggerTransmit> is selectable. | If LinIfUserTxUL equals CDD, the name of the <User_TriggerTransmit> is selectable.
              enumeration LinIfUserTxUL: {CDD, PDUR}, set at post-build in variant post-build-loadable+post-build-selectable / pre-compile in variant pre-compile, default-value=PDUR  # This parameter defines the upper layer (UL) module to which the trigger of the transmitted LinTxPdu (via the <User_TriggerTransmit>) or the confirmation of the successfully transmitted LinTxPdu has to be routed (via the <User_TxConfirmation>).
              reference LinIfTxPduRef: set at post-build in variant post-build-loadable+post-build-selectable / pre-compile in variant pre-compile, destination=Pdu  # Reference to the global PDU that is transmitted in this frame.
          container LinIfSubstitutionFrames [0..*]  # This container includes a list of unconditional Frames that can be sent in a Sporadic Frame slot.
            integer LinIfFramePriority: 0..255, set at post-build in variant post-build-loadable+post-build-selectable / pre-compile in variant pre-compile, default-value=0  # This value specifies the priority of an unconditional frame if used as a sporadic frame. 255 is highest priority, 0 is lowest priority
            reference LinIfSubstitutionFrameRef: set at post-build in variant post-build-loadable+post-build-selectable / pre-compile in variant pre-compile, destination=LinIfFrame  # Reference to an unconditional Frame that can be sent in a Sporadic Frame slot.
        container LinIfMaster  # This container includes all parameters relevant for a LIN Master configuration. Each LIN Master can only be connected to one physical channel.
          float LinIfClusterTimeBase: 0.001..0.255, set at link in variant post-build-loadable / post-build in variant post-build-selectable / pre-compile in variant pre-compile, default-value=0.005  # This value specifies the time-base for one LIN cluster (normally 2, 5 or 10ms).
          float LinIfJitter: 0..0.255, set at pre-compile, default-value=0  # This value specifies the jitter between the maximum and minimum delay of the start of two successive frames. Note: This value is not used by the implementation, but can be used for verifying.
          float LinIfLoadBalancingOffset: 0..0.255, set at pre-compile, origin=Vector Informatik, default-value=0  # This value specifies the delay in ticks after the mainfunction of this channel is actually started after the first call of LinIf_MainFunction. The actual offset in milliseconds depends also on the parameter LinIfTimeBase. The usage of this parameter is to minimize the worst case execution time of LinIf_MainFunction by balancing the load of individual channels to different main function cycles. Refer to the technical reference for further configuration and integration hints of this feature.
        container LinIfScheduleTable [1..*]: post-build-changeable=true  # This container includes the description of a schedule table. Each LinIfChannel may have several schedule tables. Each schedule table can only be connected to one channel.
          enumeration LinIfResumePosition: {CONTINUE_AT_IT_POINT, START_FROM_BEGINNING}, set at post-build in variant post-build-loadable+post-build-selectable / pre-compile in variant pre-compile, default-value=START_FROM_BEGINNING  # This value specifies where a schedule table shall be proceeded in case if it has been interrupted by a RUN-ONCE table. CONTINUE_AT_IT_POINT: Schedule processing continues with subsequent slot where the interruption happened. START_FROM_BEGINNING: Schedule processing starts after interruption with the first slot of the table.
          enumeration LinIfRunMode: {RUN_CONTINUOUS, RUN_ONCE}, set at post-build in variant post-build-loadable+post-build-selectable / pre-compile in variant pre-compile, default-value=RUN_CONTINUOUS  # This value specifies the mode of the schedule table: Run continuous: After setting this schedule table it is repeated until another continuous schedule table is selected. Run once: After selecting this schedule table it is transmitted once, afterward the before set schedule table is transmitted again.
          enumeration LinIfScheduleMode: {LINTP_APPLICATIVE_SCHEDULE, LINTP_DIAG_REQUEST, LINTP_DIAG_RESPONSE}, set at post-build in variant post-build-loadable+post-build-selectable / pre-compile in variant pre-compile, default-value=LINTP_APPLICATIVE_SCHEDULE  # This parameter defines the mode of the schedule table. Note: Parameter not used!
          integer LinIfScheduleTableIndex: 0..255, set at link in variant post-build-loadable+post-build-selectable / pre-compile in variant pre-compile, symbolic-name-value=true, default-value=0  # This value specifies the unique index used by upper layers to identify a schedule. Note that the NULL_SCHEDULE for each channel has index 0.
          string LinIfScheduleTableName [0..1]: set at post-build in variant post-build-loadable+post-build-selectable / pre-compile in variant pre-compile  # Optional schedule name used to cross-reference with a LDF. This parameter shall always be accompanied by LIN_IF_SCHEDULE_INDEX. Note: Parameter not used! Instead the ShortName of the parent container is used.
          container LinIfEntry [0..*]: post-build-changeable=true  # This container includes the configuration of a schedule table entry (also known as Frame Slot).
            float LinIfDelay: 0..0.255, set at post-build in variant post-build-loadable+post-build-selectable / pre-compile in variant pre-compile, default-value=0.01  # This value specifies the delay to next entry in the schedule table .
            integer LinIfEntryIndex: 0..255, set at post-build in variant post-build-loadable+post-build-selectable / pre-compile in variant pre-compile, default-value=0  # This value specifies the position of the frame entry in the schedule table. The first entry index in the schedule table is 0.
            reference LinIfCollisionResolvingRef [0..1]: set at post-build in variant post-build-loadable+post-build-selectable / pre-compile in variant pre-compile, destination=LinIfScheduleTable  # Reference to the schedule table, which resolves the collision. This reference is only applicable in case of an event-triggered frame.
            reference LinIfFrameRef [1..*]: set at post-build in variant post-build-loadable+post-build-selectable / pre-compile in variant pre-compile, destination=LinIfFrame  # Reference to the frames that belong to this schedule table entry.
        container LinIfSlave [0..16]: post-build-changeable=true  # This container includes all attributes of the LIN slaves. The ShortName of this container is used as LinIfNodeName. Vector Informatik: Upper limit of is set to 16 according to the physical layer specification of LIN 2.x.
          integer LinIfConfiguredNad: 0..255, set at post-build in variant post-build-loadable+post-build-selectable / pre-compile in variant pre-compile, default-value=0  # This value specifies the diagnostic address of the LIN slave after configuration (NAD).
          integer LinIfFunctionId: 0..65535, set at post-build in variant post-build-loadable+post-build-selectable / pre-compile in variant pre-compile, default-value=0  # This value specifies the LIN function identifier which is used within the node configuration commands. Vector Informatik: Range changed to 16-bit to be LIN2.1 compliant.
          string LinIfProtocolVersion: set at post-build in variant post-build-loadable+post-build-selectable / pre-compile in variant pre-compile, default-value=2.1  # This value specifies the LIN protocol version which is used by the LIN slave.
          integer LinIfSupplierId: 0..65535, set at post-build in variant post-build-loadable+post-build-selectable / pre-compile in variant pre-compile, default-value=0  # This value specifies the LIN supplier identifier which is used within the node configuration commands.
          integer LinIfVariant: 0..255, set at post-build in variant post-build-loadable+post-build-selectable / pre-compile in variant pre-compile, default-value=0  # This value specifies the LIN variant identifier which is used within the node configuration commands.
        container LinIfTransceiverDrvConfig [0..1]  # This container includes the configuration (parameters) of all addressed LIN transceivers by each underlying LIN Transceiver Driver.
          symbolic name reference LinIfTrcvIdRef: set at link in variant post-build-loadable+post-build-selectable / pre-compile in variant pre-compile, destination=LinTrcvChannel  # Reference to the logical handle of the underlying LIN transceiver to be served by the LIN Interface.
  bsw implementation LinTp_Impl: programming-language=C, sw-version=6.00.00, used-code-generator=DaVinci Configurator, vendor-id=30, ar-release-version=4.00.03, behavior=LinTpBehavior, preconfigured-configuration=LinTp_Pre, recommended-configuration=LinTp_Rec, vendor-specific-module-def=LinTp
  module definition LinTp [0..1]: category=VENDOR_SPECIFIC_MODULE_DEFINITION, refined-module-def=LinTp, variants post-build-loadable/pre-compile/post-build-selectable  # Configuration of the LINTP (LIN Transport Protocol) module.
    container LinTpGeneral  # General configuration parameters of the LINTP.
      boolean LinTpVersionInfoApi: set at pre-compile, default-value=false  # This parameter enables/disables the function LinTp_GetVersionInfo() to get major, minor and patch version information.
      string LinTpUserConfigFile [0..1]: set at pre-compile, origin=Vector Informatik  # Reference to an external text file that will be included during generation to LinTp_Cfg.h. The content of the user configuration file will be added at the end of the generated module configuration file and allows altering or extending the generated code. Caution: User configuration files can cause the software module to malfunction and must only be used with great care!
      boolean LinTpForwardRespPendingFrames: set at pre-compile, origin=Vector Informatik, default-value=true  # This parameter defines if frames containing an UDS response pending service are forwarded to PDU Router as any other response PDU or not. The default value for ASR4.x compliance is ON.
      boolean LinTpFunctionalRequestsSupported [0..1]: set at pre-compile, origin=Vector Informatik, default-value=true  # This parameter defines if the LINTP supports functional requests. A functional request uses a special NAD (0x7E) for diagnostic requests. A functional request may be inserted into an ongoing physical TP connection. No answer is expected from a LIN slave for a functional request. If this functionality is not required, deactivating this option reduces the size of the LIN Interface.
      boolean LinTpRuntimeMeasurementSupport: set at pre-compile, origin=Vector Informatik, default-value=false  # If enabled runtime measurement points are added to the BSW module code and are added to the module configuration of MICROSAR RTM. The available measurement points can be seen and configured in the RTM module configuration. Availability of the MICROSAR RTM module is a prerequisite to make use of the runtime measurement functionality. Runtime measurement should be disabled in production code as measurement points may inflict additional runtime.
      boolean LinTpBroadcastRequestHandling: set at pre-compile, origin=Vector Informatik, default-value=false  # This parameter defines the handling after transmission of a diagnostic broadcast request. A broadcast request uses a special NAD (0x7F). All slave nodes receive this request. Bus collisions might occur if an subsequent slave response header is scheduled. If this parameter is enabled, LinTp requests an applicative schedule table after a valid broadcast request transmission using BswM_LinTp_RequestMode() and expects no answer from a slave node. If this parameter is disabled, LinTp requests a diagnostic response schedule after a valid broadcast request transmission. No special handling for broadcast requests is performed.
      container LinTpOptimization [0..1]  # Optional optimization configuration parameters of the LINTP. These parameters affect the generated data using the ComStackLib module.
        boolean LinTpOptimizeConstArrays2Define: set at pre-compile, origin=Vector Informatik, default-value=false  # This parameter activates/deactivates the capability to generate CONFIG-CLASS PRE-COMPILE ROM arrays as constant define. TRUE: ROM arrays are generated as constant define if all values are identical. Code: the code size is smaller. RAM: no change expected. ROM: the ROM size is minimized. Runtime: the runtime is increased. FALSE: ROM arrays are generated as data even if all values are identical.
        enumeration LinTpMinimizeNumericalDataTypes: {NONE, MINIMIZE_NUMERICAL_DATA_TYPES_WITHOUT_CAST, MINIMIZE_NUMERICAL_DATA_TYPES_WITH_CAST}, set at pre-compile, origin=Vector Informatik, default-value=MINIMIZE_NUMERICAL_DATA_TYPES_WITH_CAST  # This parameter is used to minimize the datatypes of CONFIG-CLASS PRE-COMPILE numerical data based on the used values. NONE: The datatype is not minimized. MINIMIZE_NUMERICAL_DATA_TYPES_WITHOUT_CAST: The datatype of numerical data is minimized. Unsigned data types are not changed to signed datatypes. Code: the code size is reduced. RAM: the RAM size is reduced. ROM: the ROM size is reduced. Runtime: no change expected. MINIMIZE_NUMERICAL_DATA_TYPES_WITH_CAST: The datatype of numerical data is minimized. Unsigned data types can be optimized to signed datatypes. Code: the code size is reduced. RAM: the RAM size is reduced. ROM: the ROM size is reduced. Runtime: no change expected.
        enumeration LinTpConstDataDeduplication: {NONE, DEDUPLICATE_CONST_DATA_WITHOUT_CAST, DEDUPLICATE_CONST_DATA_WITH_CAST}, set at pre-compile, origin=Vector Informatik, default-value=DEDUPLICATE_CONST_DATA_WITH_CAST  # This parameter is used to deduplicate CONFIG-CLASS PRE-COMPILE ROM data. NONE: The generated data is not deduplicated. DEDUPLICATE_CONST_DATA_WITHOUT_CAST: The data is deduplicated without using casts. Code: no change expected. RAM: no change expected. ROM: the ROM size can be minimized. Runtime: no change expected. DEDUPLICATE_CONST_DATA_WITH_CAST: The data is deduplicated using casts. Code: no change expected. RAM: no change expected. ROM: the ROM size can be minimized more than in DEDUPLICATE_CONST_DATA_WITHOUT_CAST. Runtime: no change expected.
    container LinTpGlobalConfig  # Global configuration parameters of the LINTP. | It is a MultipleConfigurationContainer, i.e. this container and its sub-containers exit once per configuration set.
      integer LinTpMaxNumberOfRespPendingFrames: 0..65535, set at post-build in variant post-build-loadable+post-build-selectable / pre-compile in variant pre-compile, default-value=3  # This value specifies the maximum number of allowed response pending frames before data has to be sent.
      integer LinTpNumberOfRxNSdu: 0..65535, set at post-build in variant post-build-loadable+post-build-selectable / pre-compile in variant pre-compile, default-value=0  # This value specifies the number of transport protocol messages that can be received for all channels this node is connected to. According to AUTOSAR Bugzilla #52857, this value is deprecated because it can be calculated. It is kept just for compatibility reasons.
      integer LinTpNumberOfTxNSdu: 0..65535, set at post-build in variant post-build-loadable+post-build-selectable / pre-compile in variant pre-compile, default-value=0  # This value specifies the number of transport protocol messages that can be transmitted for all channels this node is connected to. According to AUTOSAR Bugzilla #52857, this value is deprecated because it can be calculated. It is kept just for compatibility reasons.
      float LinTpP2Max: 0.05..2, set at post-build in variant post-build-loadable+post-build-selectable / pre-compile in variant pre-compile, default-value=1.5  # This value specifies the P2 Timeout when a response pending frame is expected. This is the time between response pending indication and provision of data by the LIN slave. Note that the minimum value of LinTpP2Max shall be more than or equal to the value of LinTpP2Timing
      float LinTpP2Timing: 0.05..0.5, set at post-build in variant post-build-loadable+post-build-selectable / pre-compile in variant pre-compile, default-value=0.1  # This value specifies the P2 timeout observation parameter. This is the time between successive transmitted request and reception of SF / FF.
      container LinTpChannelConfig [0..*]: post-build-changeable=true  # Channel specific configuration parameters of the LINTP.
        boolean LinTpDropNotRequestedNad: set at post-build in variant post-build-loadable+post-build-selectable / pre-compile in variant pre-compile, default-value=false  # This parameter defines if TP Frames of not requested LIN Slaves are dropped or not. TRUE: Drop TP frames of not requested LIN-Slaves. FALSE: Keep/Process TP frames of not requested LIN-Slaves. | false: Do drop TP Frames of Not requested LIN-Slaves true: Drop not TP Frames of Not requested LIN-Slaves
        boolean LinTpScheduleChangeDiag: set at post-build in variant post-build-loadable+post-build-selectable / pre-compile in variant pre-compile, default-value=false  # This parameter defines if BswM_LinTp_RequestMode() is called to set a diagnostic request/response schedule. | false: BswM is not called true: BswM is called
        reference LinTpChannelRef: set at link in variant post-build-loadable+post-build-selectable / pre-compile in variant pre-compile, origin=Vector Informatik, destination=LinIfChannel  # Reference to the LINIF channel this container belongs to. The necessity of this reference is discussed in AUTOSAR Bugzilla #52171.
      container LinTpRxNSdu [0..*]: post-build-changeable=true  # This container includes the configuration if a received N-SDU.
        integer LinTpDl: 1..4095, set at post-build in variant post-build-loadable+post-build-selectable / pre-compile in variant pre-compile, default-value=1  # This value specifies Data Length Code of this RxNSdu. In case of variable length message, this value indicates the minimum data length. | Range of minimum length is 1 to 4095. Note that this is not relevant for Tx. The reason for this is to have identical structures for Tx and Rx.
        float LinTpNcr [0..1]: 0..1, set at post-build in variant post-build-loadable+post-build-selectable / pre-compile in variant pre-compile, default-value=0.15  # This value specifies the N_Cr timeout. N_Cr is the time until reception of the next Consecutive Frame N_PDU.
        integer LinTpRxNSduId: 0..65535, set at link in variant post-build-loadable+post-build-selectable / pre-compile in variant pre-compile, symbolic-name-value=true, default-value=0  # This value specifies the identifier of the Transport Protocol message. This ID will be the one that is communicated with upper layers.
        integer LinTpRxNSduNad: 0..255, set at post-build in variant post-build-loadable+post-build-selectable / pre-compile in variant pre-compile, default-value=1  # This value specifies the NAD of the addressed LIN Slave.
        reference LinTpRxNSduPduRef: set at post-build in variant post-build-loadable+post-build-selectable / pre-compile in variant pre-compile, destination=Pdu  # Reference to the global N-SDU.
        symbolic name reference LinTpRxNSduChannelRef: set at link in variant post-build-loadable+post-build-selectable / pre-compile in variant pre-compile, destination=LinIfChannel  # Reference to the LINIF channel this N-SDU belongs to.
      container LinTpTxNSdu [0..*]: post-build-changeable=true  # This container includes the configuration if a transmitted N-SDU.
        float LinTpNas: 0..1, set at post-build in variant post-build-loadable+post-build-selectable / pre-compile in variant pre-compile, default-value=0.1  # This value specifies N_As timeout. N_As is the time for transmission of a LIN frame (any N_PDU) on the part of the sender.
        float LinTpNcs [0..1]: 0..1, set at post-build in variant post-build-loadable+post-build-selectable / pre-compile in variant pre-compile, default-value=0.15  # This value specifies the performance requirement of N_Cs. N_Cs is the time which elapses between the transmit request of a CF N-PDU until the transmit request of the next CF N-PDU.
        integer LinTpTxNSduId: 0..65535, set at link in variant post-build-loadable+post-build-selectable / pre-compile in variant pre-compile, symbolic-name-value=true, default-value=0  # This value specifies the identifier of the Transport Protocol message. This ID will be the one that is communicated with upper layers.
        integer LinTpTxNSduNad: 0..255, set at post-build in variant post-build-loadable+post-build-selectable / pre-compile in variant pre-compile, default-value=1  # This value specifies the NAD (Node Address for Diagnostics) for the LIN slave handling of this N-SDU.
        reference LinTpTxNSduPduRef: set at post-build in variant post-build-loadable+post-build-selectable / pre-compile in variant pre-compile, destination=Pdu  # Reference to the global N-SDU.
        symbolic name reference LinTpTxNSduChannelRef: set at link in variant post-build-loadable+post-build-selectable / pre-compile in variant pre-compile, destination=LinIfChannel  # Reference to the LINIF channel this N-SDU belongs to.
  module config LinIf_Pre: definition=LinIf
  module config LinIf_Rec: definition=LinIf
  module config LinTp_Pre: definition=LinTp
  module config LinTp_Rec: definition=LinTp
