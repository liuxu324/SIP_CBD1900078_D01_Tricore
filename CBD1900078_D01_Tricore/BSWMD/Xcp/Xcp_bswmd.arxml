AUTOSAR XML (schema 4-0-3)
package /MICROSAR  # /MICROSAR
  module definition Xcp [0..1]: category=VENDOR_SPECIFIC_MODULE_DEFINITION, refined-module-def=Xcp, variants pre-compile/post-build-loadable/post-build-selectable  # /MICROSAR/Xcp | Configuration of the XCP module
    container XcpConfig  # This container contains the parameters for DAQ, Event, Sector and PDU information
      container XcpDaqList [0..0]  # This container contains the configuration of the DAQs. Container not supported!
        integer XcpDaqListNumber: 0..65534, set at pre-compile, symbolic-name-value=true  # Index number of the DAQ list
        enumeration XcpDaqListType: {DAQ, DAQ_STIM, STIM}, set at pre-compile  # This indicates whether this DAQ list represents a DAQ or a STIM.
        integer XcpMaxOdt: 0..252, set at pre-compile  # MAX_ODT indicates the maximum amount of ODTs in this DAQ list (STATIC configuration)
        integer XcpMaxOdtEntries: 0..255, set at pre-compile  # This parameter indicates the maximum amount of entries in an ODT of this DAQ list (STATIC configuration).
        container XcpDto [0..*]  # This container collects data transfer object specific parameters for the DAQ list. Container not supported!
          integer XcpDtoPid: 0..251, set at pre-compile, symbolic-name-value=true  # Packet identifier (PID) of the DTO that identifies the ODT the content of the DTO.
          choice reference XcpDto2PduMapping: set at pre-compile, destination=[XcpRxPdu, XcpTxPdu]  # This reference specifies the mapping of the DTO to the PDUs from the lower-layer interfaces (CanIf, FrIf, SoAd and Cdd). A reference to a XcpRxPdu is only feasible if the the DaqListType is DAQ_STIM. A reference to a XcpTxPdu is only feasible if the DaqListType is DAQ.
        container XcpOdt [0..*]  # This container contains ODT-specific parameter for the DAQ list. Container not supported!
          integer XcpOdtEntryMaxSize: 0..254, set at pre-compile  # This parameter indicates the upper limit for the size of the element described by an ODT entry. Depending on the DaqListType this ODT belongs to it describes the limit for a DAQ (MAX_ODT_ENTRY_SIZE_DAQ) or a STIM (MAX_ODT_ENTRY_SIZE_STIM).
          integer XcpOdtNumber: 0..251, set at pre-compile, symbolic-name-value=true  # Index number of this ODT within the DAQ list.
          reference XcpOdt2DtoMapping: set at pre-compile, destination=XcpDto  # This reference maps the ODT to the according DTO in which it will be transmitted.
          container XcpOdtEntry [0..*]  # This container collects all configuration parameters that comprise an ODT entry. Container not supported!
            linker symbol XcpOdtEntryAddress: set at pre-compile  # Memory address that the ODT entry is referencing to.
            integer XcpOdtEntryLength: 0..255, set at pre-compile  # Length of the referenced memory area that is referenced by the ODT entry.
            integer XcpOdtEntryNumber: 0..254, set at pre-compile  # Index number of the ODT entry
      container XcpDemEventParameterRefs [0..0]  # Container for the references to DemEventParameter elements which shall be invoked using the API Dem_ReportErrorStatus API in case the corresponding error occurs. The EventId is taken from the referenced DemEventParameter's DemEventId value. The standardized errors are provided in the container and can be extended by vendor specific error references. Container not supported.
        symbolic name reference XCP_E_INIT_FAILED [0..1]: set at pre-compile, destination=DemEventParameter  # Reference to the DemEventParameter which shall be issued when the error "Initialization of XCP failed" has occured.
      container XcpTransportLayer  # Container to configure the available Transport Layer.
        container XcpOnCan [0..1]  # Container contains all parameter for the XcpOnCan Transport Layer.
          string XcpOnCanUserConfigFile [0..1]: set at pre-compile, origin=Vector Informatik  # User Config File | A configuration file is generated by DaVinci Configurator Pro. If you want to overwrite settings in the generated configuration file, you can specify a path to a user defined configuration file. The user defined configuration file will be included at the end of the generated file. Therefore definitions in the user defined configuration file can overwrite definitions in the generated configuration file. The contents of the user defined configuration file is copied to the end of CanXcp_Cfg.h.
          integer XcpOnCanMaxCto: 8..64, set at pre-compile, origin=Vector Informatik, default-value=8  # Max Cto | Maximum size of Command Transfer Objects (e.g. for polling)
          integer XcpOnCanMaxDto: 8..64, set at pre-compile, origin=Vector Informatik, default-value=8  # Max Dto | Maximum size of Data Transfer Objects (e.g. for DAQ)
          integer XcpOnCanConfirmationTimeout: 2..65535, set at pre-compile, origin=Vector Informatik, default-value=10  # Confirmation Timeout | This parameter defines the number of MainFunction cycles until a Tx confirmation timeout is detected and the respective PDU buffer is reset.
          boolean XcpOnCanMultiConnectionProtection: set at pre-compile, origin=Vector Informatik, default-value=false  # Multi Connection Protection | Prevents a connection from a second XCP Master on a different CAN channel, when the first XCP Master has already established a connection.
          boolean XcpOnCanVariableDlc: set at pre-compile, origin=Vector Informatik, default-value=false  # Variable Dlc | Allow CAN frames with a variable length. If disabled the frames are always 8 Bytes big.
        container XcpOnFr [0..1]  # Container contains all parameter for the XcpOnFr Transport Layer.
          string XcpOnFrUserConfigFile [0..1]: set at pre-compile, origin=Vector Informatik  # User Config File | A configuration file is generated by DaVinci Configurator Pro. If you want to overwrite settings in the generated configuration file, you can specify a path to a user defined configuration file. The user defined configuration file will be included at the end of the generated file. Therefore definitions in the user defined configuration file can overwrite definitions in the generated configuration file. The contents of the user defined configuration file is copied to the end of FrXcp_Cfg.h.
          integer XcpOnFrMaxCto: 12..254, set at pre-compile, origin=Vector Informatik, default-value=12  # Max Cto | This parameter defines the maximum length of Command Transfer Objects (CTO) in bytes. For FlexRay this parameter must be at least 12 and less than the maximum length of the PDU or Link-Layer frame.
          integer XcpOnFrMaxDto: 12..254, set at pre-compile, origin=Vector Informatik, default-value=12  # Max Dto | This parameter defines the maximum length of Data Transfer Objects (DTO). For FlexRay this parameter must be at least 12 and less than the maximum length of the PDU or Link-Layer frame.
          integer XcpOnFrConfirmationTimeout: 2..65535, set at pre-compile, origin=Vector Informatik, default-value=8  # Confirmation Timeout | This parameter defines the number of MainFunction cycles until a Tx confirmation timeout is detected and the respective PDU buffer is reset.
          boolean XcpOnFrReadCCConfig: set at pre-compile, origin=Vector Informatik, default-value=false  # Read CC Config | If the “Virtual FlexRay Parameters” feature is enabled, the FlexRay parameters / Communication Controller Config can be read out in a platform independent way. They will be provided as virtual measurement values that can be read at fixed memory locations.
          integer XcpOnFrReadCCConfigExtAddr: 0..255, set at pre-compile, origin=Vector Informatik, default-value=253  # Read CC Config Ext Addr | The "Virtual FlexRay Parameters" are accessible with this address extension.
          integer XcpOnFrNodeAddress: 0..255, set at post-build in variant post-build-loadable+post-build-selectable / pre-compile in variant pre-compile, origin=Vector Informatik, default-value=0  # Node Address | This unique node address identifies the XCP slave within a network. This address is normally defined by the system designer and may be the same address as used for the Network Management Node ID.
          enumeration XcpOnFrFrameAlignment: {Align8Bit, Align16Bit, Align32Bit}, set at pre-compile, origin=Vector Informatik, default-value=Align8Bit  # Frame Alignment | This parameter determines the Alignment of XCP frames within a FlexRay frame. This parameter must be selected according to performance and architectural needs. For details please read the Technical Reference and the ASAM Xcp On FlexRay specification.
          boolean XcpOnFrSequenceCounter: set at pre-compile, origin=Vector Informatik, default-value=true  # Sequence Counter | The Sequence Counter is used to detect missing frames as well as to rearrange the ordering of frames if XCP is used asynchronously to the bus, or in the non guaranteed dynamic area of the cycle. If you can not guarantee correct ordering then activate this option. If you are uncertain, then activate this option.
          boolean XcpOnFrFrameConcatenation: set at pre-compile, origin=Vector Informatik, default-value=false  # Frame Concatenation | With this attribute you can enable the concatenation of multiple XCP frames into one Protocol Data Unit (PDU). This is useful if your sampling frequency is higher than the FlexRay Cycle, i.e. you call Xcp_Event in a 1ms cycle while you FLexRay cycle is 5ms.
          integer XcpOnFrMaxPDU: 12..254, set at pre-compile, origin=Vector Informatik, default-value=14  # Max PDU | This parameter defines the maximum length of PDUs. For FlexRay this parameter must be at least 14 and higher than Max_CTO and Max_DTO.
          enumeration XcpOnFrTransmissionMode: {Decoupled, Immediate}, set at pre-compile, origin=Vector Informatik, default-value=Decoupled  # Transmission Mode | It is possible to use the XCP either in Immediate or Decoupled Mode. Immediate Mode requires less resources but the FlexRay XCP MainFunctions must be used synchronously to the FlexRay bus. They must be placed such that the their execution finished before actual transmission on the bus happens.
          boolean XcpOnFrOptimizedCopy: set at pre-compile, origin=Vector Informatik, default-value=false  # Optimized Copy | If enabled a optimized copy routine is used within the FrXcp. This will improve execution time considerably but requires, on some platforms, certain alignment requirements, e.g. the PDUs must be aligned on a 32bit address within the FlexRay frame. In most XCP use cases this option can be enabled. If a trap occurs, disable this option.
        container XcpOnEth [0..1]  # Container contains all parameter for the XcpOnEth Transport Layer.
          string XcpOnEthUserConfigFile [0..1]: set at pre-compile, origin=Vector Informatik  # User Config File | A configuration file is generated by DaVinci Configurator Pro. If you want to overwrite settings in the generated configuration file, you can specify a path to a user defined configuration file. The user defined configuration file will be included at the end of the generated file. Therefore definitions in the user defined configuration file can overwrite definitions in the generated configuration file. The contents of the user defined configuration file is copied to the end of <Bsw>_Cfg.h.
          integer XcpOnEthMaxCto: 8..255, set at pre-compile, origin=Vector Informatik, default-value=8  # Max Cto | Maximum size of Command Transfer Objects (e.g. for polling)
          integer XcpOnEthMaxDto: 8..255, set at pre-compile, origin=Vector Informatik, default-value=8  # Max Dto | Maximum size of Data Transfer Objects (e.g. for DAQ)
          integer XcpOnEthConfirmationTimeout: 2..65535, set at pre-compile, origin=Vector Informatik, default-value=10  # Confirmation Timeout | This parameter defines the number of MainFunction cycles until a Tx confirmation timeout is detected and the respective PDU buffer is reset.
          boolean XcpOnEthMultiConnectionProtection: set at pre-compile, origin=Vector Informatik, default-value=false  # Multi Connection Protection | Prevents a connection from a second XCP Master on a different channel, when the first XCP Master has already established a connection.
          boolean XcpOnEthOptimizedCopy: set at pre-compile, origin=Vector Informatik, default-value=false  # Optimized Copy | If enabled a optimzed copy routine is used within the TcpIpXcp. This will improve execution time considerably but requires, on some platforms, certain alignment requirements, e.g. the PDUs must be aligned on a 32bit address within the FlexRay frame. In most XCP use cases this option can be enabled. If a trap occurs, disable this option.
      container XcpEventChannel [0..65535]  # Event channels configuration.
        enumeration XcpEventChannelConsistency [0..1]: {ODT}, set at pre-compile, default-value=ODT  # Type of consistency used by event channel
        integer XcpEventChannelMaxDaqList: 1..255, set at pre-compile, default-value=1  # Maximum amount of DAQ lists that are handled by this event channel.
        integer XcpEventChannelNumber: 0..65535, set at pre-compile, symbolic-name-value=true, default-value=0  # Index number of the event channel.
        integer XcpEventChannelPriority [0..1]: 0..255, set at pre-compile, default-value=0  # Priority of the event channel Parameter not supported!
        integer XcpEventChannelTimeCycle: 0..255, set at pre-compile  # The event channel time cycle indicates which sampling period is used to process this event channel. A value of 0 means 'Not cyclic'. The unit is defined by the parameter XcpEventChannelTimeUnit.
        enumeration XcpEventChannelTimeUnit: {TIMESTAMP_UNIT_100MS, TIMESTAMP_UNIT_100NS, TIMESTAMP_UNIT_100PS, TIMESTAMP_UNIT_100US, TIMESTAMP_UNIT_10MS, TIMESTAMP_UNIT_10NS, TIMESTAMP_UNIT_10PS, TIMESTAMP_UNIT_10US, TIMESTAMP_UNIT_1MS, TIMESTAMP_UNIT_1NS, TIMESTAMP_UNIT_1PS, TIMESTAMP_UNIT_1S, TIMESTAMP_UNIT_1US}, set at pre-compile  # This configuration parameter indicates the unit of the event channel time cycle.
        enumeration XcpEventChannelType: {DAQ, DAQ_STIM, STIM}, set at pre-compile  # This configuration parameter indicates what kind of DAQ list can be allocated to this event channel: DAQ: DAQ only DAQ_STIM: DAQ and STIM List in one event STIM: STIM only
        reference XcpEventChannelTriggeredDaqListRef [0..1]: set at pre-compile, destination=XcpDaqList  # References all DAQ lists that are trigged by this event channel. Parameter not supported!
        reference XcpEventChannelCoreRef: set at pre-compile, origin=Vector Informatik, destination=XcpCoreDefinition  # This reference defines the associated Core configuration container in which context the Xcp_Event(EventChannel) is called.
      choice container XcpPdu [2..*]: post-build-changeable=true  # Description of the Rx and Tx PDUs used for XCP communication. XCP requires at least one Rx and one Tx PDU for Cmd/Res communication. CAN: No additional PDUs must be defined. Delete redundant PDUs here and if necessary in the IF FlexRay: Additional PDUs for DAQ/STIM can be defined TcpIp: No additional PDUs must be defined. Delete redundant PDUs here and if necessary in the IF
        container XcpRxPdu [0..1]: post-build-changeable=true  # Rx PDU description.
          integer XcpRxPduId: 0..65535, set at post-build in variant post-build-loadable+post-build-selectable / pre-compile in variant pre-compile, symbolic-name-value=true, default-value=0  # ID of the PDU that will be received by the XCP module via a Xcp_<module>RxIndication.
          enumeration XcpOnFrRxPduType [0..1]: {Cmd, Stim, Variable}, set at post-build in variant post-build-loadable+post-build-selectable / pre-compile in variant pre-compile, origin=Vector Informatik, default-value=Variable  # XCP Rx PDU type (CMD, STIM) or Variable (type can be assigned during runtime). CMD is used for initial communication. At least one CMD PDU must be present. STIM is a fixed assignment, normally VARIABLE is used for STIM PDUs. This parameter is only relevant for FlexRay bus system.
          boolean XcpOnFrPduIsRuntimeConfigurable [0..1]: set at post-build in variant post-build-loadable+post-build-selectable / pre-compile in variant pre-compile, origin=Vector Informatik, default-value=true  # Selects whether the PDU type can be changed during runtime. This is done by the FLX_ASSIGN command and must be supported by the XCP Master. This parameter is only relevant for FlexRay bus system.
          reference XcpRxPduRef: set at post-build in variant post-build-loadable+post-build-selectable / pre-compile in variant pre-compile, destination=Pdu  # Reference to the global PDU definition that identifies the PDU.
          reference XcpTxPduContRef [0..1]: set at pre-compile, origin=Vector Informatik, destination=XcpTxPdu  # This parameter references the Tx PDU used for messages in response to this Rx PDU. This parameter is only relevant for CAN and ETH configurations.
        container XcpTxPdu [0..1]: post-build-changeable=true  # Tx PDU description.
          integer XcpTxPduId: 0..65535, set at post-build in variant post-build-loadable+post-build-selectable / pre-compile in variant pre-compile, symbolic-name-value=true, default-value=0  # The PDU identifier, which has to be used by the lower layer to identify the PDU during TxConfirmation or TriggerTransmit calls to the XCP module.
          enumeration XcpOnFrTxPduType [0..1]: {ResErr, EvServ, Daq, Variable}, set at post-build in variant post-build-loadable+post-build-selectable / pre-compile in variant pre-compile, origin=Vector Informatik, default-value=Variable  # XCP Tx PDU type (RES/ERR, EV/SERV or DAQ) or Variable (type can be assigned during runtime). RES/ERR is used for initial communication. At least one RES/ERR must be present. DAQ and EV/SERV is a fixed assignment, normally VARIABLE is used for DAQ or EV/SERV PDUs. This parameter is only relevant for FlexRay bus system.
          boolean XcpOnFrPduIsRuntimeConfigurable [0..1]: set at post-build in variant post-build-loadable+post-build-selectable / pre-compile in variant pre-compile, origin=Vector Informatik, symbolic-name-value=true, default-value=true  # Selects wether the PDU type can be changed during runtime. This parameter is only relevant for FlexRay bus system.
          reference XcpTxPduRef: set at post-build in variant post-build-loadable+post-build-selectable / pre-compile in variant pre-compile, destination=Pdu  # Reference to the global PDU definition that identifies the PDU.
      container XcpCoreDefinition [0..65535]  # Container contains all core specific configuration parameters.
        integer XcpSendQueueSize: 32..4294967292, set at pre-compile, origin=Vector Informatik, default-value=256  # The size of the transmit queue for this Core in Bytes.
        reference XcpEcuCCoreDefinitionRef [0..1]: set at pre-compile, origin=Vector Informatik, destination=EcucCoreDefinition  # EcuC Core Definition | The reference to the EcuC core definition.
    container XcpCmdConfig  # This container contains all command specific configuration options.
      boolean XcpOpenCommandInterface: set at pre-compile, origin=Vector Informatik, default-value=false  # The 'Open Command Interface' option provides the possibility for the user to implement unsupported commands in the application. For this a user call-back (XcpAppl_OpenCmdIf) is called with a pointer to the command string as parameter.
      container XcpStandard  # This container contains all standard command specific configuration options.
        boolean XcpBlockUpload: set at pre-compile, origin=Vector Informatik, default-value=false  # The Slave Block Transfer Mode speeds up memory uploads by transmitting an entire block of continuous response packets. There is only a response packet before and after transmission of the entire block. There are no limitations allowed for the master device. The slave returns whether it supports Slave Block Transfer Model in the response of the request 'CONNECT'.
        boolean XcpCommunicationModeInfo: set at pre-compile, origin=Vector Informatik, default-value=false  # The XCP command 'GET_COMM_MODE_INFO' returns optional information on different Communication Modes supported by the slave and also the version number of the Protocol Layer implementation. If the master block mode is supported, also the maximum allowed block size and the minimum separation time are returned. The XCP Protocol Layer supports the Standard Communication model and also the Master Block Transfer Mode and the Slave Block Transfer Mode.
        boolean XcpGetIdGeneric: set at pre-compile, origin=Vector Informatik, default-value=false  # The XCP GET_ID command is used for identification purposes. This option enables an call-back that is called when the XCP Master sends the GET_ID command and can be used to return the requested information (e.g. Map Filename, EPK Number, ...)
        boolean XcpMemoryReadProtection: set at pre-compile, origin=Vector Informatik, default-value=false  # If enabled the application has to confirm a read access. The memory address is passed as parameter of a application call-back that is used to verify the access. The application has to either grant or deny the memory access. If disabled XCP immediately reads the data without an request to the application.
        boolean XcpSeedKey: set at pre-compile, origin=Vector Informatik, default-value=false  # Resources within the slave device can be protected by a 'Seed & Key' mechanism. The following resources can be protected: - synchronous data acquisition (DAQ) - synchronous data stimulation (STIM) - online calibration (CAL) - programming (PGM)
        boolean XcpUserDefinedCommand: set at pre-compile, origin=Vector Informatik, default-value=false  # The 'User Defined Command' is optional and can be implemented within the application. However it must not be used to implement functionalities done by other services. The application call-back function 'XcpAppl_UserService()' is called to perform application specific actions.
        container XcpCRC [0..1]  # The XCP command BUILD_CHECKSUM returns a checksum that is calculated over the memory block defined by the Memory Transfer Address (MTA) and block size. The MTA will be post-incremented by the block size. If enabled, the checksum type (size of the checksum) and the calculation method must be configured.
          boolean XcpAUTOSARCRCModuleSupport: set at pre-compile, origin=Vector Informatik, default-value=false  # If 'AUTOSAR CRC Module Support' is enabled only the following checksum calculation methods are available: - CRC16_CCITT : CRC16 CCITT algorithm (for details please refer to the XCP Protocol Layer Specification) - CRC32 : CRC32 algorithm (for details please refer to the XCP Protocol Layer Specification) The CRC32 algorithm is only supported if the AUTOSAR CRC Module is used.
          integer XcpCRCBlockSize: 1..65535, set at pre-compile, origin=Vector Informatik, default-value=256  # As calculation of the checksum is time consuming the calculation can be split in blocks and calculated in the Xcp_MainFunction. If you make this value to small, the calculation time of the checksum might take to long and the Xcp Master runs in an timeout. If this value is to big the runtime of the Xcp_MainFunction might be to long.
          enumeration XcpCRCCalculationMethod: {ADD_11, ADD_12, ADD_14, ADD_22, ADD_24, ADD_44, CRC_16_CITT, CRC_32}, set at pre-compile, origin=Vector Informatik, default-value=ADD_12  # Defines the algorithm used for calculation of the checksum.
          boolean XcpCustomCRC: set at pre-compile, origin=Vector Informatik, default-value=false  # The CustomCRC Option enables a call-back (XcpAppl_CalculateChecksum) that allows the user to implement his own CRC calculation method instead of the built in methods.
      container XcpCalibration [0..1]  # This container contains all calibration command specific configuration options. If this container exists the following commands are available: - DOWNLOAD - DOWNLOAD_NEXT - DOWNLOAD_MAX - SHORT_DOWNLOAD - MODIFY_BITS Otherwise, these commands will return an ERR_CMD_UNKNOWN error and calibration of parameters will not be possible!
        boolean XcpBlockDownload: set at pre-compile, origin=Vector Informatik, default-value=false  # The Master Block Transfer Mode speeds up memory downloads by transmitting an entire block of continuous request packets. There is only one response packet after transmission of the entire block. The XCP Master has to meet the slave's limitations of the maximum block size and the minimum separation time. These communication parameters are responded within the response to 'GET_COMM_MODE_INFO'.
        integer XcpMIN_STForBlockDownload: 0..255, set at pre-compile, origin=Vector Informatik, default-value=0  # MIN_ST For Block Download | MIN_ST indicates the required minimum separation time between the packets of a block transfer from the master device to the slave device in units of 100 microseconds.
        boolean XcpModifyBits: set at pre-compile, origin=Vector Informatik, default-value=false  # If the feature is disabled the command will not be supported. Thus a modify bit request results in a negative response and no change of any bits.
        boolean XcpShortDownload: set at pre-compile, origin=Vector Informatik, default-value=false  # If the feature is disabled the command will not be supported. Thus a short download request results in a negative response. As the short download command is only applicable on communication busses with a data length greater eight bytes (e.g. FlexRay).
      container XcpDaqAndStim [0..1]  # This container contains all DAQ and STIM command specific configuration options. Data elements located in the slave's memory are transmitted in Data Transfer Objects (DTOs) from slave to master (DAQ) and from master to slave (STIM). The Object Description Table (ODT) describes the mapping between the synchronous data transfer objects and the slave's memory.
        boolean XcpFixedTimestamp: set at pre-compile, origin=Vector Informatik, default-value=false  # If enabled the slave always sends Data Transfer Object (DTO) Packets in time stamped mode. Otherwise timestamps are dynamically and individually enabled for each DAQ list.
        boolean XcpGetDAQEventInfo: set at pre-compile, origin=Vector Informatik, default-value=false  # Get DAQ EventInfo | The option 'Get DAQ Event Info' enables the XCP command GET_DAQ_EVENT_INFO. GET_DAQ_EVENT_INFO provides the following information about event channels: - Number of event channel - Name of event channel - Measurement cycle time of event channel - Direction of event channel: DAQ, STIM, DAQ&STIM
        integer XcpMaxNumberOfOdtDaq: 1..32767, set at pre-compile, origin=Vector Informatik, default-value=123  # The maximum number of Object Descriptor Table (ODTs) messages for Synchronous Data Acquisition (DAQ).
        integer XcpMaxNumberOfOdtEntries: 1..65535, set at pre-compile, origin=Vector Informatik, default-value=1  # The maximum number of Object Descriptor Table Entries (ODT entries) for Synchronous Data Acquisition (DAQ) and Stimulation (STIM). This parameter defined the maximum number of measurement values that are supported.
        integer XcpMaxNumberOfOdtStim: 0..255, set at pre-compile, origin=Vector Informatik, default-value=1  # Max Number Of Odt Stim | The maximum number of Object Descriptor Tables (ODTs) for Synchronous Data Stimulation (STIM).
        boolean XcpOverrunIndication: set at pre-compile, origin=Vector Informatik, default-value=true  # Overrun situations are indicated to the Master Control System. An overrun situation is e.g. an overflow of the transmit queue. This will be signaled by the MSB of the ODT number being set.
        boolean XcpResolutionInfo: set at pre-compile, origin=Vector Informatik, default-value=false  # The option 'Resolution Info' enables the command GET_DAQ_RESOLUTION_INFO, which provides information on the resolution of DAQ lists.
        boolean XcpResumeMode: set at pre-compile, origin=Vector Informatik, default-value=false  # The option 'Resume Mode' or often also called 'Cold Start Measurement' allows automatic data transfer (DAQ, STIM) directly after power-up of the slave without prior connection to the master calibration system.
        boolean XcpSynchronousDataStimulation: set at pre-compile, origin=Vector Informatik, default-value=false  # Synchronous Data Stimulation (STIM) | 'Synchronous Data Stimulation (STIM)' is the inverse mode of 'Synchronous Data Acquisition (DAQ)'. Data elements located in the slave's memory are transmitted in Data Transfer Objects from the master device to the slave device. These data elements are written to RAM upon XCP events.
        boolean XcpWriteDAQMultiple: set at pre-compile, origin=Vector Informatik, default-value=false  # If the feature is disabled the Write DAQ Multiple command will not be supported. Thus a Write DAQ Multiple request results in a negative response. The Write DAQ Multiple command is only applicable on communication busses with a MAX_CTO value of at least 16 bytes (e.g. on FlexRay or Ethernet).
        enumeration XcpDAQMessageHeader: set at pre-compile, origin=Vector Informatik, default-value=ODT  # This Attribute defines the format of the Identification Field in the DAQ message. It defines the size of the Identification Field and hence the number of individual DAQ messages possible. For most use cases an 1Byte header is sufficient. The options have the following meaning: ODT: Absolute ODT Identification Field is used (1Byte header). ODT_DAQ8: Relative ODT, Absolute DAQ 8 Identification Field is used (2Byte header). ODT = Object Descriptor Table
          ODT  # Absolute ODT
          ODT_DAQ8  # Relative ODT, Absolute DAQ
      container XcpProgramming [0..1]  # This container contains all flash programming command specific configuration options. The option 'Programming' enables the programming of non-volatile memory by providing user call-backs that have to implement access to the flash driver. If the internal flash of the microcontroller cannot be programmed while execution of code from the flash, the 'bootloader download' functionality has to be used instead.
        integer XcpMinStPgm: 0..255, set at pre-compile, origin=Vector Informatik, default-value=0  # This parameter is evaluated by the XCP Master and defines the delay between two consecutive PROGRAM_NEXT frames. Increase this value if the Slave is not fast enough to process multiple PROGRAM_NEXT frames in Block Mode received during a short time frame. Please note that this is a feature that must be supported by the XCP Master.
        boolean XcpProgrammingWriteProtection: set at pre-compile, origin=Vector Informatik, default-value=false  # The option 'Programming Write Protection' enables the programming write protection of non-volatile memory.
        container XcpSector [0..255]  # XCP Protocol Layer flash sector information. This is plug and play information and describes the flash segments that are present in the µC. The option 'Processor and Sector Info' enables the commands: - GET_PGM_PROCESSOR_INFO Transfers the general properties for programming and the total number of available sectors from the slave device to the master device. - GET_SECTOR_INFO Transfers information on a specific sector from the slave device to the master device.
          integer XcpStartAddress: 0.., set at pre-compile, origin=Vector Informatik  # Start Address of Sector
          integer XcpEndAddress: 0.., set at pre-compile, origin=Vector Informatik  # End Address of Sector
      container XcpPageSwitching [0..1]  # If calibration page switching (PAG) is enabled the access mode calibration data segments can be set by a user call-back. Calibration data segments and their pages are specified by logical numbers.
        boolean XcpCopyPage: set at pre-compile, origin=Vector Informatik, default-value=false  # If more than one calibration page is defined, the slave can copy a calibration page into another. In principle any page of any segment can be copied to any page of any segment. However, restrictions might be possible.
        boolean XcpFreezeMode: set at pre-compile, origin=Vector Informatik, default-value=false  # If enabled the commands SET_SEGMENT_MODE and GET_SEGMENT_MODE are enabled and forwarded to the application.
        boolean XcpGeneralPagingInfo: set at pre-compile, origin=Vector Informatik, default-value=false  # If 'General Paging Info' is enabled the XCP command 'GET_PAG_PROCESSOR_INFO' returns general information on paging. The following information is transferred from the slave device to the master device: - The total number of segments - Whether the freeze mode is supported Specific information for segments or pages is so far not supported.
      container XcpAsynchMessage  # Asynchronous Message | This container contains all asynchronous message specific configuration options.
        boolean XcpEventCodes: set at pre-compile, origin=Vector Informatik, default-value=false  # 'Event Codes' are transmitted within event packets (EV) from the slave device to the master device. The transmission is not guaranteed since event packets are not acknowledged. Please refer to the ASAM XCP Protocol Layer specification for the 'Table of Event codes'.
        boolean XcpServiceRequestMessage: set at pre-compile, origin=Vector Informatik, default-value=false  # 'Service Request Messages' are always transmitted within service request packets (SERV) by the slave device, in order to request the master device to perform some action. The transmission is not guaranteed since service request packets are not acknowledged by the master device. Please also refer to the XCP Protocol Layer specification for the 'Table of service request codes'.
    container XcpGeneral  # General configuration parameters of the XCP.
      enumeration XcpDaqConfigType [0..1]: {DAQ_DYNAMIC}, set at pre-compile, default-value=DAQ_DYNAMIC  # Sets the DAQ_CONFIG_TYPE bit within the DAQ_PROPERTIES parameter to "static" or to "dynamic". If DAQ_STATIC is selected, the DAQ_CONFIG_TYPE bit is set to "0". If DAQ_DYNAMIC is selected, the DAQ_CONFIG_TYPE bit is set to "1". Parameter not supported!
      integer XcpDaqCount [0..1]: 0..65535, set at pre-compile, default-value=192  # Indicates the number of DAQ lists for dynamic configuration. Parameter not supported!
      boolean XcpDevErrorDetect: set at pre-compile, default-value=true  # Dev Error Detect | Switches the Development Error Detection and Notification on or off. TRUE: Development Error Detection and Notificiation on FALSE: Development Error Detection and Notification off
      enumeration XcpIdentificationFieldType [0..1]: {ABSOLUTE}, set at pre-compile, default-value=ABSOLUTE  # Type of Identification Field the slave will use when transferring DAQ Packets to the master. The master has to use the same Type of Identification Field when transferring STIM Packets to the slave. Parameter not supported!
      float XcpMainFunctionPeriod: 0.., set at pre-compile, default-value=0.005  # The XCP does not require this information but the BSW scheduler, which invokes the main function, needs it in order to plan its tasks.
      integer XcpMaxCto [0..1]: 8..255, set at pre-compile, default-value=8  # MAX_CTO shows the maximum length of a CTO packet in bytes. Parameter not supported!
      integer XcpMaxDto [0..1]: 8..65535, set at pre-compile, default-value=8  # MAX_DTO shows the maximum length of a DTO packet in bytes. Parameter not supported!
      integer XcpMaxEventChannel: 0..65535, set at pre-compile, default-value=255  # Defines the maximum number of supported Event Channels. Parameter not supported!
      integer XcpMinDaq [0..1]: 0..255, set at pre-compile, default-value=0  # Indicates the number of predefined, read only DAQ lists on the XCP slave. Parameter not supported!
      integer XcpOdtCount [0..1]: 0..252, set at pre-compile, default-value=192  # This parameter indicates the amount of ODTs of a DAQ list using dynamic DAQ list configuration. Parameter not supported!
      integer XcpOdtEntriesCount [0..1]: 0..255, set at pre-compile, default-value=255  # Indicates the amount of entries into an ODT using dynamic DAQ list configuration. Parameter not supported!
      integer XcpOdtEntrySizeDaq [0..1]: 0..255, set at pre-compile, default-value=255  # Indicates the size of an element described by an ODT entry to the DaqListType for a DAQ. Parameter not supported!
      integer XcpOdtEntrySizeStim [0..1]: 0..255, set at pre-compile, default-value=255  # Indicates the size of an element described by an ODT entry to the DaqListType for a stim. Parameter not supported!
      boolean XcpOnCanEnabled: set at pre-compile, default-value=false  # Enabling of XCPonCAN functionality It is enabled if the respective PDU is present.
      boolean XcpOnCddEnabled: set at pre-compile, default-value=false  # Enabling of XCPonCdd functionality. Parameter not supported!
      boolean XcpOnEthernetEnabled: set at pre-compile, default-value=false  # Enabling of XCPonEthernet functionality It is enabled if the respective PDU is present.
      boolean XcpOnFlexRayEnabled: set at pre-compile, default-value=false  # Enabling of XCPonFlexRay functionality It is enabled if the respective PDU is present.
      boolean XcpPrescalerSupported: set at pre-compile, default-value=false  # This parameter enables and disables the support for Prescaler support. True is Enabled, False is disabled. The prescaler is a runtime configurable option for each xcp event and can be used to divide down the event call cycle. Parameter not supported!
      boolean XcpSuppressTxSupport [0..1]: set at pre-compile, default-value=false  # Switches the support of suppressing transmission of PDUs per communication channel on or off. TRUE: Suppressing of TxPDUs supported FALSE: Suppressing of TxPDUs not supported Parameter not supported!
      integer XcpTimestampTicks [0..1]: 1..65535, set at pre-compile, default-value=1  # The timestamp will be increment by TIMESTAMP_TICKS per unit.
      enumeration XcpTimestampType [0..1]: {FOUR_BYTE, NO_TIME_STAMP, ONE_BYTE, TWO_BYTE}, set at pre-compile, default-value=TWO_BYTE  # Number of bytes used for the timestamp field in the XCP message. In case No_TIME_STAMP is selected the timestamp field is not available.
      enumeration XcpTimestampUnit [0..1]: {TIMESTAMP_UNIT_100MS, TIMESTAMP_UNIT_100NS, TIMESTAMP_UNIT_100PS, TIMESTAMP_UNIT_100US, TIMESTAMP_UNIT_10MS, TIMESTAMP_UNIT_10NS, TIMESTAMP_UNIT_10PS, TIMESTAMP_UNIT_10US, TIMESTAMP_UNIT_1MS, TIMESTAMP_UNIT_1NS, TIMESTAMP_UNIT_1PS, TIMESTAMP_UNIT_1S, TIMESTAMP_UNIT_1US}, set at pre-compile, default-value=TIMESTAMP_UNIT_1MS  # This parameter indicates the resolution of the data acquisition clock of the slave when transferring data to master. Each timestamp unit is incremented by XcpTimestampTicks.
      boolean XcpVersionInfoApi: set at pre-compile, default-value=false  # Enables/disables the existence of the XCP_GetVersionInfo() API service. TRUE: XCP_GetVersionInfo() API service exists FALSE: XCP_GetVersionInfo() API service does not exist
      boolean XcpBootloaderDownload: set at pre-compile, origin=Vector Informatik, default-value=false  # In order to reprogram the internal flash of some microcontrollers it is necessary to use a bootloader, because code cannot be executed from flash while programming flash. This Option is used to support a flash kernel by providing a call-back that can be used to bring the applikation in a save state.
      boolean XcpControl: set at pre-compile, origin=Vector Informatik, default-value=false  # If enabled the XCP functionality can be enabled/disabled during runtime. The feature may be used to prevent unintended XCP activity by disabling the functionality on a special trigger. If this option is disabled XCP will always stay activate in the ECU.
      boolean XcpMultiClientSupport: set at pre-compile, origin=Vector Informatik, default-value=false  # Multi Client support. This option will enable the Xcp protocol layer to handle multiple connections at the same time. The RAM footprint will be multiplied with the number of supported channels.
      boolean XcpRuntimeMeasurementSupport: set at pre-compile, origin=Vector Informatik, default-value=false  # If enabled runtime measurement points are added to the BSW module code and are added to the module configuration of MICROSAR RTM. The available measurement points can be seen and configured in the RTM module configuration. Availability of the MICROSAR RTM module is a prerequisite to make use of the runtime measurement functionality. Runtime measurement should be disabled in production code as measurement points may inflict additional runtime.
      boolean XcpSafeBswChecks: set at pre-compile, origin=Vector Informatik, default-value=false  # Selects if safety checks are used. These checks improve robustness as e.g. invalid parameters are checked before function is executed. This attribute has to be enabled for safety projects where this component is mapped to an ASIL partition.
      boolean XcpSessionStatusAPI: set at pre-compile, origin=Vector Informatik, default-value=false  # The API Xcp_GetSessionStatus allows determining the session status of the XCP. It can be used to prevent the communication network to be put to sleep while an XCP communication is active.
      string XcpStationIdentifier [0..1]: set at pre-compile, origin=Vector Informatik  # The 'XCP Station Identifier' is an ASAM-MC2 filename without path and file type extension that identifies the ECU's software program version. It is used for slave device identification and automatic session configuration. The Master Control System (MCS) can interpret this identifier as file name for the ECU database. The ECU developer should change the XCP station identifier with each program change. This will prevent database using a wrong database and grant the correct access of measurement and calibration objects from the MCS to the ECU. Another benefit of the usage of the XCP station identifier is the automatic assignment of the correct ECU database at program start of the MCS via the Plug&Play mechanism. The Plug&Play mechanism prevents the user to choose the wrong ECU database.
      boolean XcpTypeSafeCopy: set at pre-compile, origin=Vector Informatik, default-value=false  # Basic multi core support. This option will enable a copy operation with 16bit or 32bit data types whereas with this option disabled all copy operations are done byte wise. This will allow data consistency on multi core platform for basic data types as they are copied in one step. If the data types are not aligned on 16 or 32 byte boundaries the copy operation will still be done byte wise.
      string XcpUserConfigFile [0..1]: set at pre-compile, origin=Vector Informatik  # A configuration file (Xcp_Cfg.h) is generated by DaVinci Configurator Pro. If you want to overwrite settings in the generated configuration file, you can specify a path to a user defined configuration file. The user defined configuration file will be included at the end of the generated file. Therefore definitions in the user defined configuration file can overwrite definitions in the generated configuration file. The contents of the user defined configuration file is copied to the end of Xcp_Cfg.h.
      boolean XcpDAQMemAccessByApplication: set at pre-compile, default-value=false  # If enabled, memory access for DAQ and STIM is performed via application call-backs.
      reference XcpCounterRef [0..1]: set at pre-compile, destination=OsCounter  # This parameter contains a reference to the counter, which is used by XCP. Parameter not supported!
      container XcpA2L  # A2L | This container contains all A2L related configuration parameter.
        string XcpOnFrClusterId [0..1]: set at pre-compile, origin=Vector Informatik  # XcpOnFr Cluster Id | The Cluster ID identifies the Cluster in the Fibex data base to use.
        string XcpOnFrFibex [0..1]: set at pre-compile, origin=Vector Informatik  # XcpOnFr Fibex | This string contains the name of the Fibex data base. The Fibex is used by the Master Tool to get the FlexRay communication parameters.
        integer XcpTimeoutT1: 0..2147483647, set at pre-compile, origin=Vector Informatik, default-value=2000  # This parameter specifies the timeout value T1 used for generic response time out handling by the Xcp Master. Value in [ms]
        integer XcpTimeoutT2: 0..2147483647, set at pre-compile, origin=Vector Informatik, default-value=10000  # This parameter specifies the timeout value T2 used for build checksum response time out handling by the Xcp Master. Value in [ms]
        integer XcpTimeoutT3: 0..2147483647, set at pre-compile, origin=Vector Informatik, default-value=2000  # This parameter specifies the timeout value T3 used for programming preparation response time out handling by the Xcp Master. Value in [ms]
        integer XcpTimeoutT4: 0..2147483647, set at pre-compile, origin=Vector Informatik, default-value=2000  # This parameter specifies the timeout value T4 used for program clear response time out handling by the Xcp Master. Value in [ms]
        integer XcpTimeoutT5: 0..2147483647, set at pre-compile, origin=Vector Informatik, default-value=2000  # This parameter specifies the timeout value T5 used for programming response time out handling by the Xcp Master. Value in [ms]
        integer XcpTimeoutT6: 0..2147483647, set at pre-compile, origin=Vector Informatik, default-value=2000  # This parameter specifies the timeout value T6 used for user defined connect response time out handling by the Xcp Master. Value in [ms]
        integer XcpTimeoutT7: 0..2147483647, set at pre-compile, origin=Vector Informatik, default-value=0  # This parameter specifies the timeout value T7 used for pre-action waiting for several commands by the Xcp Master. Value in [ms]
  bsw implementation Xcp_Impl: programming-language=C, sw-version=4.00.00, used-code-generator=cMSR, vendor-id=30, ar-release-version=4.00.03, behavior=XcpBehavior, preconfigured-configuration=Xcp_Pre, recommended-configuration=Xcp_Rec, vendor-specific-module-def=Xcp
  module config Xcp_Pre: definition=Xcp
  module config Xcp_Rec: definition=Xcp
