AUTOSAR XML (schema 4-0-3)
package /MICROSAR
  module config Xcp_Pre: definition=Xcp
  module config Xcp_Rec: definition=Xcp, implementation-config-variant=VARIANT-PRE-COMPILE
    XcpGeneral: CanXcpMultiConnectionProtection=0, CanXcpSetPduModeSupport=0, CanXcpVariableDlc=1
