AUTOSAR XML (schema 4-0-3)
package /MICROSAR
  module config LinTp_Rec: definition=LinTp, implementation-config-variant=VARIANT-PRE-COMPILE
