AUTOSAR XML (schema 4-0-3)
package /MICROSAR
  module config LinSM_Rec: definition=LinSM, implementation-config-variant=VARIANT-PRE-COMPILE
