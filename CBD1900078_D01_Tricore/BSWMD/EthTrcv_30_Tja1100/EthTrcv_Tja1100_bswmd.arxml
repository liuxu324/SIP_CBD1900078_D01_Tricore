AUTOSAR XML (schema 4-2-1)
# COPYRIGHT
# Copyright (c) 2017 by Vector Informatik GmbH. All rights reserved.
# This software is copyright protected and proprietary to Vector Informatik GmbH.
# Vector Informatik GmbH grants to you only those rights as set out in the license conditions.
package /MICROSAR/EthTrcv_Tja1100
  module definition EthTrcv [0..*]: category=VENDOR_SPECIFIC_MODULE_DEFINITION, refined-module-def=EthTrcv, variants pre-compile  # Configuration of the EthTrcv (Ethernet Transceiver driver) module.
    container EthTrcvGeneral  # General configuration of Ethernet Transceiver Driver module.
      boolean EthTrcvDevErrorDetect: set at pre-compile, default-value=true  # Dev Error Detect | This parameter switches the Development Error Detection and Notification ON or OFF. true: Development error detection is enabled. false: Development error detection is disabled. Note: In general, the development error detection is recommended during pre-test phase. It is not recommended to enable the development error detection in production code due to increased runtime and ROM needs.
      boolean EthTrcvGetBaudRateApi: set at pre-compile, default-value=true  # Get Baud Rate API | This parameter defines if the EthTrcv_GetBaudRate() API is enabled to get the current transceiver baud rate.
      boolean EthTrcvGetDuplexModeApi: set at pre-compile, default-value=true  # Get Duplex Mode API | This parameter defines if the EthTrcv_GetDuplexMode() API is enabled to get the current transceiver duplex mode.
      boolean EthTrcvGetLinkStateApi: set at pre-compile, default-value=true  # Get Transceiver Link State API | This parameter defines if the EthTrcv_GetLinkState() API is enbled to get the current transceiver link state.
      boolean EthTrcvGetTransceiverModeApi: set at pre-compile, default-value=true  # Get Transceiver Mode API | This parameter defines if the EthTrcv_GetTransceiverMode() API is enabled to get the current transceiver mode.
      integer EthTrcvMaxTrcvsSupported: 1..255, set at pre-compile, default-value=1  # Max Trcvs Supported | This value specifies the maximum number of transceiver configurations per transceiver driver.
      boolean EthTrcvSetTransceiverModeApi: set at pre-compile, default-value=true  # Set Transceiver Mode API | This parameter defines if the EthTrcv_SetTransceiverMode() API is enabled to set the transceiver mode.
      boolean EthTrcvStartAutoNegotiationApi: set at pre-compile, default-value=true  # Start Auto Negotiation API | This parameter defines if the EthTrcv_StartAutoNegotiation() is enabled to start the transceiver auto negotiation.
      boolean EthTrcvVersionInfoApi: set at pre-compile, default-value=false  # Version Info API | This parameter enables/disables the function EthTrcv_GetVersionInfo() to get major, minor and patch version information.
      string EthTrcvUserConfigFile [0..1]: set at pre-compile, origin=Vector Informatik  # User Config File | Reference to an external text file that will be included during generation to EthTrcv_Cfg.h. The content of the user configuration file will be added at the end of the generated module configuration file and allows altering or extending the generated code. Caution: User configuration files can cause the software module to malfunction and must only be used with great care!
      boolean EthTrcvVersionInfoApiMacro [0..1]: set at pre-compile, default-value=false  # Version Info API Macro | Parameter not used. This parameter defines if EthTrcv_GetVersionInfo() is implemented as a macro. Restrictions: 'EthTrcvVersionInfoApiMacro' is only relevant, if 'EthTrcvVersionInfoApi' is set to 'true'.
      integer EthTrcvIndex: 0..255, set at pre-compile, default-value=0  # Specifies the InstanceId of this module instance. If only one instance is present it shall have the Id 0.
      boolean EthTrcvRuntimeMeasurementSupport: set at pre-compile, origin=Vector Informatik, default-value=false  # If enabled runtime measurement points are added to the BSW module code and are added to the module configuration of MICROSAR RTM. The available measurement points can be seen and configured in the RTM module configuration. Availability of the MICROSAR RTM module is a prerequisite to make use of the runtime measurement functionality. Runtime measurement should be disabled in production code as measurement points may inflict additional runtime.
      enumeration EthTrcvWakeUpSupport: {ETHTRCV_WAKEUP_BY_INTERRUPT, ETHTRCV_WAKEUP_BY_POLLING, ETHTRCV_WAKEUP_NOT_SUPPORTED}, set at pre-compile, default-value=ETHTRCV_WAKEUP_NOT_SUPPORTED  # Wakeup Support | This parameter specifies the kinde of wakeup support the transceiver provides. ETHTRCV_WAKEUP_BY_INTERRUPT: Wakeup is realised through an interrupt. ETHTRCV_WAKEUP_BY_POLLING: Wakeup is realised trough polling by the EthTrcv driver itself. ETHTRCV_WAKEUO_NOT_SUPPORTED: Wakeup capability is either not supported by hardware/driver or is disabled.
      boolean EthTrcvGetTransceiverWakeupModeApi [0..1]: set at pre-compile, default-value=true  # Get Transceiver Wakeup Mode API | This parameter defines if the EthTrcv_GetTransceiverWakeupMode() API is enabled to get the current transceiver wakeup mode. The API can only be used if EthTrcvWakeUpSupport is not configured to ETHTRCV_WAKEUP_NOT_SUPPORTED.
      integer EthTrcvHwAccessLoopCount: 0..4294967296, set at pre-compile, origin=Vector Informatik, default-value=0  # On some platforms there is a additional waiting time required before the hardware access is possible. This waiting is implemented as busy waiting. The loop count can be configured using this parameter.
      boolean EthTrcvSafeBswChecks: set at pre-compile, origin=Vector Informatik, default-value=false  # Selects if safety checks are used. These checks improve robustness as e.g. invalid parameters are checked before function is executed. This attribute has to be enabled for safety projects where this component is mapped to an ASIL partition.
      integer EthTrcvCableDiagLoopCount: 0..4294967296, set at pre-compile, origin=Vector Informatik, default-value=10000  # The cable diagnostic result can only be obtained after some waiting time. This parameter specifies the loop cycles the software performs until a timeout occurs.
      float EthTrcvMainFunctionPeriod [0..1]: 0.001..1, set at pre-compile, default-value=0.02  # Wakeup Main Function Period | This value specifies the period the main function for wakeup is called, if wakeup by polling is enabled. The period is the same for this function and the main function for link handling.
      linker symbol EthTrcvPreTrcvInitUserCallout: set at pre-compile, origin=Vector Informatik, default-value=NULL_PTR  # Pre-Transceiver-Initialization User Callout | This parameter defines the function to be called before the driver initializes a Ethernet transceiver. The function that is provided here has to have following signature: void <User>_PreTrcvInitCallout(uint8 EthTrcvIdx); NULL_PTR as value disables the functionality. With the passed EthTrcvIdx, representing the Symbolic Name Value of the respective Ethernet Transceiver, one can distinguish between the initialization context that is currently executed.
      linker symbol EthTrcvPostTrcvInitUserCallout: set at pre-compile, origin=Vector Informatik, default-value=NULL_PTR  # Post-Transceiver-Initialization User Callout | This parameter defines the function to be called after the driver has initialized a Ethernet transceiver. The function that is provided here has to have following signature: void <User>_PostTrcvInitCallout(uint8 EthTrcvIdx); NULL_PTR as value disables the functionality. With the passed EthTrcvIdx, representing the Symbolic Name Value of the respective Ethernet Transceiver, one can distinguish between the initialization context that is currently executed.
      float EthTrcvMainFunctionLinkHandlingPeriod [0..1]: 0.001..0.02, set at pre-compile, origin=Vector Informatik, default-value=0.001  # Link Handling Main Function Period | This value specifies the period the function for link handling is called.
      string EthTrcvCalloutIncludeFiles [0..*]: set at pre-compile, origin=Vector Informatik  # This parameter defines include files for the declaration of callouts, i.e. Pre- and Post-TransceiverInit-Callout, WakeUpCallout, WakeUpInspectionCallout,...
    container EthTrcvConfigSet  # This conainter includes multiple configuration set containers.
      container EthTrcvConfig [1..*]  # Ethernet Transceiver Config | This container includes the configuration of the individual transceiver.
        integer EthTrcvIdx: 0..255, set at pre-compile, symbolic-name-value=true, default-value=0  # Transceiver Index | This value specifies the instance ID of the configured transceiver.
        enumeration EthTrcvSpeed: set at pre-compile, default-value=TRCV_SPEED_100  # This parameter specifies the speed of the Ethernet transceiver link in MBit/s. RESTRICTION: If Auto Negotiation is enabled this is the maximum speed advertised for Auto-Negotiation
          TRCV_SPEED_10  # ETHTRCV_BAUD_RATE_10MBIT
          TRCV_SPEED_100  # ETHTRCV_BAUD_RATE_100MBIT
          TRCV_SPEED_1000  # ETHTRCV_BAUD_RATE_1000MBIT
        function name EthTrcvWakeUpCallout [0..1]: set at pre-compile  # This parameter specifies a callout function that is called during EthTrcv_SetTransceiverMode() for transceiver activation if a wakeup event has occured. The callout can be used for e.g. initiating a remote wakeup of related ECUs by setting a activation line connected to them. The function must be declared as followed: void &lt;EthTrcvWakeUpCallout&gt;(uint8 TrcvIdx)
        enumeration EthTrcvWakeupInspectionType [0..1]: {ETHTRCV_ICU_CHANNEL, ETHTRCV_TRCV_REGISTERS, ETHTRCV_USER_CODE}, set at pre-compile, origin=Vector Informatik, default-value=ETHTRCV_ICU_CHANNEL  # Wakeup Inspection Type | This parameter specifies the method used for inspection of wakeup events. ETHTRCV_ICU_CHANNEL: Uses the Icu_GetInputState() API for the related Icu channel to verify if a wakeup event occured and the corresponding AUTOSAR wakeup reason must be set. Reason used is ETHTRCV_WUR_PIN. ETHTRCV_TRCV_REGISTERS: If hardware supports waking up by the transceiver itself the driver checks its registers if a wakeup event occured and the corresponding AUTOSAR wakeup reason must be set. ETHTRCV_USER_CODE: The user must provide integration code by itself for wakeup event inspection. This code must be embedded within the function EthTrcv_WakeupInspection generated into EthTrcv_Lcfg.c. For a more detailed information please refere to the Technical Reference of the driver.
        integer EthTrcvLinkFailCounterValueForReset: 300..100000, set at pre-compile, origin=Vector Informatik, default-value=1000  # This parameter defines a time, which is used for doing soft resets in case the link is reported as 'down' by the transceiver. If the link is lost or reported 'down' for a duration of EthTrcvLinkFailCounterValueForReset milliseconds a soft reset of the transceiver is done by the driver. Please be aware that the configured time is rounded down internally to fit the configured main function cycles in the Ethernet Interface. Configuring values less than 300 ms is not possible to allow the transceiver to try link up.
        enumeration EthTrcvDerivative: {ETHTRCV_TJA1100, ETHTRCV_TJA1101, ETHTRCV_TJA1102}, set at pre-compile, origin=Vector Informatik, default-value=ETHTRCV_TJA1100  # This parameter defines the derivative which is controlled by this driver instance. Possible values are TJA1100, TJA1101 (same like TJA1102 P0 only) or TJA1102 for dual PHY package (P0 and P1).
        boolean EthTrcvMiiDriverReducedOutputStrengthEnabled: set at pre-compile, origin=Vector Informatik, default-value=false  # Mii Driver Reduced Output Strength Enabled | This parameter specifies if the Mii driver is operated with reduced output strength
        enumeration EthTrcvConnNeg: {ETHTRCV_CONN_NEG_AUTO, ETHTRCV_CONN_NEG_MASTER, ETHTRCV_CONN_NEG_SLAVE}, set at pre-compile, default-value=ETHTRCV_CONN_NEG_MASTER  # Connection Negotiation | This parameter specifies the connection negotiation of the Ethernet transceiver link.
        integer EthTrcvPhySignalQualityMeanValueLength: 1..1000, set at pre-compile, origin=Vector Informatik, default-value=100  # This parameter specifies how many consecutive data points of the phy's signal quality are used for the calculated mean value.
        float EthTrcvLinkStartupDelay: 0.002..0.02, set at pre-compile, origin=Vector Informatik, default-value=0.002  # This value specifies the delay after which the link is started up after transceiver initialization. Please be aware that this delay is dependent on the configured value for the period of the link handling main function (EthTrcvGeneral/EthTrcvMainFunctionLinkHandlingPeriod). The actually obtained delay is rounded to fit an integer multiple of the configured value for the link handling main function period.
        boolean EthTrcvExtendedLinkStateCheckEnabled: set at pre-compile, origin=Vector Informatik, default-value=false  # Extended Link State Check Enabled | This parameter specifies if after 100 ms after the link up has been enabled another link state check is performed to verify the stability of the link. After 200 ms without a stable link a timeout and reset of the transceiver occurs if this parameter is enabled. The start of communication is therefore delayed by at least 100 ms, if this parameter is enabled but it is recommended to be enabled for certain hardware revisions.
        boolean EthTrcvSoftResetOnInit: set at pre-compile, origin=Vector Informatik, default-value=false  # This parameter speficies if a soft reset during transceiver initialization re-initializes all transceiver registers. In case the user sets some transceiver registers during runtime and wants to restore the default settings when transceiver is re-initialized, this option must be enabled.
        integer EthTrcvSoftResetWaitCycles [0..1]: 1..65535, set at pre-compile, origin=Vector Informatik, default-value=120  # This value specifies the wait time until a soft reset is performed. After soft reset the driver polls the transceiver register and checks that the reset is performed or not. This is the maximum wait time.
        enumeration EthTrcvP0P1Selection [0..1]: {ETHTRCV_P0, ETHTRCV_P1}, set at pre-compile, origin=Vector Informatik  # This parameter defines whether this driver instance represents the P0 or P1 PHY in a TJA1102 dual PHY package, which differ in some register accesses. For information regarding the selection P0 or P1 please see the documentation of the Tja1102. If a Tja1101 is configured, only P0 can be chosen.
        boolean EthTrcvAutoNegotiationEnabled: set at pre-compile, default-value=false  # Specifies if Auto-Negotiation is enabled (TRUE) or disabled (FALSE) for determination of the Ethernet transceiver speed.
        function name EthTrcvWakeUpInspectionCallout [0..1]: set at pre-compile, origin=Vector Informatik  # Wake Up Inspection Callout | This parameter specifies a callout function that is called if the Wakeup Inspection Type is set to "ETHTRCV_USER_CODE". The callout can be used to realize a user-defined wake-up inspection and reporting. The function must be declared as follows: void &lt;EthTrcvWakeUpInspectionCallout&gt;(uint8 TrcvIdx)
        symbolic name reference EthTrcvIcuChannelRef [0..1]: set at pre-compile, destination=IcuChannel  # Reference to a Icu channel container. The reference is used for enabling/disabling the wakeup notifications triggered by Icu in case EthTrcvWakeupSupport is configured to ETHTRCV_WAKEUP_BY_INTERRUPT. Additionally the reference is used to check for a proper wakeup signal if the parameter EthTrcvWakeupVerificationType is set to ETHTRCV_ICU_CHANNEL.
        reference EthTrcvP0Reference [0..1]: set at pre-compile, origin=Vector Informatik, destination=EthTrcvConfig  # This parameter is a reference to the corresponding P0 PHY and only necessary in TJA1102 P1 PHY.
        container EthTrcvDemEventParameterRefs [0..1]  # This container includes the references to DemEventParameter elements which shall be invoked using the API Dem_ReportErrorStatus API in case the corresponding error occurs. The EventId is taken from the referenced DemEventParameter's DemEventId value.
          symbolic name reference ETHTRCV_E_ACCESS [0..1]: set at pre-compile, destination=DemEventParameter  # This parameter references the Ethernet Transceiver DEM Event.
        choice container EthTrcvMgmtInterface  # This container includes either a MII interface or Switch interface container. Depending on the physical hardware the transceiver is either connected to an Ethernet Controller via MII interface or is integrated into an Ethernet Switch.
          container EthTrcvMiiInterface [0..1]  # This container includes the MII interface configuration between an Ethernet Controller and the Ethernet Transceiver.
            integer EthTrcvMiiIdx: 0..255, set at pre-compile, origin=Vector Informatik, default-value=1  # Transceiver MII Index | This value specifies the transceiver index used for MII (Media Independent Interface) access of the transceiver. A transceiver is usually associated with a constant MII address, that can be selected via strapping pins on the hardware. The adress is used to identify the transceiver during communication.
            enumeration EthTrcvMiiSelection: {ETHTRCV_MII_MODE, ETHTRCV_RMII_MODE, ETHTRCV_RMII_XTAL_MODE}, set at pre-compile, origin=Vector Informatik, default-value=ETHTRCV_MII_MODE  # This parameter specifies the type of transceiver/controller interface. The interface is either MII, RMII or RMII-XTAL. The interface must be selected according to your electric circuit design.
            symbolic name reference EthTrcvCtrlRef: set at pre-compile, origin=Vector Informatik, destination=EthCtrlConfig  # Reference to a physical Ethernet controller configuration.
          container EthTrcvSwitchInterface [0..1]  # This container includes the Switch interface configuration between an Ethernet Switch and an Ethernet Transceiver.
            enumeration EthTrcvMiiSelection: {ETHTRCV_MII_MODE, ETHTRCV_RMII_MODE, ETHTRCV_RMII_XTAL_MODE, ETHTRCV_INTERNAL_PHY}, set at pre-compile, origin=Vector Informatik, default-value=ETHTRCV_MII_MODE  # This parameter specifies the type of transceiver/controller interface. In case the configured element is an intenal PHY choose INTERNAL PHY, in case it is an external PHY managed by a switch the interface must be selected. The interface is either MII, RMII or RMII-XTAL.In case of R(G)MII the refclock signal can be generated by the transceiver or applied externally. Choose R(G)MII_XTAL for transceiver clock generation and R(G)MII for an external clock. The interface must be selected according to your electric circuit design.
            symbolic name reference EthTrcvSwitchRef: set at pre-compile, origin=Vector Informatik, destination=EthSwtConfig  # Reference to a switch configuration container. The switch configuration is associated with the hardware switch this transceiver is connected into.
            symbolic name reference EthTrcvSwitchPortRef: set at pre-compile, origin=Vector Informatik, destination=EthSwtPort  # Reference to a switch port reference. The port configuration is associated with the port of a hardware switch this transceiver connected to.
          container EthTrcvSpiInterface [0..1]
            symbolic name reference EthTrcvCtrlRef: set at pre-compile, origin=Vector Informatik, destination=EthCtrlConfig  # Reference to a physical Ethernet controller configuration.
        container EthTrcvWakeupMap [0..7]  # Container for the mapping of wake up reasons to wake up sources. At least one container is needed if EthTrcvWakeUpSupport is not ETHTRCV_WAKEUP_NOT_SUPPORTED.
          enumeration EthTrcvWakeupReason: {ETHTRCV_WUR_BUS, ETHTRCV_WUR_GENERAL, ETHTRCV_WUR_INTERNAL, ETHTRCV_WUR_PIN, ETHTRCV_WUR_POWER_ON, ETHTRCV_WUR_RESET, ETHTRCV_WUR_SYSERR}, set at pre-compile, default-value=ETHTRCV_WUR_BUS  # Trcv Wakeup Reason | This parameter specifies the corresponding wakeup reason mapped to the wakeup source of the EcuM. ETHTRCV_WUR_BUS: Reason for the wakeup is a event on the Ethernet network. ETHTRCV_WUR_GENERAL: Reason for the wakeup is a general event. ETHTRCV_WUR_INTERNAL: Reason for the wakeup is a internal transceiver event. ETHTRCV_WUR_PIN: Reason for the wakeup is a event on the related Icu channel. ETHTRCV_WUR_POWER_ON: Reason for the wakeup is the power on of the ECU. ETHTRCV_WUR_RESET: Reason for the wakeup is the reset of the ECU. ETHTRCV_WUR_SYSERR: Reason for the wakeup is a system error.
          symbolic name reference EthTrcvWakeupSourceRef: set at pre-compile, destination=EcuMWakeupSource  # EcuM Wakeup Source | Reference to a EcuM wakeup source container. This wakeup source is mapped to the wakeup reason and is issued to the EcuM during EcuM_CheckWakeup() with EcuM_SetWakeupEvent() if the corresponding wakeup reason occured.
  bsw implementation EthTrcv_Impl: programming-language=C, sw-version=3.01.00, used-code-generator=DaVinci Configurator, vendor-id=30, ar-release-version=4.01.01, behavior=EthTrcv_30_Tja1100Behavior, preconfigured-configuration=EthTrcv_Pre, recommended-configuration=EthTrcv_Rec, vendor-api-infix=Tja1100, vendor-specific-module-def=EthTrcv
  module config EthTrcv_Pre: definition=EthTrcv
  module config EthTrcv_Rec: definition=EthTrcv
