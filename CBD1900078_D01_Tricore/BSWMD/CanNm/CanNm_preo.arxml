AUTOSAR XML (schema 4-0-3)
package /MICROSAR
  module config CanNm_Rec: definition=CanNm, implementation-config-variant=VARIANT-PRE-COMPILE
