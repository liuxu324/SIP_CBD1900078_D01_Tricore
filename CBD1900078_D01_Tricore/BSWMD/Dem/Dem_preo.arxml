AUTOSAR XML (schema 4-0-3)
package /MICROSAR
  module config Dem_Pre: definition=Dem
  module config Dem_Rec: definition=Dem, implementation-config-variant=VARIANT-PRE-COMPILE
