AUTOSAR XML (schema 4-0-3)
package /MICROSAR
  module definition Dlt [0..1]: category=VENDOR_SPECIFIC_MODULE_DEFINITION, refined-module-def=Dlt, variants pre-compile  # Configuration of the DLT (Diagnostic Log and Trace) module.
    container DltGeneral  # General configuration parameters of the DLT module that add or remove functionality from code.
      boolean DltDevErrorDetect: set at pre-compile, default-value=true  # This parameter switches the Development Error Detection and Notification ON or OFF. true: Development error detection is enabled. false: Development error detection is disabled. Note: In general, the development error detection is recommended during pre-test phase. It is not recommended to enable the development error detection in production code due to increased runtime and ROM needs.
      boolean DltImplementAppIdContextIdQuery [0..1]: set at pre-compile, default-value=false  # If DltImplementAppIdContextIdQuery is true additionally to each Application ID and Context ID a description string shall be storable. RESTRICTIONS: Storing the Application ID and the Context ID in NvRAM is not supported.
      boolean DltImplementExtendedHeader [0..1]: set at pre-compile, default-value=false  # If set the extended functionality for the header shall be available. RESTRICTIONS: Extended DLT Protocol Header Information is not supported.
      boolean DltImplementFilterMessages: set at pre-compile, default-value=false  # This flag is for code generation of Dlt. If set the functionality for filtering messages shall be included in the code.
      boolean DltImplementNVRamStorage [0..1]: set at pre-compile, default-value=false  # If set the functionality for storing and loading information in and from NVRam shall be availible. RESTRICTIONS: Storing and loading information in and from NvRAM is not supported.
      boolean DltImplementSWCInjection [0..1]: set at pre-compile, default-value=false  # If the remote call from functions over the Dlt in SW-C shall be available. RESTRICTIONS: Injection of function calls in SW-C from Dlt is not supported.
      boolean DltImplementTimestamp: set at pre-compile, default-value=false  # If set the timestamp functionality for the header shall be available.
      boolean DltImplementVerboseMode: set at pre-compile, default-value=false  # If set the functionality for Verbose Mode shall be available.
      boolean DltImplementVfbTrace [0..1]: set at pre-compile, default-value=false  # If set the the header files and the implementation of VFB-trace shall be generated. RESTRICTIONS: VFB Tracing is not supported by Dlt.
      integer DltVfbTraceLogLevel [0..1]: 0..6, set at pre-compile  # The log level of the log messages generated by the VFB-Trace RESTRICTIONS: VFB Tracing is not supported by Dlt. | ImplementationType: Dlt_MessageLogLevelType
      string DltUserConfigFile [0..1]: set at pre-compile, origin=Vector Informatik  # Reference to an external user configuration file that will be included during generation. The content of the user configuration file will be added at the end of the generated module configuration file and allows altering or extending the generated code. Caution: User configuration files can cause the software module to malfunction and must only be used with great care!
      integer DltMaxNumberOfDltUsers: 1..4294967295, set at pre-compile, origin=Vector Informatik, default-value=10  # This parameter defines the maximum number of SW-C instances that can use the DLTService concurrently. This parameter directly affects the number of service ports provided by DLT. | ImplementationType: Dlt_MessageLogLevelType
      float DltMainFunctionCycleTime: 0.001..1, set at pre-compile, origin=Vector Informatik, default-value=0.01  # Cycle time of DLT mainfunction. A value of 10 [ms] is recommended.
      enumeration DltComLayer: {XCP, DLTCOM}, set at pre-compile, origin=Vector Informatik, default-value=XCP  # Defines the communication layer to be used. - XCP: Use XCP as transport protocol - DLTCOM: Use an CDD (DltCom) as communication interface. The CDD communicates via TCP/IP.
      boolean DltImplementDemEventFiltering: set at pre-compile, origin=Vector Informatik, default-value=false  # If active, forwarded DEM events are filtered if event status has not changed. If inactive, all DEM events are sent.
      symbolic name reference DltGptChannel [0..1]: set at pre-compile, destination=GptChannelConfiguration  # Reference to the hardware free running timer of the GPT module for time stamps (if no HWFRT is applied, calls to add timestamps are ignored).
    container DltMemory [0..1]  # Configuration parameters for reserving memory for some internal storing and buffer.
      integer DltInitBufferSize [0..0]: 0..4294967295, set at pre-compile  # Buffer size for the C-init buffer. This buffer is for storing messages from other BSW modules before Dlt is initialized. RESTRICTION: The message buffer is used as initial buffer, therefore an explicit init buffer is not used. | Unit: byte
      integer DltMaxCountAppIds: 1..65535, set at pre-compile, default-value=10  # The maximum count of register able Application Ids. There shall be a table to manage registered Application IDs, this is the number of lines to hold in this table. | Unit: byte
      integer DltMaxCountContextIds: 1..4294967295, set at pre-compile, default-value=10  # The maximum count of registrable Context Ids. There shall be a table to manage registered Context IDs, this is the number of lines to hold in this table. | Unit: byte
      integer DltMaxCountContextIdsPerAppId: 1..65535, set at pre-compile, default-value=10  # Each Context ID belongs to a specific Application ID. Dlt shall handle the correlation between them. The table of the registered Application IDs shall hold for every Application ID several references to the proper Context IDs. This is the maximum count for Context IDs per Application ID. | Unit: byte
      integer DltMessageBufferSize: 0..4294967295, set at pre-compile, default-value=512  # Buffer size for storing Dlt messages for waiting to transmit over the Network (send buffer). | Unit: byte
    container DltMultipleConfigurationContainer  # General configuration parameters of the DLT module.
      symbolic name reference DltNvRamBlockRef [0..1]: set at pre-compile, destination=NvMBlockDescriptor  # Reference to the NvM Block which is used to store the Dlt parameters. RESTRICTIONS: Storing and loading information in and from NvRAM is not supported.
      container DltBandwidth [0..0]  # Configuration parameters controlling network and diagnostic interfaces bandwidth. If DltImplementNVRamStorage is enabled this parameters are the initial values for the NVRam. If DltImplementNVRamStorage is not set, Link-Time or Post-Build configuration shall be uesd. RESTRICTIONS: Communication over standard Dcm channel and communication over Dlt Communication Module is not supported.
        integer DltBandwidthForComModule: 0..4294967295, set at pre-compile  # For communication over the Dlt Communication Module the maximum bandwidth shall be set. | Unit: kbit per second
        integer DltBandwidthForDiagChannel: 0..4294967295, set at pre-compile  # For communication over the DCM and as follows over the diagnostic interface the maximum bandwidth shall be set. | Unit: kbit per second
        float DltTimePeriodTrafficShaping: 0..Inf, set at pre-compile  # For implementing a traffic shaping, a time window for measuring shall be provided. | Unit: second
      container DltMessageFiltering [0..1]  # Configuration parameters for setting message filtering properties in Dlt module. RESTRICTIONS: In case of XCP as com layer: Message filtering is realized by calling Appl_DltDemEventFilterCbk().
        integer DltDefaultMaxLogLevel: 0..6, set at pre-compile, default-value=3  # The maximum log level a received message (from SW-C to Dlt) can have. This can also be modified at runtime and stored persistently in NVRAM. If DltImplementNVRamStorage is enabled this parameter is the initial value for the corospending NVRam entry. If DltImplementNVRamStorage is not set, Link-Time or Post-Build configuration shall be uesd. The value 0 means loging is disabled. | ImplementationType: Dlt_MessageLogLevelType
        boolean DltDefaultTraceStatus: set at pre-compile, default-value=false  # Tells if trace messages shall be forwarded by Dlt. This functionality can also be modified at runtime and changed can stored persistently in NVRAM. If DltImplementNVRamStorage is enabled this parameter is the initial value for the corresponding NVRam entry. If DltImplementNVRamStorage is not set, Link-Time or Post-Build configuration shall be used.
        integer DltFactoryDefaultMaxLogLevel: 0..6, set at pre-compile, default-value=3  # The maximum log level a received message (from SW-C to Dlt) can have. This is for setting DltDefaultMaxLogLevel to factory defaults. The value 0 means loging is disabled. | ImplementationType: Dlt_MessageLogLevelType
        boolean DltFilterMessages: set at pre-compile, default-value=false  # This flag gives the Dlt the instruction to filter or not to filter incoming log or trace messages. If it is not set all incoming messages are forwarded to the communication channel. So also the caller of the DltSendXXXMessage can leave the field trace_info or log_info empty. | If DltImplementNVRamStorage is enabled this parameter is the initial value for the corospending NVRam entry. If DltImplementNVRamStorage is not set, Link-Time or Post-Build configuration shall be uesd.
      container DltProtocol  # Configuration parameters for handling the specific protocol variants.
        string DltEcuId [0..1]: set at pre-compile, default-value=ECUI, max-length=4, min-length=4  # This is the name of the ECU for use within the Dlt protocol. The meaning is described in the document. This name is transimitted within the Dlt protocol. There this are 4 characters. If you want to use an number representation type this as character.
        enumeration DltHeaderPayloadEndianes: {BigEndian, LittleEndian}, set at pre-compile, default-value=LittleEndian  # Determines the endianes of the CPU (Most Significant Byte).
        boolean DltHeaderUseEcuId [0..1]: set at pre-compile, default-value=false  # Corresponds to field WEID (With ECU ID). If set ECU ID shall be placed in the header, else not. | If DltImplementNVRamStorage is enabled this parameter is the initial value for the corospending NVRam entry. If DltImplementNVRamStorage is not set, Link-Time or Post-Build configuration shall be uesd.
        boolean DltHeaderUseExtendedHeader [0..1]: set at pre-compile, default-value=false  # Corresponds to field UEH (Use Extended Header). If set the Extended Header shall be attached, else not. | If DltImplementNVRamStorage is enabled this parameter is the initial value for the corospending NVRam entry. If DltImplementNVRamStorage is not set, Link-Time or Post-Build configuration shall be uesd.
        boolean DltHeaderUseSessionID [0..1]: set at pre-compile, default-value=false  # Corresponds to field WSID (with Session ID). If set the Session ID shall be placed in the header, else not. | If DltImplementNVRamStorage is enabled this parameter is the initial value for the corospending NVRam entry. If DltImplementNVRamStorage is not set, Link-Time or Post-Build configuration shall be uesd.
        boolean DltHeaderUseTimestamp [0..1]: set at pre-compile, default-value=false  # Corresponds to field WTMS (With Timestamp). If set the timestamp shall be placed in the header, else not. | If DltImplementNVRamStorage is enabled this parameter is the initial value for the corospending NVRam entry. If DltImplementNVRamStorage is not set, Link-Time or Post-Build configuration shall be uesd.
        integer DltMaxMessageLength: 8..65535, set at pre-compile, default-value=128  # The maximum length of a verbose DLT log or trace message that can be transmitted over the network. Each time a verbose message is written the (in this parameter) conifgured number of bytes are transmitted. If the provided string is shorter than the configured message length size a termination character will be added automatically. To reduce busload and latency it is recommended to choose a value as small as possible (e.g. to the payload size of one XCP frame).
        boolean DltUseVerboseMode [0..1]: set at pre-compile, default-value=false  # If this flag is set Dlt shall support the the Verbose Mode (VERB) flag in the extended protocol header to indicate whether the transmitted data is provided within the payload or not. Since the DLT payload is transmitted via XCP and the protocol header is currently not used this flag has no effect. Hint: Configure the /Dlt/DltGeneral/DltImplementVerboseMode parameter to enable/disable the usage of the Dlt Verbose Mode. | If DltImplementNVRamStorage is enabled this parameter is the initial value for the corospending NVRam entry. If DltImplementNVRamStorage is not set, Link-Time or Post-Build configuration shall be uesd.
    container DltNonVerboseMessage [0..*]  # Non-Verbose messages require a minimum bandwith as only its identifier will be transmitted over the network. The XCP tool will then resolve the identifier to the string defined as static data. To transmit a non-verbose message use the API: <Name>. Hint: Use the verbose message API to transmit a runtime defined string over the network.
      integer DltMessageId: set at pre-compile, origin=Vector Informatik, symbolic-name-value=true, default-value=3  # Message ID is the unique ID to characterize the information, which is transported by the non-verbose message itself. The message ID will be assigned automatically. RESTRICTIONS: Message IDs used for Dem (1) and Det (2) are reserved and not usable for the application.
      string DltStaticData: set at pre-compile, origin=Vector Informatik, symbolic-name-value=true  # Data of static information that is associated with the Message ID. This data is not transmitted with the non-verbose message but is stored in the A2L file.
    container DltVfbTrace [0..0]  # All functions to trace from the VFB by the Dlt. RESTRICTIONS: VFB Tracing is not supported by Dlt.
      function name DltVfbTraceFunction: set at pre-compile  # The Dlt generator shall enable VFB tracing for a given hook function when there is a #define in the Dlt-VFB configuration header file for the hook function name and tracing is globally enabled. | Example: #define Dlt_Rte WriteHook i1 p1 a Start. Also the corresponding function shall be generated. The exact argument description for the function is to take from the provieded BSWModudulDescription from the RTE module.
      foreign reference DltBswModuleEntryRef: set at pre-compile, destination-type=BSW-MODULE-ENTRY  # Foreign reference to the BSWModuleEntry describing the trace function implementation.
  bsw implementation Dlt_Impl: programming-language=C, sw-version=1.07.04, used-code-generator=cMSR, vendor-id=30, ar-release-version=4.00.03, behavior=DltBehavior, preconfigured-configuration=Dlt_Pre, recommended-configuration=Dlt_Rec, vendor-specific-module-def=Dlt
  module config Dlt_Pre: definition=Dlt
  module config Dlt_Rec: definition=Dlt
