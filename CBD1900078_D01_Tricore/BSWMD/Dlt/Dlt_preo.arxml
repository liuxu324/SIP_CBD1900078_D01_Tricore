AUTOSAR XML (schema 4-0-3)
package /MICROSAR
  module config Dlt_Rec: definition=Dlt, implementation-config-variant=VARIANT-PRE-COMPILE
