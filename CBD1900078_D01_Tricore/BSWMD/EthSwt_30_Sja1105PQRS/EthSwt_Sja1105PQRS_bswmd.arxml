AUTOSAR XML (schema 4-2-1)
package /MICROSAR/EthSwt_Sja1105PQRS
  module definition EthSwt [0..*]: category=VENDOR_SPECIFIC_MODULE_DEFINITION, refined-module-def=EthSwt, variants pre-compile  # Configuration of the EthSwt (Ethernet Switch Driver) module.
    container EthSwtConfig [1..*]: multiplicity set at pre-compile  # Configuration of one Ethernet Switch.
      integer EthSwtIdx: 0..255, scope=ECU, multiplicity set at pre-compile, post-build-variant-value=true, set at pre-compile, symbolic-name-value=true, default-value=0  # Index | This parameter defines the index used to address the switch within the BSW.
      enumeration EthSwtDerivative: multiplicity set at pre-compile, origin=Vector Informatik, set at pre-compile, default-value=SJA1105P  # Derivative | This parameter defines which derivative of the NXP switch the driver has to configure and control.
        SJA1105P
        SJA1105Q
        SJA1105R  # SJA110R
        SJA1105S
      integer EthSwtDefaultVlanId: 0..4094, multiplicity set at pre-compile, origin=Vector Informatik, set at pre-compile, default-value=0  # Default VLAN ID | This parameter defines the default VLAN ID used by the switch to handle un-tagged traffic internally on ports where no ingress VLAN tagging is enabled.
      integer EthSwtDefaultPcp: 0..7, multiplicity set at pre-compile, origin=Vector Informatik, set at pre-compile, default-value=0  # Default PCP | This parameter defines the default PCP used by the switch to handle un-tagged traffic internally on ports where no ingress VLAN tagging is enabled.
      boolean EthSwtEnableAddressAging: multiplicity set at pre-compile, origin=Vector Informatik, set at pre-compile, default-value=false  # Enable Address Aging | This parameter defines if address aging is applied to entries of the address table learned during runtime. FALSE: Address aging is not applied. Learned entries will not be forgotten. TRUE: Address aging is applied. Learned entries will be forgotten if no frame with a matching source MAC address is received for the timeout configured by EthSwtAddressAgeingTimeout.
      float EthSwtAddressAgingTimeout [0..1]: 10..327670, multiplicity set at pre-compile, origin=Vector Informatik, set at pre-compile, default-value=60000  # Address Aging Timeout | This parameter defines the timeout after an entry of the address lookup table is forgotten if no frame with a matching source MAC address is received.
      integer EthSwtStaticVlanNum: 0..4096, multiplicity set at pre-compile, origin=Vector Informatik, set at pre-compile, default-value=1  # Static VLAN Number | This parameter defines the number of VLANs configured due to configuration settings applied to the switch ports.
      integer EthSwtOverallVlanNum: 0..4096, multiplicity set at pre-compile, origin=Vector Informatik, set at pre-compile, default-value=1  # Overall VLAN Number | This parameter defines the number of VLANs that can be handled during runtime. This parameter represents the sum of static and dynamic VLANs.
      integer EthSwtDynamicVlanNum: 0..4096, multiplicity set at pre-compile, origin=Vector Informatik, set at pre-compile, default-value=0  # Dynamic VLAN Number | This parameter defines the number of VLANs which are not related to any configuration settings that can be additionally handled during runtime.
      boolean EthSwtGlobalTimeSupport: multiplicity set at pre-compile, origin=Vector Informatik, set at pre-compile, default-value=false  # Global Time Support | This parameter defines if port specific time stamping is enabled/disabled.
      boolean EthSwtManagementSupport: multiplicity set at pre-compile, origin=Vector Informatik, set at pre-compile, default-value=false  # Management Support | The parameter defines if the management capabilities of the switch are enabled/disabled.
      float EthSwtMgmtInfoIndicationTimeout: 0..1, multiplicity set at pre-compile, origin=Vector Informatik, set at pre-compile, default-value=0.1  # Management Info Indication Timeout | This parameter isn't applicable for this driver.
      string EthSwtManagementDestMacs [0..*]: multiplicity set at pre-compile, origin=Vector Informatik, set at pre-compile, default-value=01:80:C2:00:00:0E  # Managed Frame Destination MAC address | This parameter defines the destination MAC address that is used for frames that must be managed.
      float EthSwtTimeStampInfoIndicationTimeout: 0.001..1, multiplicity set at pre-compile, origin=Vector Informatik, set at pre-compile, default-value=0.001  # Time Stamp Info Indication Timeout | This parameter specifies the timeout for fetching timestamps related to PTP frames. If the timeout is reached the missing timestamp will be reported to the upper layer modules of the stack so they are able to take further actions based on their protocol specification.
      integer EthSwtMgmtFrameQueue [0..1]: 0..7, multiplicity set at pre-compile, origin=Vector Informatik, set at pre-compile, default-value=7  # This parameter defines the Ingress and Egress queue which is used for managed frames. If a shaper is configured for this queue, the manged frames will also be taken into account.
      string EthSwtManagementMetaFrameSrcMac [0..1]: multiplicity set at pre-compile, origin=Vector Informatik, set at pre-compile, default-value=01:70:C2:AA:BB:CC  # This parameter defines the source MAC address of the META frames, which are generated by the Sja1105PQRS when FrameManagement / Global Time Support is enabled. The configured MAC address must be unique and and not used be other frames in the system.
      string EthSwtPerStreamPolicingMarker [0..1]: multiplicity set at pre-compile, origin=Vector Informatik, set at pre-compile, default-value=00:00:00:00, max-length=11, min-length=11  # This parameter and the parameter EthSwtPerStreamPolicingMask are used to decide if an Ethernet frame might be used for a stream or not. The four most significant bytes of the destination MAC address are bitwise anded with EthSwtPerStreamPolicingMask. EthSwtPerStreamPolicingMarker is also bitwise anded with EthSwtPerStreamPolicingMask. If both results are the same, the Ethernet frame will be used as stream if the two last significant bytes of the destination MAC address match EthSwtPortPerStreamPolicerIdentifier.
      string EthSwtPerStreamPolicingMask [0..1]: multiplicity set at pre-compile, origin=Vector Informatik, set at pre-compile, default-value=FF:FF:FF:FF, max-length=11, min-length=11  # See description of EthSwtPerStreamPolicingMarker
      symbolic name reference EthSwtManagementEthCtrlRef [0..1]: multiplicity set at pre-compile, origin=Vector Informatik, set at pre-compile, destination=EthCtrlConfig  # Management Ethernet Controller | This reference defines the Ethernet Controller connected to the Management Port where the frames to be managed are sent to.
      symbolic name reference EthSwtManagementPortRef [0..1]: multiplicity set at pre-compile, origin=Vector Informatik, set at pre-compile, destination=EthSwtPort  # Management Port | This reference defines the port where the managment entity (Host-CPU) is connected to.
      container EthSwtDemEventParameterRefs [0..1]: multiplicity set at pre-compile  # Container for the references to DemEventParameter elements which shall be invoked using the API Dem_ReportErrorStatus in case the corresponding error occurs. The EventId is taken from the referenced DemEventParameter's DemEventId value. The standardized errors are provided in the container and can be extended by vendor specific error references.
        symbolic name reference ETHSWT_E_ACCESS [0..1]: multiplicity set at pre-compile, post-build-variant-value=true, set at pre-compile, destination=DemEventParameter  # E_ACCESS | Reference to the DEM event issued if an configuration interface access issue occurs.
        symbolic name reference ETHSWT_E_BUFFEROVERRUN [0..1]: multiplicity set at pre-compile, origin=Vector Informatik, set at pre-compile, destination=DemEventParameter  # E_BUFFEROVERRUN | Reference to the DEM event issued if a buffer overrun is detected.
        symbolic name reference ETHSWT_E_CRC [0..1]: multiplicity set at pre-compile, origin=Vector Informatik, set at pre-compile, destination=DemEventParameter  # E_CRC | Reference to the DEM event issued if a CRC error is detected.
        symbolic name reference ETHSWT_E_UNDERSIZEPCKT [0..1]: multiplicity set at pre-compile, origin=Vector Informatik, set at pre-compile, destination=DemEventParameter  # E_UNDERSIZEPCKT | Reference to the DEM event issued if an undersited frame is detected.
        symbolic name reference ETHSWT_E_OVERSIZEPCKT [0..1]: multiplicity set at pre-compile, origin=Vector Informatik, set at pre-compile, destination=DemEventParameter  # E_OVERSIZEPCKT | Reference to the DEM event issued if an oversited frame is detected.
        symbolic name reference ETHSWT_E_ALIGNMENT [0..1]: multiplicity set at pre-compile, origin=Vector Informatik, set at pre-compile, destination=DemEventParameter  # E_ALIGNMENT | Reference to the DEM event issued if an alignment error is detected.
        symbolic name reference ETHSWT_E_SQETEST [0..1]: multiplicity set at pre-compile, origin=Vector Informatik, set at pre-compile, destination=DemEventParameter  # E_SQETEST | Reference to the DEM event issued if a SQE test error is detected.
        symbolic name reference ETHSWT_E_INDISCARD [0..1]: multiplicity set at pre-compile, origin=Vector Informatik, set at pre-compile, destination=DemEventParameter  # E_INDISCARD | Reference to the DEM event issued if a non errornous frame is discarded on ingress side.
        symbolic name reference ETHSWT_E_INERROR [0..1]: multiplicity set at pre-compile, origin=Vector Informatik, set at pre-compile, destination=DemEventParameter  # E_INERROR | Reference to the DEM event issued if a errournous frame on ingress side is detected.
        symbolic name reference ETHSWT_E_OUTDISCARD [0..1]: multiplicity set at pre-compile, origin=Vector Informatik, set at pre-compile, destination=DemEventParameter  # E_OUTDISCARD | Reference to the DEM event issued if a non errornous frame is discarded on egress side.
        symbolic name reference ETHSWT_E_OUTERROR [0..1]: multiplicity set at pre-compile, origin=Vector Informatik, set at pre-compile, destination=DemEventParameter  # E_OUTERROR | Reference to the DEM event issued if a errournous frame on egress side is detected.
        symbolic name reference ETHSWT_E_SINGLECOLLISION [0..1]: multiplicity set at pre-compile, origin=Vector Informatik, set at pre-compile, destination=DemEventParameter  # E_SINGLECOLLISION | Reference to the DEM event issued if a single collision is detected.
        symbolic name reference ETHSWT_E_MULTIPLECOLLISION [0..1]: multiplicity set at pre-compile, origin=Vector Informatik, set at pre-compile, destination=DemEventParameter  # E_MULTIPLECOLLISION | Reference to the DEM event issued if a multiple collision is detected.
        symbolic name reference ETHSWT_E_DEFFEREDTRANSMISSION [0..1]: multiplicity set at pre-compile, origin=Vector Informatik, set at pre-compile, destination=DemEventParameter  # E_DEFFEREDTRANSMISSION | Reference to the DEM event issued if a deffered transmission is detected.
        symbolic name reference ETHSWT_E_LATECOLLISION [0..1]: multiplicity set at pre-compile, origin=Vector Informatik, set at pre-compile, destination=DemEventParameter  # E_LATECOLLISION | Reference to the DEM event issued if a late collision is detected.
      container EthSwtNvm [0..1]: multiplicity set at pre-compile  # Configuration of one Ethernet Switch Nvm usage in case the module requires non volatile memory in the Ecu to store switch configuration.
        symbolic name reference EthSwtTableNvmBlockDescriptorRef: scope=ECU, multiplicity set at pre-compile, set at pre-compile, destination=NvMBlockDescriptor  # NvM Block | Reference to the Nvm block description in the Nvm module configuration to store e.g. the learned ARL table
        symbolic name reference EthSwtConfigurationNvmBlockDescriptorRef: set at pre-compile, multiplicity set at pre-compile, set at pre-compile, destination=NvMBlockDescriptor  # Mirroring NvM Block | Reference to the Nvm block description in the Nvm module configuration to store e.g. the port mirror configurations
      container EthSwtPort [1..*]: multiplicity set at pre-compile  # Configuration of one Ethernet Switch Port.
        boolean EthSwtPortEnableLinkDownCallback: multiplicity set at pre-compile, set at pre-compile, default-value=false  # Enable IEEE802.1X Link Down Callback | Enables the callback <User>_LinkDown for this EthSwtPort if an IEEE802.1X link loss is detected. (not supported) | <User> is defined by EthSwtLinkDownUser.
        integer EthSwtPortIdx: 0..255, scope=ECU, multiplicity set at pre-compile, post-build-variant-value=true, set at pre-compile, symbolic-name-value=true, default-value=0  # Port Index | This parameter defines the index of this port.
        enumeration EthSwtPortPhysicalLayerType: {ETHSWT_PORT_BASE_T, ETHSWT_PORT_BROAD_R_REACH, ETHSWT_PORT_RTPGE, ETHSWT_PORT_X_MII}, scope=ECU, multiplicity set at pre-compile, post-build-variant-value=true, set at pre-compile, default-value=ETHSWT_PORT_X_MII  # Physical Layer Type | This parameter defines the type of the interface on the pin level of the switch. All ports of SJA1105PQRS have a xMII interface. Therefore ETHSWT_PORT_X_MII ist the only possible value allowed to be configured. ETHSWT_PORT_X_MII: xMII Interface
        string EthSwtPortPredefinedMacAddresses [0..*]: multiplicity set at pre-compile, post-build-variant-value=true, set at pre-compile  # Predefined/Static MAC Address | This parameter defines a MAC address, which is statically included into the L2 lookup table of the SJA1105PQRS. | Note that further addresses can be learned during runtime.
        enumeration EthSwtPortSpeed [0..1]: {ETHSWT_PORT_SPEED_10, ETHSWT_PORT_SPEED_100, ETHSWT_PORT_SPEED_1000}, scope=ECU, multiplicity set at pre-compile, post-build-variant-value=true, set at pre-compile, default-value=ETHSWT_PORT_SPEED_100  # Speed | This parameter defines the speed configured for this port. | Is optional if EthSwtPortTrcvRef is defined.
        enumeration EthSwtHardwarePort: {ETHSWT_PORT_1, ETHSWT_PORT_2, ETHSWT_PORT_3, ETHSWT_PORT_4, ETHSWT_PORT_5}, multiplicity set at pre-compile, origin=Vector Informatik, set at pre-compile, default-value=ETHSWT_PORT_1  # Hardware Port | This parameter defines the Hardware Port represented by this configuration port.
        enumeration EthSwtXMiiPhyType [0..1]: {PHY_MANAGED_BY_MCU, PHY_MANAGED_BY_SWITCH, NO_PHY}, multiplicity set at pre-compile, origin=Vector Informatik, set at pre-compile, default-value=PHY_MANAGED_BY_MCU  # xMII PHY Type | This parameter defines if and how a PHY is connected to the switch xMII port. PHY_MANAGED_BY_MCU: The xMii interface of the port is connected to a PHY having its managment interface (MDIO/MDC) connected to a MCU. PHY_MANAGED_BY_SWITCH: The xMii interface of the port is connected to a PHY having its managment interface (MDIO/MDC) connected to the switch too. NO_PHY: The xMii interface of the port is directly connected to annother xMii interface without a PHY inbetween.
        enumeration EthSwtXMiiType: {ETHSWT_MII, ETHSWT_RMII, ETHSWT_RGMII, ETHSWT_SGMII}, multiplicity set at pre-compile, origin=Vector Informatik, set at pre-compile, default-value=ETHSWT_MII  # xMII Type | This parameter defines the type of MII-Interface used to connect to the ports counter part (MAC/PHY). ETHSWT_MII: Common MII interface allowing 10/100 MBit/s data connections. ETHSWT_RMII: Reduced MII interface allowing 10/100 MBit/s data connections. ETHSWT_RGMII: Reduced Gigabit MII Interface allowing 10/100/1000 MBit/s ETHSWT_SGMII (SJA1105R/S Port 4 only): Serial Gigabit MII Interface allowing 10/100/1000 MBit/s
        enumeration EthSwtOverridePortMode [0..1]: {ETHSWT_PORT_MAC_MODE, ETHSWT_PORT_PHY_MODE}, multiplicity set at pre-compile, origin=Vector Informatik, set at pre-compile, default-value=ETHSWT_PORT_MAC_MODE  # This parameter overrides the settings of EthSwtXMiiPhyType. This is only necessary for some hardware layouts, eg. when the host controller is connected via RMII and does not provide a REFCLK. In most cases the configuration of the EthSwtXMiiPhyType parameter is sufficient.
        boolean EthSwtPortTimeStampSupport: multiplicity set at pre-compile, origin=AUTOSAR, set at pre-compile, default-value=false  # Time Stamping Support | This parameter defines if time stamping on this port is enabled/disabled.
        enumeration EthSwtPortSlewRate [0..1]: {ETHSWT_HIGH_SPEED_MODE, ETHSWT_FAST_SPEED_MODE, ETHSWT_MEDIUM_SPEED_MODE, ETHSWT_LOW_SPEED_MODE}, multiplicity set at pre-compile, origin=Vector Informatik, set at , default-value=ETHSWT_MEDIUM_SPEED_MODE  # This parameter specifies the slew rate for the port. Please refer to the chapter "Slew Rate Settings" of the NXP Sja1105PQRS Application Note. Based on the interface type, voltage and frequency recommended settings are provided for improving EMC performance. Using a wrong setting here can prevent correct communication on this port.
        symbolic name reference EthSwtPortTrcvRef [0..1]: scope=ECU, multiplicity set at pre-compile, post-build-variant-value=true, set at pre-compile, destination=EthTrcvConfig  # Ethernet Transceiver | This reference selects the Ethernet transceiver representing and managing the PHY of this port.
        container EthSwtPortEgress: multiplicity set at pre-compile  # Configuration of one Ethernet Switch Port Egress behavior.
          reference EthSwtPortEgressLastSchedulerRef: multiplicity set at pre-compile, set at pre-compile, destination=EthSwtPortScheduler  # Last scheduler | Reference to the port scheduler which is the last in the egress port structure.
          container EthSwtPortFifo [1..*]: multiplicity set at pre-compile  # Represents a Fifo in the egress port.
            integer EthSwtPortFifoTrafficClassAssignment [0..8]: 0..7, scope=ECU, multiplicity set at pre-compile, post-build-variant-value=true, set at pre-compile, default-value=0  # PCP assignment | This parameter defines the PCP assigned to the FIFO. Note: SJA1105PQRS hardware doesn't define an internal priority representation but works with the PCP of the VLAN-Tag. Therefore this assignment is no internal priority to FIFO assignment but a assignment of the VLAN-tags PCP.
            integer EthSwtPortFifoIdx: 0..7, multiplicity set at pre-compile, origin=Vector Informatik, set at pre-compile, default-value=0  # FIFO Index | This value defines the index of this FIFO.
            enumeration EthSwtHardwareFifo: {ETHSWT_QUEUE0, ETHSWT_QUEUE1, ETHSWT_QUEUE2, ETHSWT_QUEUE3, ETHSWT_QUEUE4, ETHSWT_QUEUE5, ETHSWT_QUEUE6, ETHSWT_QUEUE7}, multiplicity set at pre-compile, origin=Vector Informatik, set at pre-compile, default-value=ETHSWT_QUEUE0  # Hardware Queue | This parameter defines the hardware queue representet by this configuration FIFO.
          container EthSwtPortScheduler [1..*]: multiplicity set at pre-compile  # Represents a Scheduler in the egress port.
            enumeration EthSwtPortSchedulerAlgorithm: {ETHSWT_SCHEDULER_DEFICIT_ROUND_ROBIN, ETHSWT_SCHEDULER_STRICT_PRIORITY, ETHSWT_SCHEDULER_WEIGHTED_ROUND_ROBIN}, multiplicity set at pre-compile, post-build-variant-value=true, set at pre-compile, default-value=ETHSWT_SCHEDULER_STRICT_PRIORITY  # Scheduling Algorithm | This parameter defines the scheduling algorithm used to schedule the predecessor elements configured by EthSwtPortSchedulerPredecessor. SJA1105PQRS only allows strict priority algorithm. Therefore ETHSWT_SCHEDULER_STRICT_PRIORITY is the only value allowed to be configured. ETHSWT_SCHEDULER_STRICT_PRIORITY: Strict priority algorithm.
            container EthSwtPortSchedulerPredecessor [1..*]: multiplicity set at pre-compile  # Defines an ordered list of predecessors for this scheduler.
              integer EthSwtPortSchedulerPredecessorOrder: 0..18446744073709551615, scope=ECU, multiplicity set at pre-compile, post-build-variant-value=true, set at pre-compile, default-value=0  # Order index | This value defines the index in the order of predecessors applied to the scheduler.
              choice reference EthSwtPortEgressPredecessorRef: multiplicity set at pre-compile, set at pre-compile, destination=[EthSwtPortFifo, EthSwtPortScheduler, EthSwtPortShaper]  # Choice reference to the scheduler predecessor.
          container EthSwtPortShaper [0..*]: multiplicity set at pre-compile  # Represents a Shaper in the egress port.
            integer EthSwtPortShaperIdleSlope [0..1]: 0..1000000000, multiplicity set at pre-compile, post-build-variant-value=true, set at pre-compile, default-value=20000000  # Bandwidth Limit [Bit/s] | This value defines the maximum bandwidth that this queue is able to allocate in Bit/s.
            enumeration EthSwtHardwareShaper: {ETHSWT_SHAPER0, ETHSWT_SHAPER1, ETHSWT_SHAPER2, ETHSWT_SHAPER3, ETHSWT_SHAPER4, ETHSWT_SHAPER5, ETHSWT_SHAPER6, ETHSWT_SHAPER7, ETHSWT_SHAPER8, ETHSWT_SHAPER9}, multiplicity set at pre-compile, origin=Vector Informatik, set at pre-compile, default-value=ETHSWT_SHAPER0  # This parameter defines the hardware shaper representet by this configuration shaper.
            reference EthSwtPortEgressPredecessorFifoRef: multiplicity set at pre-compile, set at pre-compile, destination=EthSwtPortFifo  # Reference to the fifo which is the predecessor for this shaper.
          container EthSwtPortVlanForwarding [0..*]: multiplicity set at pre-compile  # Defines how messages with a specific VLAN Id shall be handled at this egress port wrt. their VLAN Id.
            integer EthSwtPortVlanDefaultPriority: 0..7, scope=ECU, multiplicity set at pre-compile, post-build-variant-value=true, set at pre-compile, default-value=0  # Default PCP | This value specifies the default PCP applied to a VLAN tagged frame. (not supported)
            integer EthSwtPortVlanForwardingId: 0..4094, scope=ECU, multiplicity set at pre-compile, post-build-variant-value=true, set at pre-compile, default-value=0  # VLAN-ID | This value defines the VLAN-ID the forwarding rule shall be applied to.
            enumeration EthSwtPortVlanForwardingType: {ETHSWT_NOT_SENT, ETHSWT_SENT_TAGGED, ETHSWT_SENT_UNTAGGED}, scope=ECU, multiplicity set at pre-compile, post-build-variant-value=true, set at pre-compile, default-value=ETHSWT_SENT_TAGGED  # Forwarding Rule | This parameter defines the rule that shall be applied to the VLAN tagged frame. ETHSWT_NOT_SENT: Do not forward a frame with the corresponding VLAN ID on this port. ETHSWT_SENT_TAGGED: Forward a frame with the corresponding VLAN-ID on this port without changing the VLAN tag. ETHSWT_SENT_UNTAGGED: Forward a frame wiht the corresponding VLAN-ID on this port without the VLAN tag (tag will be removed).
          container EthSwtQbvScheduler [0..*]: multiplicity set at pre-compile  # Vector Informatik | Defines the Qbv scheduling
            integer EthSwtQbvScheduleEntryGateDuration: 1..52428800, multiplicity set at pre-compile, origin=Vector Informatik, set at pre-compile, default-value=1000000  # Gate Duration | This value defines the duration the respective gate (FIFO) is opened and allowed to transmit frames. Note: This duration must implcitly include the guard duration for the next entry.
            integer EthSwtQbvScheduleEntryAbsoluteStartOffset: 0..10000000000, multiplicity set at pre-compile, origin=Vector Informatik, set at pre-compile, default-value=0  # Absolute time when the entry shall be scheduled | This value defines the absolute time when the entry shall be scheduled. If there are two or more entries for different ports at the same absolute time, they have to use the same FIFO. The last entry has to switch off all FIFO.
            reference EthSwtQbvSchedulerEntryFifoRef [0..8]: multiplicity set at pre-compile, origin=Vector Informatik, set at pre-compile, destination=EthSwtPortFifo  # Gate (FIFO) | Defines which gate (FIFO) are allowed to send during the active time of this entry.
            reference EthSwtQbvSchedulerEntryPerStreamPolicerRef [0..1]: multiplicity set at pre-compile, origin=Vector Informatik, set at pre-compile, destination=EthSwtPortPerStreamPolicer  # Reference to a per stream policer rule which will use this schedule.
        container EthSwtPortIngress: multiplicity set at pre-compile  # Configuration of one Ethernet Switch Port ingress behavior.
          integer EthSwtPortIngressVlanModification [0..1]: 0..4094, scope=ECU, multiplicity set at pre-compile, post-build-variant-value=true, set at pre-compile, default-value=0  # VLAN-ID Modification | This parameter defines the VLAN-ID untagged traffic will be tagged with. | If this parameter is not defined no changes to the VLAN Id shall happen at this ingress port.
          integer EthSwtPortTrafficClassAssignment [0..1]: 0..7, scope=ECU, multiplicity set at pre-compile, post-build-variant-value=true, set at pre-compile, default-value=0  # Traffic Class Assignment | This parameter defines the default PCP which shall be applied to the VLAN-tag of untagged traffic. | If this parameter is not defined no general port based traffic class assignment is done.
          boolean EthSwtPortIngressAllowUntaggedTraffic: multiplicity set at pre-compile, origin=Vector Informatik, set at pre-compile, default-value=true  # Allow Untagged Traffic | This parameter defines if untagged traffic is dropped or is allowed to pass. FALSE: Untagged traffic is dropped TRUE: Untagged traffic is allowed to pass.
          boolean EthSwtPortIngressAllowDoubleTaggedTraffic: multiplicity set at pre-compile, origin=Vector Informatik, set at pre-compile, default-value=false  # Allow Double Tagged Traffic | This parameter defines if double tagged traffic is dropped or allowed to pass. FALSE: Double tagged traffic is dropped. TRUE: Double tagged traffic is allowed to pass.
          container EthSwtPriorityRegeneration [0..8]: multiplicity set at pre-compile  # Defines a priority regeneration where the EthSwtPriorityRegenerationIngressPriority is replaced by EthSwtPriorityRegenerationRegeneratedPriority. | The EthSwtPriorityRegeneration is optional in case no priority regeneration shall be performed. In case a EthSwtPriorityRegeneration is defined it shall have 8 mappings, one for each priority.
            integer EthSwtPriorityRegenerationIngressPriority: 0..7, scope=ECU, multiplicity set at pre-compile, post-build-variant-value=true, set at pre-compile, default-value=0  # Ingress PCP | This parameter defines the ingress PCP the regeneration shall be applied for.
            integer EthSwtPriorityRegenerationRegeneratedPriority: 0..7, scope=ECU, multiplicity set at pre-compile, post-build-variant-value=true, set at pre-compile, default-value=0  # Regenerated PCP | This parameter defines the regenerated PCP.
          container EthSwtPriorityTrafficClassAssignment [0..8]: multiplicity set at pre-compile  # This container is unused. SJA1105PQRS hardware doesn't define an internal priority representation but works with the PCP of the VLAN-Tag. (not supported)
            integer EthSwtPriorityTrafficClassAssignmentPriority: 0..7, scope=ECU, multiplicity set at pre-compile, post-build-variant-value=true, set at pre-compile, default-value=0  # Ingress PCP | This parameter is unused. SJA1105PQRS hardware doesn't define an internal priority representation but works with the PCP of the VLAN-Tag. (not supported)
            integer EthSwtPriorityTrafficClassAssignmentTrafficClass: 0..7, scope=ECU, multiplicity set at pre-compile, post-build-variant-value=true, set at pre-compile, default-value=0  # Assigned Traffic-Class | This parameter is unused. SJA1105PQRS hardware doesn't define an internal priority representation but works with the PCP of the VLAN-Tag. (not supported)
          container EthSwtPortPolicer [0..32760]: multiplicity set at pre-compile  # Defines rate policing parameters which are applied to ingress traffic.
            integer EthSwtPortRatePolicedByteCount: 1..1250000000, multiplicity set at pre-compile, set at pre-compile, default-value=12500000  # This parameter defines the amount of byte counts (excluding header information) which can be received in a configured EthSwtPortRatePolicedTimeInterval.
            float EthSwtPortRatePolicedTimeInterval: 0..86400, multiplicity set at pre-compile, set at pre-compile, default-value=1  # This parameter defines the time interval in seconds where a configured EthSwtPortRatePolicedByteCount can be received without a rate limitation.
            integer EthSwtPortRatePolicedPriority [0..1]: 0..7, multiplicity set at pre-compile, set at pre-compile, default-value=0  # This parameter defines the priority which this rate policy shall be limited on. If no priority is given this rate policy is not considering priority.
            enumeration EthSwtPortRateViolationAction: {DROP_FRAME, BLOCK_SOURCE}, multiplicity set at pre-compile, set at pre-compile, default-value=DROP_FRAME  # This parameter defines the action to be taken when the rate policy criteria defined for this EthSwtPortPolicer are met.
            integer EthSwtPortRatePolicedSmax: 0..65535, multiplicity set at pre-compile, origin=Vector Informatik, set at pre-compile, default-value=15220  # Max burst size of ingress frames | This parameter defines the maximum burst size in bytes for received frames. Its value is used to initialize the bandwidth budget on start-up. This parameter also defines the maximum bandwidth budget when no traffic associated with this entry has been received for a long time.
          container EthSwtPortPerStreamPolicer [0..*]: multiplicity set at pre-compile  # This container defines streams for policing.
            string EthSwtPortPerStreamPolicerIdentifier: multiplicity set at pre-compile, origin=Vector Informatik, set at pre-compile, default-value=00:00, max-length=5, min-length=5  # This parameter is used to identify a stream. If a destination MAC address of an Ethernet frame is accepted via EthSwtPerStreamPolicingMarker and EthSwtPerStreamPolicingMask which are used to compare the most significant four bytes of the destination MAC address, the least significant two bytes of the destination MAC address are compared with this parameter. If this matches, the stream is identified.
            integer EthSwtPortPerStreamPolicerMaximumFrameLength: 0..2043, multiplicity set at pre-compile, origin=Vector Informatik, set at pre-compile, default-value=1522  # This parameter defines the maximum frame length accepted by this stream. This includes the MAC addresses, the Ethernet type and the frame checksum (12 + 2 + 4 = 18 bytes).
            reference EthSwtPortPerStreamPolicerFifoRef: multiplicity set at pre-compile, origin=Vector Informatik, set at pre-compile, destination=EthSwtPortFifo  # This parameter defines the output gate (FIFO) of this stream.
        container EthSwtPortRgmiiConfig [0..1]: multiplicity set at pre-compile  # This container allows configuration of RGMII specific parameters.
          boolean EthSwtPortRgmiiConfigEnableTxDelay: multiplicity set at pre-compile, origin=Vector Informatik, set at pre-compile, default-value=true  # This parameter enables the RxDelay for RGMII interfaces.
          boolean EthSwtPortRgmiiConfigEnableRxDelay: multiplicity set at pre-compile, origin=Vector Informatik, set at pre-compile, default-value=false  # This parameter enables the RxDelay for RGMII interfaces.
          integer EthSwtPortRgmiiConfigRxDelay: 0..31, multiplicity set at pre-compile, origin=Vector Informatik, set at pre-compile, default-value=8  # This parameter describes the delay between clock and data lines of the RGMII interface. Please refer to the NXP SJA1105PQRS manual for configuration details. This parameter is the "delay_value".
          integer EthSwtPortRgmiiConfigTxDelay: 0..31, multiplicity set at pre-compile, origin=Vector Informatik, set at pre-compile, default-value=8  # This parameter describes the delay between clock and data lines of the RGMII interface. Please refer to the NXP SJA1105PQRS manual for configuration details. This parameter is the "delay_value".
      container EthSwtSpi [0..1]: multiplicity set at pre-compile  # Configuration of one Ethernet Switch SPI access (if SPI is used).
        container EthSwtSpiSequence [1..*]: multiplicity set at pre-compile  # Container gives EthSwt driver information about one SPI sequence. | One SPI sequence used by EthSwt driver is in exclusive use for it. No other driver is allowed to access this sequence. EthSwt driver may use one sequence to access n EthSwt hardware chips of the same type or n sequences are used to access one single EthSwt hardware chip. If a EthSwt hardware has no SPI interface, there is no instance of this container.
          boolean EthSwtSpiAccessSynchronous [0..1]: scope=ECU, multiplicity set at pre-compile, set at pre-compile, default-value=true  # Enable Synchronous SPI Access | This parameter defines if the SPI interface is accessed in a synchronous or asynchronous manner. | true: SPI access is synchronous. false: SPI access is asynchronous.
          symbolic name reference EthSwtSpiSequenceName [0..*]: scope=ECU, multiplicity set at pre-compile, set at pre-compile, destination=SpiSequence  # SPI Sequence | This reference selects the SPI sequence used to communicate with the SJA1105PQRS.
    container EthSwtGeneral: multiplicity set at pre-compile  # General configuration of Ethernet Switch Driver module.
      boolean EthSwtDevErrorDetect: multiplicity set at pre-compile, set at pre-compile, default-value=true  # Development Error Detection | This parameter switches the Development Error Detection and Notification ON or OFF. true: Development error detection is enabled. false: Development error detection is disabled.
      boolean EthSwtEnableVlanApi: multiplicity set at pre-compile, set at pre-compile, default-value=false  # Enable EnableVlan() API | This parameter enables/disables the function EthSwt_EnableVlan() to to influence the VLAN forwarding on ports during runtime.
      boolean EthSwtGetArlTableApi: multiplicity set at pre-compile, set at pre-compile, default-value=false  # Enable GetArlTable() API | This parameter enables/disables the function EthSwt_GetArlTable() to get current L2 lookup table entries.
      boolean EthSwtGetBufferLevelApi: multiplicity set at pre-compile, set at pre-compile, default-value=false  # Enable GetBufferLevel() API | This parameter enables/disables the function EthSwt_GetBufferLevel() to get current buffer level.
      boolean EthSwtGetDropCountApi: multiplicity set at pre-compile, set at pre-compile, default-value=false  # Enable GetDropCount() API | This parameter enables/disables the function EthSwt_GetDropCount() to retriev the drop counts.
      boolean EthSwtGetEtherStatsApi: multiplicity set at pre-compile, set at pre-compile, default-value=false  # Enable GetEtherStats() API | This parameter enables/disables the function EthSwt_GetEtherStats() to retrieve the Ethernet statistic counters.
      boolean EthSwtGetMacLearningModeApi: multiplicity set at pre-compile, set at pre-compile, default-value=false  # Enable GetMacLearningModel() API | This parameter enables/disables the function EthSwt_GetMacLearningMode() to get current MAC learning mode.
      boolean EthSwtGetPortMacAddrApi: multiplicity set at pre-compile, set at pre-compile, default-value=false  # Enable GetPortMacAddr() API | This parameter enables/disables the function EthSwt_GetPortMacAddress() to get the corresponding port to a MAC address.
      boolean EthSwtGetSwitchRegApi: multiplicity set at pre-compile, set at pre-compile, default-value=false  # Enable GetSwitchReg() API | This parameter enables/disables the function EthSwt_GetSwitchReg() to read switch registers.
      integer EthSwtIndex: 0..255, multiplicity set at pre-compile, set at pre-compile, default-value=0  # Index | This value specifies the index of the switch instance.
      function name EthSwtLinkDownUser [0..1]: multiplicity set at pre-compile, set at pre-compile  # Link Down Callout | This parameter defines the user name of the callout functions to be called if a link state changes (up/down) is detected during link state retrieval (EthSwt_GetLinkState()). Function prototypes: void <User>_LinkUp(uint8* SwitchIdxPtr, uint8* PortIdxPtr); void <User>_LinkDown(uint8* SwitchIdxPtr, uint8* PortIdxPtr); where <User> is the value of this parameter.
      function name EthSwtLinkUpUser [0..1]: multiplicity set at pre-compile, set at pre-compile  # Link Up Callout | This parameter defines the user name of the callout functions to be called if a link state changes (up/down) is detected during link state retrieval (EthSwt_GetLinkState()). Function prototypes: void <User>_LinkUp(uint8* SwitchIdxPtr, uint8* PortIdxPtr); void <User>_LinkDown(uint8* SwitchIdxPtr, uint8* PortIdxPtr); where <User> is the value of this parameter.
      boolean EthSwtPersistentConfigurationResult: multiplicity set at pre-compile, set at pre-compile, default-value=false  # Enable Persistent Configuration Result Callout | This parameter defines if a callout function shall be called after the asynchronous NvM job triggerd by EthSwt_StoreConfiguration() or EthSwt_ResetConfiguration() has finished. false: No user callout called. true: User callout configured by EthSwtPersistentConfigurationResultUser called.
      function name EthSwtPersistentConfigurationResultUser [0..1]: multiplicity set at pre-compile, set at pre-compile  # Persistent Configuration Result Callout | This parameter defines the user name of the callout function to be called if EthSwtPersistentConfigurationResult is enabled. Function prototype: void <User>_PersistentConfigurationResult( NvM_RequestResultType JobResult ); where <User> is the value of this parameter.
      string EthSwtPublicCddHeaderFile [0..*]: multiplicity set at pre-compile, set at pre-compile, max-length=32, min-length=1  # Header File | This parameter defines a C/C++ header file containg the declaration of the callout defined by EthSwtPersistentConfigurationResultUser or EthSwtLinkDownUser.
      boolean EthSwtReadTrcvRegisterApi: multiplicity set at pre-compile, set at pre-compile, default-value=true  # Enable ReadTrcvRegister() API | This parameter enables/disables the function EthSwt_ReadTrcvRegister() to read transceiver registers.
      boolean EthSwtResetConfigurationApi: multiplicity set at pre-compile, set at pre-compile, default-value=false  # Enable ResetConfiguration() API | This parameter enables/disables the function EthSwt_ResetConfiguration() to reset the configuration stored in NV RAM.
      boolean EthSwtSetMacLearningModeApi: multiplicity set at pre-compile, set at pre-compile, default-value=false  # Enable SetMacLearningModel() API | This parameter enables/disables the function EthSwt_SetMacLearningMode() to influenc the MAC learning mode.
      boolean EthSwtSetSwitchRegApi: multiplicity set at pre-compile, set at pre-compile, default-value=true  # Enable SetSwitchReg() API | This parameter enables/disables the function EthSwt_SetSwitchReg() to write switch registers.
      boolean EthSwtStoreConfigurationApi: multiplicity set at pre-compile, set at pre-compile, default-value=false  # Enable StoreConfiguration() API | This parameter enables/disables the function EthSwt_StoreConfiguration() to store the current learned L2 lookup table entries in NV RAM.
      boolean EthSwtVersionInfoApi: multiplicity set at pre-compile, set at pre-compile, default-value=false  # Enable GetVersionInfo() API | This parameter enables/disables the function EthSwt_GetVersionInfo() to get major, minor and patch version information.
      boolean EthSwtWriteTrcvRegisterApi: multiplicity set at pre-compile, set at pre-compile, default-value=true  # Enable WriteTrcvRegister() API | This parameter enables/disables the function EthSwt_WriteTrcvRegister() to write transceiver registers.
      float EthSwtMainFunctionPeriod: 0.001..1, multiplicity set at pre-compile, origin=Vector Informatik, set at pre-compile, default-value=0.02  # MainFunction Period | This value specifies the period the EthSwt_MainFunction() shall be called with.
      integer EthSwtSpiHwTimeout [0..1]: 1..65535, multiplicity set at pre-compile, origin=Vector Informatik, set at pre-compile, default-value=300  # SPI Hardware Timeout | This value specifies the amount of tries for SPI access that are executed until abort.
      string EthSwtUserConfigFile [0..1]: multiplicity set at pre-compile, origin=Vector Informatik, set at pre-compile  # User Config File | Reference to an external file that will be included during generation to EthSwt_Cfg.h. The content of the user configuration file will be added at the end of the generated module configuration file and allows altering or extending the generated code. Caution: User configuration files can cause the software module to malfunction and must only be used with greate care!
      integer EthSwtResetTimeout: 1..65535, multiplicity set at pre-compile, origin=Vector Informatik, set at pre-compile, default-value=50  # Device Reset Timeout | This parameter defines the maximum amount of tries the driver executes to check if the device has left the reset during intialization.
      integer EthSwtPllLockTimeout: 1..65535, multiplicity set at pre-compile, origin=Vector Informatik, set at pre-compile, default-value=50  # PLL Lock Timeout | This parameter defines the maximum amount of tries the driver executes to check if the PLL1 needed for RMII and RGMII clock generation has locked after configuration.
      enumeration EthSwtApiCallType: {ETHSWT_SYNC_CALL, ETHSWT_ASYNC_CALL}, multiplicity set at pre-compile, origin=Vector Informatik, set at pre-compile, default-value=ETHSWT_SYNC_CALL  # API Call Type | This parameter defines the calling mechanism used for selected AUTOSAR APIs. The following APIs must be called in a syncronous way according to AUTOSAR: - EthSwt_GetArlTable - EthSwt_GetDropCount - EthSwt_GetEtherStats However the APIs consume a high amount of processing time proably harming the timing restrictions for task activation of the OS. This extension allows to change the behavior of the API to just trigger the processing and get notificated if it has finished. ETHSWT_SYNC_CALL: Synchronous AUTOSAR behavior of API ETHSWT_ASYNC_CALL: Asynchronous behavior of API with finish callback
      string EthSwtAsyncNotificationUser [0..1]: multiplicity set at pre-compile, origin=Vector Informatik, set at pre-compile  # Asynchronous Notification User | This parameter defines the <User> or the asynchronous API call notification. The notification API will be expected having following name and signature: void <User>_EthSwt_AsyncCallFinishedNotification(uint8 SwitchIdx, uint8 ApiId, boolean Success);
      integer EthSwtMaxArlTableEntries [0..1]: 1..1024, multiplicity set at pre-compile, origin=Vector Informatik, set at pre-compile, default-value=1  # Maximum L2 Lookup Table Entries | This parameter defines the maximum amount of entries that can be stored to NvM during EthSwt_StoreConfiguration().
      integer EthSwtMaxParallelTsEvents: 2..100, multiplicity set at pre-compile, origin=Vector Informatik, set at pre-compile, default-value=10  # Maximum Amount of parallel Timestamping Events | This parameter defines the maximum amount of timestamping events the driver is able to process in parallel. The value is related to the amount of ports that have timestamping enabled and the period/occurence of PTP frames that are timestamped.
      float EthSwtMainFunctionTimePeriod: 0.001..1, multiplicity set at pre-compile, origin=Vector Informatik, set at pre-compile, default-value=0.001  # MainFunction Time Period | This value specifies the period the main function EthSwt_30_Sja1105PQRS_MainFunctionTime() of the driver shall be called with. The EthSwt_30_Sja1105PQRS_MainFunctionTime() handles the fetching, processing and indication of timestamps related to PTP frames.
      boolean EthSwtUpdateMCastPortAssignmentApi: multiplicity set at pre-compile, origin=Vector Informatik, set at pre-compile, default-value=false  # Enable UpdateMCastPortAssignment() API | This parameter enables/disables the function EthSwt_30_Bcm8953x_UpdateMCastPortAssignment() to active/deactivate specific multicast addresses on ports.
      integer EthSwtMaxParallelMCastPortAssignments: 1..255, multiplicity set at pre-compile, origin=Vector Informatik, set at pre-compile, default-value=5  # This parameter defines the amount of different Multicast-Addresses that can be handled by the EthSwt_UpdateMCastPortAssignment() API.
      boolean EthSwtIEEE8021QbvSupport: multiplicity set at pre-compile, origin=Vector Informatik, set at pre-compile, default-value=false  # IEEE802.1Qbv Support | This parameter enables/disables the support of IEEE802.1Qbv. IEEE802.1Qbv allows to synchronize the clocks of the Ethernet switches to a global time base and use this synchronized clock as base for the time-based scheduling of Ethernet traffic.
      boolean EthSwtWritePortMirrorConfigurationApi: set at pre-compile, multiplicity set at pre-compile, set at pre-compile, default-value=false  # Enable EthSwt_WritePortMirrorConfiguration() API | This parameter enables/disables the function EthSwt_WritePortMirrorConfiguration() to write the port mirror configuration.
      boolean EthSwtReadPortMirrorConfigurationApi: set at pre-compile, multiplicity set at pre-compile, set at pre-compile, default-value=false  # Enable EthSwt_ReadPortMirrorConfiguration() API | This parameter enables/disables the function EthSwt_ReadPortMirrorConfiguration() to read the port mirror configuration.
      boolean EthSwtGetPortMirrorStateApi: set at pre-compile, multiplicity set at pre-compile, set at pre-compile, default-value=false  # Enable EthSwt_GetPortMirrorState() API | This parameter enables/disables the function EthSwt_GetPortMirrorState() to get the port mirror status.
      boolean EthSwtSetPortMirrorStateApi: set at pre-compile, multiplicity set at pre-compile, set at pre-compile, default-value=false  # Enable EthSwt_SetPortMirrorState() API | This parameter enables/disables the function EthSwt_SetPortMirrorState() to set the port mirror status.
      boolean EthSwtDeletePortMirrorConfigurationApi: set at pre-compile, multiplicity set at pre-compile, set at pre-compile, default-value=false  # Enable EthSwt_DeletePortMirrorConfiguration() API | This parameter enables/disables the function EthSwt_DeletePortMirrorConfiguration() to set the port mirror status.
    container EthSwtCascadingMap [1..*]: multiplicity set at pre-compile  # Cascading topology configuration.
      symbolic name reference EthSwtCascadingSwitchRef: multiplicity set at pre-compile, origin=Vector Informatik, set at pre-compile, destination=EthSwtConfig  # Cascading Switch | This reference defines the switch the cascading level is assigned to.
      symbolic name reference EthSwtPortToHostRef: multiplicity set at pre-compile, origin=Vector Informatik, set at pre-compile, destination=EthSwtPort  # Port to Host-CPU | This reference defines the port that is either directly connected to the Host-CPU or to the uplink port to the next switch that is able to reach the Host-CPU.
      container EthSwtPortUplinkConfig [0..*]: multiplicity set at pre-compile  # Switch port uplink configuration. This defines which switch ports are used to connect switches with each other.
        symbolic name reference EthSwtLocalUplinkPortRef: multiplicity set at pre-compile, origin=Vector Informatik, set at pre-compile, destination=EthSwtPort  # Local Uplink Port | This reference defines the uplink port for this switch connecting to a uplink port of a remote switch.
        symbolic name reference EthSwtRemoteUplinkPortRef: multiplicity set at pre-compile, origin=Vector Informatik, set at pre-compile, destination=EthSwtPort  # Remote Uplink Port | This reference defines the uplink port of the remote switch connecting to the uplink port of this switch
  bsw implementation EthSwt_Impl: programming-language=C, sw-version=5.00.01, used-code-generator=DaVinci Configurator, vendor-id=30, ar-release-version=4.02.01, behavior=EthSwt_30_Sja1105PQRSBehavior, preconfigured-configuration=EthSwt_Pre, recommended-configuration=EthSwt_Rec, vendor-api-infix=Sja1105PQRS, vendor-specific-module-def=EthSwt
  module config EthSwt_Pre: definition=EthSwt
  module config EthSwt_Rec: definition=EthSwt
