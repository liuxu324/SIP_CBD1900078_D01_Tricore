AUTOSAR XML (schema 4-2-2)
package /AURIX2G/EcucDefs
  module definition Fls [0..*]: post-build-variant-support=true, refined-module-def=Fls, variants post-build  # Configuration of the Fls (internal or external flash driver) module.
    container FlsConfigSet  # Container for runtime configuration parameters of the flash driver.
      integer FlsAcErase: 0..4294967295, post-build-variant-value=true, set at post-build, default-value=1880101320  # Address offset in RAM to which the erase flash access code shall be loaded.
      integer FlsAcWrite: 0..4294967295, post-build-variant-value=true, set at post-build, default-value=1880101120  # Address offset in RAM to which the write flash access code shall be loaded.
      float FlsCallCycle: 1.0E-4..1.0, post-build-variant-value=true, set at post-build, default-value=0.01  # Cycle time of calls of the flash driver's main function (in seconds).
      enumeration FlsDefaultMode: {MEMIF_MODE_FAST, MEMIF_MODE_SLOW}, post-build-variant-value=true, set at post-build, default-value=MEMIF_MODE_SLOW  # This parameter is the default FLS device mode after initialization.
      function name FlsJobEndNotification [0..1]: multiplicity set at post-build, post-build-variant-multiplicity=true, post-build-variant-value=true, set at post-build, default-value=Fee_JobEndNotification  # Mapped to the job end notification routine provided by some upper layer module, typically the Fee module.
      function name FlsJobErrorNotification [0..1]: multiplicity set at post-build, post-build-variant-multiplicity=true, post-build-variant-value=true, set at post-build, default-value=Fee_JobErrorNotification  # Mapped to the job error notification routine provided by some upper layer module, typically the Fee module.
      function name FlsEraseVerifyErrNotif [0..1]: multiplicity set at post-build, origin=INFINEON_AURIX2G, set at post-build, default-value=Fee_17_JobEraseErrorNotification  # Mapped to the EVER notification routine provided by some upper layer module, typically the Fee module.
      function name FlsProgVerifyErrNotif [0..1]: multiplicity set at post-build, origin=INFINEON_AURIX2G, set at post-build, default-value=Fee_17_JobProgErrorNotification  # Mapped to the PVER notification routine provided by some upper layer module, typically the Fee module.
      integer FlsMaxReadFastMode: 1..1048576, post-build-variant-value=true, set at post-build, default-value=64  # The maximum number of bytes to read or compare in one cycle of the flash driver's job processing function in fast mode. Note: The value configured for FlsMaxReadFastMode should be more than the value configured for FlsMaxReadNormalMode
      integer FlsMaxReadNormalMode: 1..1048576, post-build-variant-value=true, set at post-build, default-value=32  # The maximum number of bytes to read or compare in one cycle of the flash driver's job processing function in normal mode.
      integer FlsMaxWriteFastMode: 32..32, post-build-variant-value=true, set at post-build, default-value=32  # The maximum number of bytes to write in one cycle of the flash driver's job processing function in fast mode.
      integer FlsMaxWriteNormalMode: 32..32, post-build-variant-value=true, set at post-build, symbolic-name-value=true, default-value=32  # The maximum number of bytes to write in one cycle of the flash driver's job processing function in normal mode.
      integer FlsProtection: 0..4294967295, post-build-variant-value=true, set at post-build, default-value=0  # Erase/write protection settings. Only relevant if supported by hardware.
      enumeration FlsWaitStateRead: {FLS_17_DMU_WAIT_STATE_READACCESS0, FLS_17_DMU_WAIT_STATE_READACCESS1, FLS_17_DMU_WAIT_STATE_READACCESS2, FLS_17_DMU_WAIT_STATE_READACCESS3, FLS_17_DMU_WAIT_STATE_READACCESS4, FLS_17_DMU_WAIT_STATE_READACCESS5, FLS_17_DMU_WAIT_STATE_READACCESS6, FLS_17_DMU_WAIT_STATE_READACCESS7, FLS_17_DMU_WAIT_STATE_READACCESS8, FLS_17_DMU_WAIT_STATE_READACCESS9, FLS_17_DMU_WAIT_STATE_READACCESS10, FLS_17_DMU_WAIT_STATE_READACCESS11, FLS_17_DMU_WAIT_STATE_READACCESS12, FLS_17_DMU_WAIT_STATE_READACCESS13, FLS_17_DMU_WAIT_STATE_READACCESS14, FLS_17_DMU_WAIT_STATE_READACCESS15, FLS_17_DMU_WAIT_STATE_READACCESS16, FLS_17_DMU_WAIT_STATE_READACCESS17, FLS_17_DMU_WAIT_STATE_READACCESS18, FLS_17_DMU_WAIT_STATE_READACCESS19, FLS_17_DMU_WAIT_STATE_READACCESS20, FLS_17_DMU_WAIT_STATE_READACCESS21, FLS_17_DMU_WAIT_STATE_READACCESS22, FLS_17_DMU_WAIT_STATE_READACCESS23, FLS_17_DMU_WAIT_STATE_READACCESS24, FLS_17_DMU_WAIT_STATE_READACCESS25, FLS_17_DMU_WAIT_STATE_READACCESS26, FLS_17_DMU_WAIT_STATE_READACCESS27, FLS_17_DMU_WAIT_STATE_READACCESS28, FLS_17_DMU_WAIT_STATE_READACCESS29, FLS_17_DMU_WAIT_STATE_READACCESS30, FLS_17_DMU_WAIT_STATE_READACCESS31, FLS_17_DMU_WAIT_STATE_READACCESS32, FLS_17_DMU_WAIT_STATE_READACCESS33, FLS_17_DMU_WAIT_STATE_READACCESS34, FLS_17_DMU_WAIT_STATE_READACCESS35, FLS_17_DMU_WAIT_STATE_READACCESS36, FLS_17_DMU_WAIT_STATE_READACCESS37, FLS_17_DMU_WAIT_STATE_READACCESS38, FLS_17_DMU_WAIT_STATE_READACCESS39, FLS_17_DMU_WAIT_STATE_READACCESS40, FLS_17_DMU_WAIT_STATE_READACCESS41, FLS_17_DMU_WAIT_STATE_READACCESS42, FLS_17_DMU_WAIT_STATE_READACCESS43, FLS_17_DMU_WAIT_STATE_READACCESS44, FLS_17_DMU_WAIT_STATE_READACCESS45, FLS_17_DMU_WAIT_STATE_READACCESS46, FLS_17_DMU_WAIT_STATE_READACCESS47, FLS_17_DMU_WAIT_STATE_READACCESS48, FLS_17_DMU_WAIT_STATE_READACCESS49, FLS_17_DMU_WAIT_STATE_READACCESS50, FLS_17_DMU_WAIT_STATE_READACCESS51, FLS_17_DMU_WAIT_STATE_READACCESS52, FLS_17_DMU_WAIT_STATE_READACCESS53, FLS_17_DMU_WAIT_STATE_READACCESS54, FLS_17_DMU_WAIT_STATE_READACCESS55, FLS_17_DMU_WAIT_STATE_READACCESS56, FLS_17_DMU_WAIT_STATE_READACCESS57, FLS_17_DMU_WAIT_STATE_READACCESS58, FLS_17_DMU_WAIT_STATE_READACCESS59, FLS_17_DMU_WAIT_STATE_READACCESS60, FLS_17_DMU_WAIT_STATE_READACCESS61, FLS_17_DMU_WAIT_STATE_READACCESS62, FLS_17_DMU_WAIT_STATE_READACCESS63, FLS_17_DMU_WAIT_STATE_READACCESS64, FLS_17_DMU_WAIT_STATE_READACCESS65, FLS_17_DMU_WAIT_STATE_READACCESS66, FLS_17_DMU_WAIT_STATE_READACCESS67, FLS_17_DMU_WAIT_STATE_READACCESS68, FLS_17_DMU_WAIT_STATE_READACCESS69, FLS_17_DMU_WAIT_STATE_READACCESS70, FLS_17_DMU_WAIT_STATE_READACCESS71, FLS_17_DMU_WAIT_STATE_READACCESS72, FLS_17_DMU_WAIT_STATE_READACCESS73, FLS_17_DMU_WAIT_STATE_READACCESS74, FLS_17_DMU_WAIT_STATE_READACCESS75, FLS_17_DMU_WAIT_STATE_READACCESS76, FLS_17_DMU_WAIT_STATE_READACCESS77, FLS_17_DMU_WAIT_STATE_READACCESS78, FLS_17_DMU_WAIT_STATE_READACCESS79, FLS_17_DMU_WAIT_STATE_READACCESS80, FLS_17_DMU_WAIT_STATE_READACCESS81, FLS_17_DMU_WAIT_STATE_READACCESS82, FLS_17_DMU_WAIT_STATE_READACCESS83, FLS_17_DMU_WAIT_STATE_READACCESS84, FLS_17_DMU_WAIT_STATE_READACCESS85, FLS_17_DMU_WAIT_STATE_READACCESS86, FLS_17_DMU_WAIT_STATE_READACCESS87, FLS_17_DMU_WAIT_STATE_READACCESS88, FLS_17_DMU_WAIT_STATE_READACCESS89, FLS_17_DMU_WAIT_STATE_READACCESS90, FLS_17_DMU_WAIT_STATE_READACCESS91, FLS_17_DMU_WAIT_STATE_READACCESS92, FLS_17_DMU_WAIT_STATE_READACCESS93, FLS_17_DMU_WAIT_STATE_READACCESS94, FLS_17_DMU_WAIT_STATE_READACCESS95, FLS_17_DMU_WAIT_STATE_READACCESS96, FLS_17_DMU_WAIT_STATE_READACCESS97, FLS_17_DMU_WAIT_STATE_READACCESS98, FLS_17_DMU_WAIT_STATE_READACCESS99, FLS_17_DMU_WAIT_STATE_READACCESS100, FLS_17_DMU_WAIT_STATE_READACCESS101, FLS_17_DMU_WAIT_STATE_READACCESS102, FLS_17_DMU_WAIT_STATE_READACCESS103, FLS_17_DMU_WAIT_STATE_READACCESS104, FLS_17_DMU_WAIT_STATE_READACCESS105, FLS_17_DMU_WAIT_STATE_READACCESS106, FLS_17_DMU_WAIT_STATE_READACCESS107, FLS_17_DMU_WAIT_STATE_READACCESS108, FLS_17_DMU_WAIT_STATE_READACCESS109, FLS_17_DMU_WAIT_STATE_READACCESS110, FLS_17_DMU_WAIT_STATE_READACCESS111, FLS_17_DMU_WAIT_STATE_READACCESS112, FLS_17_DMU_WAIT_STATE_READACCESS113, FLS_17_DMU_WAIT_STATE_READACCESS114, FLS_17_DMU_WAIT_STATE_READACCESS115, FLS_17_DMU_WAIT_STATE_READACCESS116, FLS_17_DMU_WAIT_STATE_READACCESS117, FLS_17_DMU_WAIT_STATE_READACCESS118, FLS_17_DMU_WAIT_STATE_READACCESS119, FLS_17_DMU_WAIT_STATE_READACCESS120, FLS_17_DMU_WAIT_STATE_READACCESS121, FLS_17_DMU_WAIT_STATE_READACCESS122, FLS_17_DMU_WAIT_STATE_READACCESS123, FLS_17_DMU_WAIT_STATE_READACCESS124, FLS_17_DMU_WAIT_STATE_READACCESS125, FLS_17_DMU_WAIT_STATE_READACCESS126, FLS_17_DMU_WAIT_STATE_READACCESS127, FLS_17_DMU_WAIT_STATE_READACCESS128, FLS_17_DMU_WAIT_STATE_READACCESS129, FLS_17_DMU_WAIT_STATE_READACCESS130, FLS_17_DMU_WAIT_STATE_READACCESS131, FLS_17_DMU_WAIT_STATE_READACCESS132, FLS_17_DMU_WAIT_STATE_READACCESS133, FLS_17_DMU_WAIT_STATE_READACCESS134, FLS_17_DMU_WAIT_STATE_READACCESS135, FLS_17_DMU_WAIT_STATE_READACCESS136, FLS_17_DMU_WAIT_STATE_READACCESS137, FLS_17_DMU_WAIT_STATE_READACCESS138, FLS_17_DMU_WAIT_STATE_READACCESS139, FLS_17_DMU_WAIT_STATE_READACCESS140, FLS_17_DMU_WAIT_STATE_READACCESS141, FLS_17_DMU_WAIT_STATE_READACCESS142, FLS_17_DMU_WAIT_STATE_READACCESS143, FLS_17_DMU_WAIT_STATE_READACCESS144, FLS_17_DMU_WAIT_STATE_READACCESS145, FLS_17_DMU_WAIT_STATE_READACCESS146, FLS_17_DMU_WAIT_STATE_READACCESS147, FLS_17_DMU_WAIT_STATE_READACCESS148, FLS_17_DMU_WAIT_STATE_READACCESS149, FLS_17_DMU_WAIT_STATE_READACCESS150, FLS_17_DMU_WAIT_STATE_READACCESS151, FLS_17_DMU_WAIT_STATE_READACCESS152, FLS_17_DMU_WAIT_STATE_READACCESS153, FLS_17_DMU_WAIT_STATE_READACCESS154, FLS_17_DMU_WAIT_STATE_READACCESS155, FLS_17_DMU_WAIT_STATE_READACCESS156, FLS_17_DMU_WAIT_STATE_READACCESS157, FLS_17_DMU_WAIT_STATE_READACCESS158, FLS_17_DMU_WAIT_STATE_READACCESS159, FLS_17_DMU_WAIT_STATE_READACCESS160, FLS_17_DMU_WAIT_STATE_READACCESS161, FLS_17_DMU_WAIT_STATE_READACCESS162, FLS_17_DMU_WAIT_STATE_READACCESS163, FLS_17_DMU_WAIT_STATE_READACCESS164, FLS_17_DMU_WAIT_STATE_READACCESS165, FLS_17_DMU_WAIT_STATE_READACCESS166, FLS_17_DMU_WAIT_STATE_READACCESS167, FLS_17_DMU_WAIT_STATE_READACCESS168, FLS_17_DMU_WAIT_STATE_READACCESS169, FLS_17_DMU_WAIT_STATE_READACCESS170, FLS_17_DMU_WAIT_STATE_READACCESS171, FLS_17_DMU_WAIT_STATE_READACCESS172, FLS_17_DMU_WAIT_STATE_READACCESS173, FLS_17_DMU_WAIT_STATE_READACCESS174, FLS_17_DMU_WAIT_STATE_READACCESS175, FLS_17_DMU_WAIT_STATE_READACCESS176, FLS_17_DMU_WAIT_STATE_READACCESS177, FLS_17_DMU_WAIT_STATE_READACCESS178, FLS_17_DMU_WAIT_STATE_READACCESS179, FLS_17_DMU_WAIT_STATE_READACCESS180, FLS_17_DMU_WAIT_STATE_READACCESS181, FLS_17_DMU_WAIT_STATE_READACCESS182, FLS_17_DMU_WAIT_STATE_READACCESS183, FLS_17_DMU_WAIT_STATE_READACCESS184, FLS_17_DMU_WAIT_STATE_READACCESS185, FLS_17_DMU_WAIT_STATE_READACCESS186, FLS_17_DMU_WAIT_STATE_READACCESS187, FLS_17_DMU_WAIT_STATE_READACCESS188, FLS_17_DMU_WAIT_STATE_READACCESS189, FLS_17_DMU_WAIT_STATE_READACCESS190, FLS_17_DMU_WAIT_STATE_READACCESS191, FLS_17_DMU_WAIT_STATE_READACCESS192, FLS_17_DMU_WAIT_STATE_READACCESS193, FLS_17_DMU_WAIT_STATE_READACCESS194, FLS_17_DMU_WAIT_STATE_READACCESS195, FLS_17_DMU_WAIT_STATE_READACCESS196, FLS_17_DMU_WAIT_STATE_READACCESS197, FLS_17_DMU_WAIT_STATE_READACCESS198, FLS_17_DMU_WAIT_STATE_READACCESS199, FLS_17_DMU_WAIT_STATE_READACCESS200, FLS_17_DMU_WAIT_STATE_READACCESS201, FLS_17_DMU_WAIT_STATE_READACCESS202, FLS_17_DMU_WAIT_STATE_READACCESS203, FLS_17_DMU_WAIT_STATE_READACCESS204, FLS_17_DMU_WAIT_STATE_READACCESS205, FLS_17_DMU_WAIT_STATE_READACCESS206, FLS_17_DMU_WAIT_STATE_READACCESS207, FLS_17_DMU_WAIT_STATE_READACCESS208, FLS_17_DMU_WAIT_STATE_READACCESS209, FLS_17_DMU_WAIT_STATE_READACCESS210, FLS_17_DMU_WAIT_STATE_READACCESS211, FLS_17_DMU_WAIT_STATE_READACCESS212, FLS_17_DMU_WAIT_STATE_READACCESS213, FLS_17_DMU_WAIT_STATE_READACCESS214, FLS_17_DMU_WAIT_STATE_READACCESS215, FLS_17_DMU_WAIT_STATE_READACCESS216, FLS_17_DMU_WAIT_STATE_READACCESS217, FLS_17_DMU_WAIT_STATE_READACCESS218, FLS_17_DMU_WAIT_STATE_READACCESS219, FLS_17_DMU_WAIT_STATE_READACCESS220, FLS_17_DMU_WAIT_STATE_READACCESS221, FLS_17_DMU_WAIT_STATE_READACCESS222, FLS_17_DMU_WAIT_STATE_READACCESS223, FLS_17_DMU_WAIT_STATE_READACCESS224, FLS_17_DMU_WAIT_STATE_READACCESS225, FLS_17_DMU_WAIT_STATE_READACCESS226, FLS_17_DMU_WAIT_STATE_READACCESS227, FLS_17_DMU_WAIT_STATE_READACCESS228, FLS_17_DMU_WAIT_STATE_READACCESS229, FLS_17_DMU_WAIT_STATE_READACCESS230, FLS_17_DMU_WAIT_STATE_READACCESS231, FLS_17_DMU_WAIT_STATE_READACCESS232, FLS_17_DMU_WAIT_STATE_READACCESS233, FLS_17_DMU_WAIT_STATE_READACCESS234, FLS_17_DMU_WAIT_STATE_READACCESS235, FLS_17_DMU_WAIT_STATE_READACCESS236, FLS_17_DMU_WAIT_STATE_READACCESS237, FLS_17_DMU_WAIT_STATE_READACCESS238, FLS_17_DMU_WAIT_STATE_READACCESS239, FLS_17_DMU_WAIT_STATE_READACCESS240, FLS_17_DMU_WAIT_STATE_READACCESS241, FLS_17_DMU_WAIT_STATE_READACCESS242, FLS_17_DMU_WAIT_STATE_READACCESS243, FLS_17_DMU_WAIT_STATE_READACCESS244, FLS_17_DMU_WAIT_STATE_READACCESS245, FLS_17_DMU_WAIT_STATE_READACCESS246, FLS_17_DMU_WAIT_STATE_READACCESS247, FLS_17_DMU_WAIT_STATE_READACCESS248, FLS_17_DMU_WAIT_STATE_READACCESS249, FLS_17_DMU_WAIT_STATE_READACCESS250, FLS_17_DMU_WAIT_STATE_READACCESS251, FLS_17_DMU_WAIT_STATE_READACCESS252, FLS_17_DMU_WAIT_STATE_READACCESS253, FLS_17_DMU_WAIT_STATE_READACCESS254, FLS_17_DMU_WAIT_STATE_READACCESS255}, origin=INFINEON_AURIX2G, post-build-variant-value=true, set at post-build, default-value=FLS_17_DMU_WAIT_STATE_READACCESS9  # Defines Wait State Configuration for read access from DFLASH.
      enumeration FlsWaitStateErrorCorrection: {FLS_17_DMU_WAIT_STATE_ERRORCORRECTION0, FLS_17_DMU_WAIT_STATE_ERRORCORRECTION1, FLS_17_DMU_WAIT_STATE_ERRORCORRECTION2, FLS_17_DMU_WAIT_STATE_ERRORCORRECTION3, FLS_17_DMU_WAIT_STATE_ERRORCORRECTION4, FLS_17_DMU_WAIT_STATE_ERRORCORRECTION5, FLS_17_DMU_WAIT_STATE_ERRORCORRECTION6, FLS_17_DMU_WAIT_STATE_ERRORCORRECTION7}, origin=INFINEON_AURIX2G, post-build-variant-value=true, set at post-build, default-value=FLS_17_DMU_WAIT_STATE_ERRORCORRECTION1  # Defines Wait State Configuration for error correction
      container FlsDemEventParameterRefs [0..1]: multiplicity set at post-build  # Container for the references to DemEventParameter elements which shall be invoked using the Dem_ReportErrorStatus API in case the corresponding error occurs. The EventId is taken from the referenced DemEventParameter's DemEventId value. The standardized errors are provided in the container and can be extended by vendor specific error references. Tags: atp.Status=obsolete, atp.StatusComment=This container is set to obsolete and will be removed in release 4.3., atp.StatusRevisionBegin=4.2.2
        symbolic name reference FLS_E_COMPARE_FAILED [0..1]: multiplicity set at post-build, post-build-variant-multiplicity=true, post-build-variant-value=true, set at post-build, destination=DemEventParameter  # Reference to the DemEventParameter which shall be issued when the error "Flash compare failed (HW)" has occurred. Tags: atp.Status=obsolete, atp.StatusComment=This reference is set to obsolete and will be removed in release 4.3., atp.StatusRevisionBegin=4.2.2
        symbolic name reference FLS_E_ERASE_FAILED [0..1]: multiplicity set at post-build, post-build-variant-multiplicity=true, post-build-variant-value=true, set at post-build, destination=DemEventParameter  # Reference to the DemEventParameter which shall be issued when the error "Flash erase failed (HW)" has occurred. Tags: atp.Status=obsolete, atp.StatusComment=This reference is set to obsolete and will be removed in release 4.3., atp.StatusRevisionBegin=4.2.2
        symbolic name reference FLS_E_READ_FAILED [0..1]: multiplicity set at post-build, post-build-variant-multiplicity=true, post-build-variant-value=true, set at post-build, destination=DemEventParameter  # Reference to the DemEventParameter which shall be issued when the error "Flash read failed (HW)" has occurred. Tags: atp.Status=obsolete, atp.StatusComment=This reference is set to obsolete and will be removed in release 4.3., atp.StatusRevisionBegin=4.2.2
        symbolic name reference FLS_E_UNEXPECTED_FLASH_ID [0..1]: multiplicity set at post-build, post-build-variant-multiplicity=true, post-build-variant-value=true, set at post-build, destination=DemEventParameter  # Reference to the DemEventParameter which shall be issued when the error "Expected hardware ID not matched" has occurred. Tags: atp.Status=obsolete, atp.StatusComment=This reference is set to obsolete and will be removed in release 4.3., atp.StatusRevisionBegin=4.2.2
        symbolic name reference FLS_E_WRITE_FAILED [0..1]: multiplicity set at post-build, post-build-variant-multiplicity=true, post-build-variant-value=true, set at post-build, destination=DemEventParameter  # Reference to the DemEventParameter which shall be issued when the error "Flash write failed (HW)" has occurred. Tags: atp.Status=obsolete, atp.StatusComment=This reference is set to obsolete and will be removed in release 4.3., atp.StatusRevisionBegin=4.2.2
      container FlsExternalDriver [0..1]: multiplicity set at pre-compile  # This container is present for external Flash drivers only. Internal Flash drivers do not use the parameter listed in this container, hence its multiplicity is 0 for internal drivers.
        symbolic name reference FlsSpiReference [1..*]: multiplicity set at pre-compile, set at pre-compile, destination=SpiSequence  # Reference to SPI sequence (required for external Flash drivers).
      container FlsSectorList  # List of flashable sectors and pages.
        container FlsSector [1..*]: multiplicity set at pre-compile  # Configuration description of a flashable sector
          integer FlsNumberOfSectors: 1..2, set at pre-compile, default-value=2  # Number of continuous sectors with identical values for FlsSectorSize and
          integer FlsPageSize: 8..8, set at pre-compile, default-value=8  # Size of one page of this sector.
          integer FlsSectorSize: 4096..1048576, set at pre-compile, default-value=524288  # Size of this sector.
          integer FlsSectorStartaddress: 0..1048575, set at pre-compile, default-value=0  # Start address of this sector.
    container FlsGeneral  # Container for general parameters of the flash driver. These parameters are always pre-compile.
      boolean FlsAcLoadOnJobStart: set at pre-compile, default-value=false  # The flash driver shall load the flash access code to RAM whenever an erase or write job is started and unload (overwrite) it after that job has been finished or canceled.
      integer FlsBaseAddress: 2936012800..2936012800, set at pre-compile, default-value=2936012800  # The flash memory start address (see also SWS_Fls_00208 and SWS_Fls_00209).
      boolean FlsBlankCheckApi: set at pre-compile, default-value=false  # Compile switch to enable/disable the Fls_BlankCheck function.
      boolean FlsInitCheckApi: origin=INFINEON_AURIX2G, set at pre-compile, default-value=false  # Adds / removes the service Fls_17_Dmu_InitCheck() from the code. true: Fls_17_Dmu_InitCheck() can be used. false: Fls_17_Dmu_InitCheck() can not be used.
      boolean FlsCancelApi: set at pre-compile, default-value=false  # Compile switch to enable and disable the Fls_Cancel function.
      boolean FlsCompareApi: set at pre-compile, default-value=false  # Compile switch to enable and disable the Fls_Compare function.
      boolean FlsDevErrorDetect: set at pre-compile, default-value=true  # Switches the Default Error Tracer (Det) detection and notification ON or OFF.
      boolean FlsRunTimeErrorDetect: origin=INFINEON_AURIX2G, set at pre-compile, default-value=true  # Switches the Runtime Error Tracer detection and notification ON or OFF.
      boolean FlsSafetyEnable: origin=INFINEON_AURIX2G, set at pre-compile, default-value=false  # Switch to enable/disable the Safety Error.
      boolean FlsIfxFeeUse: origin=INFINEON_AURIX2G, set at pre-compile, default-value=true  # Enables/Disables the use of IFX FEE functions.
      integer FlsDriverIndex: 0..254, scope=ECU, set at pre-compile, symbolic-name-value=true, default-value=0  # Index of the driver, used by FEE.
      boolean FlsGetJobResultApi: set at pre-compile, default-value=false  # Compile switch to enable and disable the Fls_GetJobResult function.
      boolean FlsGetStatusApi: set at pre-compile, default-value=false  # Compile switch to enable and disable the Fls_GetStatus function.
      boolean FlsSetModeApi: set at pre-compile, default-value=false  # Compile switch to enable and disable the Fls_SetMode function.
      integer FlsTotalSize: 4096..1048576, set at pre-compile, default-value=1048576  # The total amount of flash memory in bytes (see also SWS_Fls_00208 and SWS_Fls_00209).
      boolean FlsUseInterrupts: set at pre-compile, default-value=false  # Job processing triggered by hardware interrupt.
      boolean FlsVersionInfoApi: set at pre-compile, default-value=false  # Pre-processor switch to enable / disable the API to read out the modules version information.
      enumeration FlsInitApiMode: {FLS_17_DMU_MCAL_SUPERVISOR, FLS_17_DMU_MCAL_USER1}, origin=INFINEON_AURIX2G, set at pre-compile, default-value=FLS_17_DMU_MCAL_SUPERVISOR  # This parameter selects the operating modes for FlexRay initialization
      enumeration FlsRuntimeApiMode: {FLS_17_DMU_MCAL_SUPERVISOR, FLS_17_DMU_MCAL_USER1}, origin=INFINEON_AURIX2G, set at pre-compile, default-value=FLS_17_DMU_MCAL_SUPERVISOR  # This parameter selects the operating modes for FlexRay initialization
    container FlsPublishedInformation  # Additional published parameters not covered by CommonPublishedInformation container.
      integer FlsAcLocationErase: 0..4294967295, set at published-information, default-value=0  # Position in RAM, to which the erase flash access code has to be loaded.
      integer FlsAcLocationWrite: 0..4294967295, set at published-information, default-value=0  # Position in RAM, to which the write flash access code has to be loaded.
      integer FlsAcSizeErase: 0..4294967295, set at published-information, default-value=200  # Number of bytes in RAM needed for the erase flash access code.
      integer FlsAcSizeWrite: 0..4294967295, set at published-information, default-value=200  # Number of bytes in RAM needed for the write flash access code.
      float FlsEraseTime: 0.0..4.294967295E9, set at published-information, default-value=1500000  # Maximum time to erase one complete flash sector.
      integer FlsErasedValue: 0..4294967295, set at published-information, default-value=0  # The contents of an erased flash memory cell.
      string FlsExpectedHwId: set at published-information, default-value=0  # Unique identifier of the hardware device that is expected by this driver (the device for which this driver has been implemented).
      integer FlsSpecifiedEraseCycles: 0..4294967295, set at published-information, default-value=125000  # Number of erase cycles specified for the flash device (usually given in the device data sheet).
      float FlsWriteTime: 0.0..4.294967295E9, set at published-information, default-value=140  # Maximum time to program one complete flash page.
    container FlsIfxSpecificConfig  # This container is used to provide the Ifx specific parameters.
      string FlsStateVarStruct: origin=INFINEON_AURIX2G, set at post-build, default-value=FlsStateVar  # This parameter is used to provide the name of the structure containing the entire global variables specific to the Flash driver.
      boolean FlsUseEraseSuspend: origin=INFINEON_AURIX2G, set at pre-compile, default-value=false  # Compile switch to enable or disable the FLS erase suspend and erase resume feature
      integer FlsEraseSuspendTimeout: 0..65535, origin=INFINEON_AURIX2G, set at pre-compile, default-value=6000  # Timeout for Erase Suspend feature(loop count).
      function name FlsIllegalStateNotification: origin=INFINEON_AURIX2G, set at pre-compile, default-value=NULL_PTR  # This parameter is a pointer to a notification function, which is called when FLS reaches an Illegal state. Illegal state here means that FLS is not able to proceed. No more FLS request shall be triggered; Reset of the system is recommended.
    container CommonPublishedInformation  # Common container, aggregated by all modules. It contains published information about vendor and versions.
      integer ArMajorVersion: 0..65535, origin=INFINEON_AURIX2G, set at published-information, default-value=4  # Major version number of AUTOSAR specification on which the appropriate implementation is based on.
      integer ArMinorVersion: 0..65535, origin=INFINEON_AURIX2G, set at published-information, default-value=2  # Minor version number of AUTOSAR specification on which the appropriate implementation is based on.
      integer ArPatchVersion: 0..65535, origin=INFINEON_AURIX2G, set at published-information, default-value=2  # Patch level version number of AUTOSAR specification on which the appropriate implementation is based on.
      integer SwMajorVersion: 0..65535, origin=INFINEON_AURIX2G, set at published-information, default-value=3  # Major version number of the vendor specific implementation of the module. The numbering is vendor specific.
      integer SwMinorVersion: 0..65535, origin=INFINEON_AURIX2G, set at published-information, default-value=0  # Minor version number of the vendor specific implementation of the module. The numbering is vendor specific.
      integer SwPatchVersion: 0..65535, origin=INFINEON_AURIX2G, set at published-information, default-value=0  # Patch level version number of the vendor specific implementation of the module. The numbering is vendor specific.
      integer ModuleId: 0..65535, origin=INFINEON_AURIX2G, set at published-information, default-value=92  # Module ID of this module from Module List
      integer VendorId: 0..65535, origin=INFINEON_AURIX2G, set at published-information, default-value=17  # Vendor ID of the dedicated implementation of this module according to the AUTOSAR vendor list
      string VendorApiInfix: origin=INFINEON_AURIX2G, set at published-information, default-value=Dmu  # In driver modules which can be instantiated several times on a single ECU, BSW00347 requires that the name of APIs is extended by the VendorId and a vendor specific name. This parameter is used to specify the vendor specific name. In total, the implementation specific name is generated as follows: <ModuleName>_>VendorId>_<VendorApiInfix><Api name from SWS>
      string Release: origin=INFINEON_AURIX2G, set at published-information, default-value=_TRICORE_TC397  # Aurix2G derivative used for the implementation
