AUTOSAR XML (schema 4-2-2)
package /AURIX2G/EcucDefs
  module config Mcu_Rec: definition=Mcu
  bsw implementation Mcu_Impl: programming-language=C, behavior=McuBehavior, recommended-configuration=Mcu_Rec, vendor-specific-module-def=Mcu
