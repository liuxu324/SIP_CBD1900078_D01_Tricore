AUTOSAR XML (schema 4-2-2)
package /AURIX2G/EcucDefs
  module definition Mcu [0..1]: post-build-variant-support=true, refined-module-def=Mcu, variants post-build  # Configuration of the Mcu (Microcontroller Unit) module.
    container McuGeneralConfiguration  # This container contains the configuration (parameters) of the MCU driver.
      boolean McuDevErrorDetect: set at pre-compile, default-value=true  # Switches the Default Error Tracer (Det) detection and notification ON or OFF.
      boolean McuMultiCoreErrorDetect: origin=INFINEON_AURIX2G, set at pre-compile, default-value=true  # Switches the Multicore Error detection and notification ON or OFF.
      boolean McuGetRamStateApi: set at pre-compile, default-value=false  # Pre-processor switch to enable/disable the API Mcu_GetRamState. This Api is not supported, therefore this parameter is always false. TRUE : The function Mcu_GetRamState() is enabled. FALSE: The function Mcu_GetRamState() is disabled.
      boolean McuInitClock: set at pre-compile, default-value=true  # If this parameter is set to FALSE, the clock initialization has to be disabled from the MCU driver. This concept applies when there are some write once clock registers and a bootloader is present. If this parameter is set to TRUE, the MCU driver is responsible of the clock initialization. TRUE : Mcu_InitClock API is available. FALSE: Mcu_InitClock API is not available.
      boolean McuNoPll: set at pre-compile, default-value=false  # This parameter is set True, if the H/W does not have a PLL or the PLL circuitry is enabled after the power on without S/W intervention. In this case MCU_DistributePllClock API is disabled and MCU_GetPllStatus returns MCU_PLL_STATUS_UNDEFINED. Otherwise, this parameters has to be set False TRUE : Mcu is not responsible for PLL related setup. FALSE: Mcu is responsible to setup PLLs.
      boolean McuPerformResetApi: set at pre-compile, default-value=false  # Pre-processor switch to enable / disable the use of the function Mcu_PerformReset() TRUE : The function Mcu_PerformReset() is available FALSE: The function Mcu_PerformReset() not is available
      boolean McuVersionInfoApi: set at pre-compile, default-value=false  # Pre-processor switch to enable / disable the API to read out the modules version information. TRUE : Mcu_GetVersionInfo() API is enabled FALSE: Mcu_GetVersionInfo() API is disabled
      boolean McuClearColdResetStatusApi: origin=INFINEON_AURIX2G, set at pre-compile, default-value=false  # Pre-processor switch to enable/disable the API Mcu_ClearColdResetStatus. TRUE : Enables Mcu_ClearColdResetStatus API. FALSE: Disables Mcu_ClearColdResetStatus API.
      boolean McuGtmSleepModeEnabled: origin=INFINEON_AURIX2G, post-build-variant-value=true, set at post-build, default-value=false  # This parameter specifies if GTM peripheral goes into sleep mode when complete system is put into sleep mode. TRUE : Enables sleep mode for GTM peripheral FALSE: Disables sleep mode for GTM peripheral.
      boolean McuIfxLpmApi: origin=INFINEON_AURIX2G, set at pre-compile, default-value=false  # This parameter Enables/Disables availability of low power mode APIs defined by IFX namely Mcu_GetCpuIdleModeInitiator, Mcu_GetCpuState, Mcu_GetWakeupCause and Mcu_ClearWakeupCause..
      boolean McuIfxTrapApi: origin=INFINEON_AURIX2G, set at pre-compile, default-value=false  # This parameter Enables/Disables availability of trap related APIs defined by IFX namely Mcu_GetTrapCause, Mcu_SetTrapRequest and Mcu_ClearTrapRequest..
      boolean McuIfxCpuCcuconApi: origin=INFINEON_AURIX2G, set at pre-compile, default-value=false  # This parameter Enables/Disables availability of Cpu Ccucon register update API defined by IFX namely Mcu_UpdateCpuCcuconReg.
      boolean McuIfxDeInitApi: origin=INFINEON_AURIX2G, set at pre-compile, default-value=false  # This parameter Enables/Disables availability of Mcu Deinitialization API - Mcu_DeInit.
      boolean McuClockSourceFailureNotification: origin=INFINEON_AURIX2G, set at pre-compile, default-value=false  # This parameter availibility of Clock failure related DEMs notification function. ENABLED Clock failure related DEMs are reported DISABLED Clock failure related DEMs are not reported
      boolean McuSafetyEnable: origin=INFINEON_AURIX2G, set at pre-compile, default-value=true  # Enables/Disables safety checks and features of MCU driver
      boolean McuInitCheckApi: origin=INFINEON_AURIX2G, set at pre-compile, default-value=false  # Enables/Disables availability of Mcu_InitCheck API. Currently this parameter is disabled since Mcu_InitCheck API is not supported.
      integer McuMainOscillatorFrequency: 4..40, origin=INFINEON_AURIX2G, set at pre-compile, default-value=20  # This parameter defines External crystal frequency value in MHz
      enumeration McuSystemModeCpuCore: {CPU_SYSTEM_CORE0_SEL0, CPU_SYSTEM_CORE1_SEL1, CPU_SYSTEM_CORE2_SEL2, CPU_SYSTEM_CORE3_SEL3, CPU_SYSTEM_CORE4_SEL4, CPU_SYSTEM_CORE5_SEL5, UNANIMOUS_SYSTEM_ALL_CORES_SEL6}, origin=INFINEON_AURIX2G, set at pre-compile, default-value=CPU_SYSTEM_CORE0_SEL0  # This parameter defines core responsible to trigger system modes (sleep / standby).
      enumeration McuIdleModeCpuCore: {INDIVIDUAL_IDLE_CORES_SEL0, CPU_IDLE_CORE0_SEL1, CPU_IDLE_CORE1_SEL2, CPU_IDLE_CORE2_SEL3, CPU_IDLE_CORE3_SEL4, CPU_IDLE_CORE4_SEL5, CPU_IDLE_CORE5_SEL6}, origin=INFINEON_AURIX2G, set at pre-compile, default-value=INDIVIDUAL_IDLE_CORES_SEL0  # This parameter defines core responsible to trigger idle mode.
      enumeration McuStandbyEntryMode: {STANDBY_ENTRY_REQ_SLEEP_SEL0, STANDBY_ENTRY_ESR_SEL4}, origin=INFINEON_AURIX2G, set at pre-compile, default-value=STANDBY_ENTRY_REQ_SLEEP_SEL0  # This parameter will define standby mode entry criteria. STANDBY_ENTRY_REQ_SLEEP_SEL0: Entry to standby domain is through PMSWCR1.STBYEV. STANDBY_ENTRY_ESR_SEL4: Entry to standby mode domain is through ESR1/NMI assertion.
      enumeration McuOscillatorMode: {EXT_CRYSTAL_CERAMIC_RES_MODE_SEL0, EXT_INPUT_CLOCK_MODE_SEL2, OSC_DISABLED_MODE_SEL3}, origin=INFINEON_AURIX2G, set at pre-compile, default-value=EXT_CRYSTAL_CERAMIC_RES_MODE_SEL0  # This parameter selects ocillator mode. EXT_CRYSTAL_CERAMIC_RES_MODE_SEL0: External Crystal or Ceramic resonator mode is selected. EXT_INPUT_CLOCK_MODE_SEL2: External input clock source mode is selected. OSC_DISABLED_MODE_SEL3: Oscillator is disabled.
      enumeration McuInitDeInitApiMode: {MCU_MCAL_SUPERVISOR, MCU_MCAL_USER1}, origin=INFINEON_AURIX2G, set at pre-compile, default-value=MCU_MCAL_SUPERVISOR  # This parameter selects the operating modes for MCU initialization, de-initialization APIs
      enumeration McuRuntimeApiMode: {MCU_MCAL_SUPERVISOR, MCU_MCAL_USER1}, origin=INFINEON_AURIX2G, set at pre-compile, default-value=MCU_MCAL_SUPERVISOR  # This parameter selects the operating modes for MCU runtime APIs
    container McuModuleConfiguration  # This container contains the configuration (parameters) of the MCU driver
      enumeration McuClockSrcFailureNotification: {DISABLED, ENABLED}, set at pre-compile, default-value=DISABLED  # Enables/Disables clock failure notification. In case this feature is not supported by HW the setting should be disabled.
      integer McuNumberOfMcuModes: 1..255, set at pre-compile, derivation=informal-formula=verbatim=l-5=Number of configured McuModeSettingConf, default-value=1  # This parameter shall represent the number of Modes available for the MCU. This parameter is disabled and is included here for completeness. calculation Formula = Number of configured McuModeSettingConf. Press the Calculate button beside the parameter to automatically update the field. This parameter doesn't have any influence on the generated code file
      integer McuRamSectors: 0..4294967295, set at pre-compile, derivation=informal-formula=verbatim=l-5=number of configured McuRamSectorSettingConf, default-value=0  # This parameter shall represent the number of RAM sectors configured for initialization for the MCU. This parameter is disabled and is included here for completeness. calculation Formula = Number of configured McuRamSectorSettingConf. Press the Calculate button beside the parameter to automatically update the field. This parameter doesn't have any influence on the generated code file
      integer McuResetSetting [0..1]: 1..255, multiplicity set at pre-compile, set at pre-compile, default-value=1  # This parameter relates to the MCU specific reset configuration. This applies to the function Mcu_PerformReset, which performs a microcontroller reset using the hardware feature of the microcontroller. This parameter is disabled and is included here for completeness.
      container McuResetSettingConf  # This container contains the configuration (parameters) of the reset settings
        enumeration McuESR0ResetConf: {MCU_ESR0_NO_RESET_SEL0, MCU_ESR0_SYSTEM_RESET_SEL1, MCU_ESR0_APPLICATION_RESET_SEL2}, origin=INFINEON_AURIX2G, post-build-variant-value=true, set at post-build, default-value=MCU_ESR0_NO_RESET_SEL0  # This parameter defines the response of ESR0 reset request. MCU_ESR0_NO_RESET_SEL0 : No reset request is triggered. MCU_ESR0_SYSTEM_RESET_SEL1 : System reset is triggered. MCU_ESR0_APPLICATION_RESET_SEL2: Application reset request is triggered.
        enumeration McuESR1ResetConf: {MCU_ESR1_NO_RESET_SEL0, MCU_ESR1_SYSTEM_RESET_SEL1, MCU_ESR1_APPLICATION_RESET_SEL2}, origin=INFINEON_AURIX2G, post-build-variant-value=true, set at post-build, default-value=MCU_ESR1_NO_RESET_SEL0  # This parameter defines the response of ESR1 reset request. MCU_ESR1_NO_RESET_SEL0 : No reset request is triggered. MCU_ESR1_SYSTEM_RESET_SEL1 : System reset request is triggered. MCU_ESR1_APPLICATION_RESET_SEL2: Application reset request is triggered.
        enumeration McuSWResetConf: {MCU_SW_NO_RESET_SEL0, MCU_SW_SYSTEM_RESET_SEL1, MCU_SW_APPLICATION_RESET_SEL2}, origin=INFINEON_AURIX2G, post-build-variant-value=true, set at post-build, default-value=MCU_SW_NO_RESET_SEL0  # This parameter defines the response of SW reset request. MCU_SW_NO_RESET_SEL0 : No reset request is triggered. MCU_SW_SYSTEM_RESET_SEL1 : System reset request is triggered. MCU_SW_APPLICATION_RESET_SEL2: Application reset request is triggered.
        enumeration McuSMUResetConf: {MCU_SMU_NO_RESET_SEL0, MCU_SMU_SYSTEM_RESET_SEL1, MCU_SMU_APPLICATION_RESET_SEL2}, origin=INFINEON_AURIX2G, post-build-variant-value=true, set at post-build, default-value=MCU_SMU_NO_RESET_SEL0  # This parameter defines the response of SMU reset request. MCU_SMU_NO_RESET_SEL0 : No reset request is triggered. MCU_SMU_SYSTEM_RESET_SEL1 : System reset request is triggered. MCU_SMU_APPLICATION_RESET_SEL2: Application reset request is triggered.
        enumeration McuSTM0ResetConf: {MCU_STM0_NO_RESET_SEL0, MCU_STM0_SYSTEM_RESET_SEL1, MCU_STM0_APPLICATION_RESET_SEL2}, origin=INFINEON_AURIX2G, post-build-variant-value=true, set at post-build, default-value=MCU_STM0_NO_RESET_SEL0  # This parameter defines the response of STM0 reset request. MCU_STM0_NO_RESET_SEL0 : No reset request is triggered. MCU_STM0_SYSTEM_RESET_SEL1 : System reset request is triggered. MCU_STM0_APPLICATION_RESET_SEL2: Application reset request is triggered.
        enumeration McuSTM{1..5}ResetConf: {MCU_STM{1..5}_NO_RESET_SEL0, MCU_STM{1..5}_SYSTEM_RESET_SEL1, MCU_STM{1..5}_APPLICATION_RESET_SEL2}, origin=INFINEON_AURIX2G, post-build-variant-value=true, set at post-build, default-value=MCU_STM{1..5}_NO_RESET_SEL0  # This parameter defines the response of STM{1..5} reset request. MCU_STM{1..5}_NO_RESET_SEL0 : No reset request is triggered. MCU_STM{1..5}_SYSTEM_RESET_SEL1 : System reset request is triggered. MCU_STM{1..5}_APPLICATION_RESET_SEL2: Application reset request is triggered. The parameter will be disabled if STM{1..5} timer doesn't exist on the HW.
        boolean McuSTM0ResetOnApplResetEnable: origin=INFINEON_AURIX2G, post-build-variant-value=true, set at post-build, default-value=true  # This parameter specifies enabling of STM0 timer reset on occurance of application reset. TRUE : STM0 timer is reset on application reset request. FALSE: STM0 timer is not reset on application reset request.
        boolean McuSTM1ResetOnApplResetEnable: origin=INFINEON_AURIX2G, post-build-variant-value=true, set at post-build, default-value=true  # This parameter specifies enabling of STM1 timer reset on occurance of application reset. TRUE : STM1 timer is reset on application reset request. FALSE: STM1 timer is not reset on application reset request. The parameter will be disabled if STM2 timer doesn't exist on the HW.
        boolean McuSTM{2..5}ResetOnApplResetEnable: origin=INFINEON_AURIX2G, post-build-variant-value=true, set at post-build, default-value=true  # This parameter specifies enabling of STM{2..5} timer reset on occurance of application reset. TRUE : STM{2..5} timer is reset on application reset request. FALSE: STM{2..5} timer is not reset on application reset request. The parameter will be disabled if STM{2..5} timer doesn't exist on the HW.
      container McuTrapSettingConf  # This container defines the configuration (parameters) of the trap settings
        boolean McuCPU0ESR0TrapEnable: origin=INFINEON_AURIX2G, post-build-variant-value=true, set at post-build, default-value=false  # This parameter specifies if ESR0 trap can be generated by CPU0. TRUE : ESR0 trap request can be generated. FALSE: ESR0 trap request can not be generated.
        boolean McuCPU{1..5}ESR0TrapEnable: origin=INFINEON_AURIX2G, post-build-variant-value=true, set at post-build, default-value=false  # This parameter specifies if ESR0 trap can be generated by CPU{1..5}. TRUE : ESR0 trap request can be generated. FALSE: ESR0 trap request can not be generated. The parameter will be disabled if CPU{1..5} doesn't exist on the HW.
        boolean McuCPU0ESR1TrapEnable: origin=INFINEON_AURIX2G, post-build-variant-value=true, set at post-build, default-value=false  # This parameter specifies if ESR1 trap can be generated by CPU0. TRUE : ESR1 trap request can be generated. FALSE: ESR1 trap request can not be generated.
        boolean McuCPU{1..5}ESR1TrapEnable: origin=INFINEON_AURIX2G, post-build-variant-value=true, set at post-build, default-value=false  # This parameter specifies if ESR1 trap can be generated by CPU{1..5}. TRUE : ESR1 trap request can be generated. FALSE: ESR1 trap request can not be generated. The parameter will be disabled if CPU{1..5} doesn't exist on the HW.
        boolean McuCPU0Trap2Enable: origin=INFINEON_AURIX2G, post-build-variant-value=true, set at post-build, default-value=false  # This parameter specifies if Trap2 trap can be generated by CPU0. TRUE : Trap2 trap request can be generated. FALSE: Trap2 trap request can not be generated.
        boolean McuCPU{1..5}Trap2Enable: origin=INFINEON_AURIX2G, post-build-variant-value=true, set at post-build, default-value=false  # This parameter specifies if Trap2 trap can be generated by CPU{1..5}. TRUE : Trap2 trap request can be generated. FALSE: Trap2 trap request can not be generated. The parameter will be disabled if CPU{1..5} doesn't exist on the HW.
        boolean McuCPU0SMUTrapEnable: origin=INFINEON_AURIX2G, post-build-variant-value=true, set at post-build, default-value=false  # This parameter specifies if SMU trap can be generated by CPU0. TRUE : SMU trap request can be generated. FALSE: SMU trap request can not be generated.
        boolean McuCPU{1..5}SMUTrapEnable: origin=INFINEON_AURIX2G, post-build-variant-value=true, set at post-build, default-value=false  # This parameter specifies if SMU trap can be generated by CPU{1..5}. TRUE : SMU trap request can be generated. FALSE: SMU trap request can not be generated. The parameter will be disabled if CPU{1..5} doesn't exist on the HW.
      container McuEruGlobalConf  # This container contains the configuration (parameters) for Global ERU settings.
        integer McuEruInputFilterRegVal: 0..4278321151, origin=INFINEON_AURIX2G, post-build-variant-value=true, set at post-build, default-value=0  # This configuration parameter enables/disables the glitch filter and also the Glitch filter pre-divider and filters depth. (Register EIFILT). In case 0 is passed for bitfields which are reserved according to the TS, the value will be masked out.
      container McuClockSettingConfig [1..256]: multiplicity set at pre-compile  # This container defines the configuration (parameters) for the MCU Clock settings.
        integer McuClockSettingId: 0..255, set at pre-compile, symbolic-name-value=true, default-value=0  # The Id of this McuClockSettingConfig to be used as argument for the API call Mcu_InitClock.
        container McuClockReferencePointConfig  # This container has sub-container for the configuration of Mcu Clock tree.
          container McuSystemPllSettingConfig  # This container contains the configuration (parameters) for the System clock settings.
            enumeration McuPllInputSrcSelection: {BACKUP_CLOCK_SRC_SELECT_SEL0, OSC_CLOCK_SRC_SELECT_SEL1}, origin=INFINEON_AURIX2G, post-build-variant-value=true, set at post-build, default-value=OSC_CLOCK_SRC_SELECT_SEL1  # This parameter will define PLL input source. BACKUP_CLOCK_SRC_SELECT_SEL0: Backup clock selected for oscillator watchdog clock source. OSC_CLOCK_SRC_SELECT_SEL1: Oscillator clock selected for oscillator watchdog clock source.
            integer McuSystemPllPDivider: 0..7, origin=INFINEON_AURIX2G, post-build-variant-value=true, set at post-build, default-value=0  # The parameter defines P divider value for System PLL.
            integer McuSystemPllNDivider: 0..127, origin=INFINEON_AURIX2G, post-build-variant-value=true, set at post-build, default-value=29  # The parameter defines N divider value for System PLL.
            integer McuSystemPllK2Divider: 0..7, origin=INFINEON_AURIX2G, post-build-variant-value=true, set at post-build, default-value=1  # The parameter defines K2 divider value for System PLL.
            integer McuSysPllK2DivStepUpChangeDelay: 5..100, origin=INFINEON_AURIX2G, post-build-variant-value=true, set at post-build, default-value=10  # McuSysPllK2DivStepUpChangeDelay : This paramter configures the delay in micro-seconds for ramping up/down K2 div increment to reach configured system PLL frequency
            integer McuSysPllK2DivStepDownChangeDelay: 5..100, origin=INFINEON_AURIX2G, post-build-variant-value=true, set at post-build, default-value=10  # McuSysPllK2DivStepDownChangeDelay : This paramter configures the delay in micro-seconds for ramping up/down K2 div decrement to reach configured system PLL frequency
            boolean McuFmPllEnable: origin=INFINEON_AURIX2G, post-build-variant-value=true, set at post-build, default-value=false  # This parameter specifies if Frequency Modulation for system PLL is enabled. TRUE : Frequency modulation for system PLL is enabled. FALSE: Frequency modulation for system PLL is disabled.
            float McuFMPllModAmp: 0.0..5.0, origin=INFINEON_AURIX2G, post-build-variant-value=true, set at post-build, default-value=1.25  # McuFMPllModAmp : It is the value for Modulation Amplitude for system PLL Frequency modulation.For any desired Modulation Amplitude, the corresponding bitfield MODCFG[9:0] of SCU_PLLCON2 can be calculated considering oscillator frequency McuMainOscillatorFrequency, McuPllPDivider and McuPllNDivider, according to this equation:MODCFG[9:0] = (64 * McuFMPllModAmp/100 * McuMainOscillatorFrequency/McuPllPDivider * McuPllNDivider/3.6) ; units: McuFMPllModAmp [%] , McuMainOscillatorFrequency [MHz].
            float McuClockReferencePointFrequency0: 2.0E7..3.0E8, scope=ECU, origin=INFINEON_AURIX2G, post-build-variant-value=true, set at post-build, default-value=3.0E8  # This is the System PLL frequency for the specific instance of the McuClockReferencePointConfig container. The unit is Hz. Its value is calculated based on Oscillator frequency and P, N and K2 divider configuration Calculation Formula: Fpll =( (Fosc * (McuNDivider + 1)) / ((McuK2Divider+1)*(McuPDivider+1))) The McuClockReferencePointFrequency for NORMAL_MODE should be in range: 20 - 300 MHz If McuClockDistributionInpClockSel is selected as BACKUP_INPUT_CLOCK_SRC_SELECT, then manually configure this clock to Fback = 100MHz.
          container McuPeripheralPllSettingConfig  # This container contains the configuration (parameters) for the Peripheral clock settings.
            integer McuPeripheralPllPDivider: 0..7, origin=INFINEON_AURIX2G, post-build-variant-value=true, set at post-build, default-value=0  # The parameter defines P divider value for peripheral PLL.
            integer McuPeripheralPllNDivider: 0..127, origin=INFINEON_AURIX2G, post-build-variant-value=true, set at post-build, default-value=39  # The parameter defines N divider value for peripheral PLL.
            integer McuPeripheralPllK2Divider: 0..7, origin=INFINEON_AURIX2G, post-build-variant-value=true, set at post-build, default-value=4  # The parameter defines K2 divider value for peripheral PLL.
            integer McuPerPllK2DivStepUpChangeDelay: 5..100, origin=INFINEON_AURIX2G, post-build-variant-value=true, set at post-build, default-value=10  # McuPerPllK2DivStepChangeDelay : This paramter configures the delay in micro-seconds for ramping up/down K2 div to reach configured peripheral PLL frequency
            integer McuPerPllK2DivStepDownChangeDelay: 5..100, origin=INFINEON_AURIX2G, post-build-variant-value=true, set at post-build, default-value=10  # McuPerPllK2DivStepChangeDelay : This paramter configures the delay in micro-seconds for ramping up/down K2 div to reach configured peripheral PLL frequency
            integer McuPeripheralPllK3Divider: 0..7, origin=INFINEON_AURIX2G, post-build-variant-value=true, set at post-build, default-value=1  # The parameter defines K3 divider value for peripheral PLL.
            integer McuPerPllK3DivStepUpChangeDelay: 5..100, origin=INFINEON_AURIX2G, post-build-variant-value=true, set at post-build, default-value=10  # McuPerPllK3DivStepChangeDelay : This paramter configures the delay in micro-seconds for ramping up/down K3 div to reach configured peripheral PLL frequency
            integer McuPerPllK3DivStepDownChangeDelay: 5..100, origin=INFINEON_AURIX2G, post-build-variant-value=true, set at post-build, default-value=10  # McuPerPllK3DivStepChangeDelay : This paramter configures the delay in micro-seconds for ramping up/down K3 div to reach configured peripheral PLL frequency
            enumeration McuFreqSource1ClockDivSelect: {DIV_FACTOR_2_NOT_BYPASSED_SEL0, DIV_FACTOR_2_BYPASSED_SEL1}, origin=INFINEON_AURIX2G, post-build-variant-value=true, set at post-build, default-value=DIV_FACTOR_2_BYPASSED_SEL1  # This parameter defines the peripheral clock divider selection. DIV_FACTOR_2_NOT_BYPASSED_SEL0: Divider factor of two is not bypassed. (Fpll1/2 = Fsource1 ). DIV_FACTOR_2_BYPASSED_SEL1: Divider factor of two is bypassed. (Fpll1 = Fsource1).
            enumeration McuPll2DivSelect: {MCU_K3_DIV_FACTOR_NOT_BYPASSED_SEL0, MCU_K3_DIV_FACTOR_BYPASSED_SEL1}, origin=INFINEON_AURIX2G, post-build-variant-value=true, set at post-build, default-value=MCU_K3_DIV_FACTOR_BYPASSED_SEL1  # This parameter will define peripheral clock divider selection. MCU_K3_DIV_FACTOR_NOT_BYPASSED_SEL0: Divider factor for K3 is not bypassed. MCU_K3_DIV_FACTOR_BYPASSED_SEL1: Divider factor for K3 is bypassed.
            float McuClockReferencePointFrequency1: 2.0E7..3.2E8, scope=ECU, origin=INFINEON_AURIX2G, post-build-variant-value=true, set at post-build, default-value=1.6E8  # This is the peripheral PLL frequency for the specific instance of the McuClockReferencePointConfig container. It shall be given in Hz. Its value is given by Fpll =( (Fosc * (McuNDivider + 1)) / ((McuK2Divider+1)*(McuPDivider+1))) The McuClockReferencePointFrequency for NORMAL_MODE should be in range: 20 - 320 MHz If McuClockDistributionInpClockSel is selected as BACKUP_INPUT_CLOCK_SRC_SELECT, then manually configure the clock to 100 MHz.
            float McuClockReferencePointFrequency2: 2.0E7..2.0E8, origin=INFINEON_AURIX2G, post-build-variant-value=true, set at post-build, default-value=2.0E8  # This is the peripheral PLL frequency for the specific instance of the McuClockReferencePointConfig container. It shall be given in Hz. Its value is given by Fpll =( (Fosc * (McuNDivider + 1)) / ((McuK3Divider+1)*(McuPDivider+1))) The McuClockReferencePointFrequency for NORMAL_MODE should be in range: 20 - 200 MHz If McuClockDistributionInpClockSel is selected as BACKUP_INPUT_CLOCK_SRC_SELECT, then manually configure this clock to Fback = 100MHz.
          container McuPllDistributionSettingConfig  # This container contains the configuration (parameters) for PLL Distribution and frequencies to various HW modules within clock tree.
            enumeration McuClockDistributionInpClockSel: {BACKUP_INPUT_CLOCK_SRC_SELECT_SEL0, PLL_INPUT_CLOCK_SRC_SELECT_SEL1}, origin=INFINEON_AURIX2G, post-build-variant-value=true, set at post-build, default-value=PLL_INPUT_CLOCK_SRC_SELECT_SEL1  # This parameter defines clock source selection for clock distribution unit. BACKUP_INPUT_CLOCK_SRC_SELECT_SEL0: Backup clock is selected as an input to the clock distribution unit. PLL_INPUT_CLOCK_SRC_SELECT_SEL1: PLLx(x=0, 1, 2) is selected as an input clock to the clock distribution unit.
            enumeration McuLowPowerDivValue: {LOW_POWER_DIVIDER_DISABLE_SEL0, LOW_POWER_DIVIDE_BY_30_SEL1, LOW_POWER_DIVIDE_BY_60_SEL2, LOW_POWER_DIVIDE_BY_120_SEL3, LOW_POWER_DIVIDE_BY_240_SEL4}, origin=INFINEON_AURIX2G, post-build-variant-value=true, set at post-build, default-value=LOW_POWER_DIVIDER_DISABLE_SEL0  # This parameter defines whether low power divider feature is enabled or disabled. LOW_POWER_DIVIDER_DISABLE_SEL0: Low power mode is disabled. LOW_POWER_DIVIDE_BY_30_SEL1: Low power mode clock divider is set to 30. LOW_POWER_DIVIDE_BY_60_SEL2: Low power mode clock divider is set to 60. LOW_POWER_DIVIDE_BY_120_SEL3: Low power mode clock divider is set to 120. LOW_POWER_DIVIDE_BY_240_SEL4: Low power mode clock divider is set to 240.
            float McuSRIFrequency: 1.0..3.0E8, scope=ECU, origin=INFINEON_AURIX2G, post-build-variant-value=true, set at post-build, default-value=300000000.0  # This parameter defines the SRI frequency. SRI should always be in proportionate to McuClockReferencePointFrequency0. The unit is Hz.
            float McuCPU0Frequency: 1.0..3.0E8, scope=ECU, origin=INFINEON_AURIX2G, post-build-variant-value=true, set at post-build, default-value=3.0E8  # This parameter defines the CPU0 frequency. The unit is Hz. McuCPU0Frequency configuration requires adherence to the following formula. McuCPU0Frequency = McuSRIFrequency * (64 - CPU0DIV) / 64.
            float McuCPU{1..5}Frequency: 1.0..3.0E8, scope=ECU, origin=INFINEON_AURIX2G, post-build-variant-value=true, set at post-build, default-value=3.0E8  # This parameter defines the CPU{1..5} frequency. The unit is Hz. McuCPU{1..5}Frequency configuration requires adherence to the following formula. McuCPU{1..5}Frequency = McuSRIFrequency * (64 - CPU{1..5}DIV) / 64. The parameter will be disabled if CPU{1..5} doesn't exist on the HW.
            float McuSPBFrequency: 1.0..1.0E8, scope=ECU, origin=INFINEON_AURIX2G, post-build-variant-value=true, set at post-build, default-value=100000000.0  # This parameter defines the SPB frequency. SPB should always be in proportionate to McuClockReferencePointFrequency0. The unit is Hz.
            float McuFSIFrequency: 2.0E7..1.0E8, scope=ECU, origin=INFINEON_AURIX2G, post-build-variant-value=true, set at post-build, default-value=100000000  # This parameter specifies the intended target FSI frequency. The unit is Hz. FSI can be same as SRI. If FSI is intended to be half of SRI then SRIDIV must be either 1 or 2. If FSI is intended to be one third of SRI then SRIDIV must be either 1 or 2 default : 100MHz (Max FSI clock value wrt fSRI @ 300Mhz.)
            float McuFSI2Frequency: 1.0..3.0E8, scope=ECU, origin=INFINEON_AURIX2G, post-build-variant-value=true, set at post-build, default-value=3.0E8  # This parameter specifies the intended target FSI2 frequency. The unit is Hz. FSI2 can be same as SRI. If FSI2 is intended to be half of SRI then SRIDIV must be either 1 or 2. If FSI2 is intended to be one third of SRI then SRIDIV must be either 1 or 2 default : 300MHz (Max FSI clock value wrt fSRI @ 300Mhz.)
            float McuReferenceFrequency1: 0.0..1.0E8, scope=ECU, origin=INFINEON_AURIX2G, post-build-variant-value=true, set at post-build, default-value=1.25E7  # This parameter specifies the intended reference frequency 1 for MCDS. McuReferenceFrequency1 = McuClockReferencePointFrequency0 / 24. The unit is Hz.
            float McuReferenceFrequency2: 0.0..1.0E8, origin=INFINEON_AURIX2G, post-build-variant-value=true, set at post-build, default-value=6666667.0  # This parameter specifies the intended reference frequency 2 for MCDS. McuReferenceFrequency2 = McuClockReferencePointFrequency1 / 24. The unit is Hz.
            float McuBBBFrequency: 0.0..1.5E8, scope=ECU, origin=INFINEON_AURIX2G, post-build-variant-value=true, set at post-build, default-value=150000000.0  # This parameter specifies Back Bone Bus frequency. BBB frequency output can be stopped by configuring 0 to this configuration parameter. The unit is Hz.
            boolean McuErayClkEnable: origin=INFINEON_AURIX2G, post-build-variant-value=true, set at post-build, default-value=false  # This parameter specifies if frequencies provided for ERAY module, fERAY is enabled or not TRUE : fERAY is enabled. FALSE: fERAY is disabled. The parameter will be disabled if FlexRay IP doesn't exist on the HW.
            float McuErayFrequency: 0.0..8.0E7, scope=ECU, origin=INFINEON_AURIX2G, post-build-variant-value=true, set at post-build, default-value=80000000  # This parameter specifies Eray frequency. Resultant Eray frequency is always peripheral PLL frequency (McuClockReferencePointFrequency1) divided by fixed divider 2. Eray frequency has to be disabled when distribution source is selected as Back Up Frequency. The unit is Hz.
            float McuGTMFrequency: 0.0..2.0E8, scope=ECU, origin=INFINEON_AURIX2G, post-build-variant-value=true, set at post-build, default-value=200000000.0  # This parameter specifies GTM peripheral frequency. The unit is Hz. If GTM peripheral frequency to be disabled, value 0 has to be configured to this configuration parameter. GTM frequency, if enabled, is derived by dividing the FSourceGTM frequency by one of the following factors. 1, 2, 3, 4, 5, 6, 8, 10, 12, 15. FSourceGTM is derived by following formula. if GTMDIV = 1 ; then FSourceGTM = McuSPBFrequency * 2, otherwise FSourceGTM = McuClockReferencePointFrequency0 Hence, GTM has to be configured either equal to = McuSPBFrequency * 2 or fraction of McuClockReferencePointFrequency0. (Valid fraction values are 2, 3, 4, 5, 6, 8, 10, 12 and 15.) The parameter will be disabled if GTM IP doesn't exist on the HW.
            float McuSTMFrequency: 0.0..1.0E8, origin=INFINEON_AURIX2G, post-build-variant-value=true, set at post-build, default-value=100000000.0  # This parameter specifies STM peripheral frequency. The unit is Hz. If STM peripheral frequency to be disabled, value 0 has to be configured to this configuration parameter. STM frequency, if enabled, has to be divisible by McuClockReferencePointFrequency0 with one of the following dividers. 1, 2, 3, 4, 5, 6, 8, 10, 12 and 15. STM frequency can be slower or faster or equal to SPB frequency.
            enumeration McuMscClockSourceSelection: {MSC_CLOCK_SOURCE_DISABLED_SEL0, MSC_CLOCK_SOURCE_SOURCE1_SEL1, MSC_CLOCK_SOURCE_SOURCE2_SEL2}, scope=ECU, origin=INFINEON_AURIX2G, post-build-variant-value=true, set at post-build, default-value=MSC_CLOCK_SOURCE_DISABLED_SEL0  # This parameter will define the input clock source for MSC peripheral. MSC_CLOCK_SOURCE_DISABLED_SEL0: MSC peripheral frequency is disabled. MSC_CLOCK_SOURCE_SOURCE1_SEL1: McuClockReferencePointFrequency1 is used as input clock source for MSC dividers. MSC_CLOCK_SOURCE_SOURCE2_SEL2: McuClockReferencePointFrequency2 is used as input clock source for MSC dividers.
            float McuMscFrequency: 0.0..2.0E8, scope=ECU, origin=INFINEON_AURIX2G, post-build-variant-value=true, set at post-build, default-value=0.0  # This parameter specifies MSC peripheral frequency. The unit is Hz. This parameter is applicable only if McuMscClockSourceSelection is not MSC_CLOCK_SOURCE_DISABLED. Target frequency to be configured should be perfectly divisible by one of the following dividers 1, 2, 3, 4, 5, 6, 8, 10, 12 and 15.
            enumeration McuMCanClockSourceSelection: {MCAN_CLOCK_SOURCE_DISABLED_SEL0, MCAN_CLOCK_SOURCE_MCANI_SEL1, MCAN_CLOCK_SOURCE_OSC_SEL2}, scope=ECU, origin=INFINEON_AURIX2G, post-build-variant-value=true, set at post-build, default-value=MCAN_CLOCK_SOURCE_DISABLED_SEL0  # This parameter will define the input clock source for MCAN peripheral. MCAN_CLOCK_SOURCE_DISABLED_SEL0: MCAN peripheral frequency is disabled. MCAN_CLOCK_SOURCE_MCANI_SEL1: fMCANI frequency is used as input clock source for MCAN peripheral. MCAN_CLOCK_SOURCE_OSC_SEL2: Main oscillator frequency is used as input clock source for MCAN peripheral.
            float McuMCanFrequency: 0.0..8.0E7, scope=ECU, origin=INFINEON_AURIX2G, post-build-variant-value=true, set at post-build, default-value=0.0  # This parameter specifies MSC peripheral frequency. The unit is Hz. This parameter is applicable only if McuMCANClockSourceSelection is not MCAN_CLOCK_SOURCE_DISABLED_SEL0. Target frequency to be configured should be perfectly divisible by one of the following dividers 1, 2, 3, 4, 5, 6, 8, 10, 12 and 15
            float McuAscLinFastFrequency: 0.0..2.0E8, scope=ECU, origin=INFINEON_AURIX2G, post-build-variant-value=true, set at post-build, default-value=0.0  # This parameter specifies ASCLIN peripheral frequency. The unit is Hz. If ASCLIN peripheral frequency for fast mode to be disabled, value 0 has to be configured to this configuration parameter. If not disabled, intended target frequency to be configured should be McuClockReferencePointFrequency2 perfectly divisible by one of the following dividers 1, 2, 3, 4, 5, 6, 8, 10, 12 and 15
            enumeration McuAscLinSlowClockSourceSelection: {ASCLINS_CLOCK_SOURCE_DISABLED_SEL0, ASCLINS_CLOCK_SOURCE_ASCLINSI_SEL1, ASCLINS_CLOCK_SOURCE_OSC0_SEL2}, scope=ECU, origin=INFINEON_AURIX2G, post-build-variant-value=true, set at post-build, default-value=ASCLINS_CLOCK_SOURCE_DISABLED_SEL0  # This parameter specifies the input clock source for ASCLIN peripheral slow frequency. ASCLINS_CLOCK_SOURCE_DISABLED_SEL0: AscLin clock source is disabled. ASCLINS_CLOCK_SOURCE_ASCLINSI_SEL1: McuAscLinSlowFrequency is used as input clock source for ASCLIN dividers. ASCLINS_CLOCK_SOURCE_OSC0_SEL2: McuMainOscillatorFrequency is used as input clock source for ASCLIN dividers.
            float McuAscLinSlowFrequency: 0.0..2.0E8, origin=INFINEON_AURIX2G, post-build-variant-value=true, set at post-build, default-value=0.0  # This parameter specifies ASCLIN peripheral slow frequency. The unit is Hz. If ASCLIN peripheral frequency for fast mode to be disabled, value 0 has to be configured to this configuration parameter. If not disabled, intended target frequency to be configured should be McuClockReferencePointFrequency1 perfectly divisible by one of the following dividers 1, 2, 3, 4, 5, 6, 8, 10, 12 and 15
            enumeration McuQspiClockSourceSelection: {QSPI_CLOCK_SOURCE_DISABLED_SEL0, QSPI_CLOCK_SOURCE_SOURCE1_SEL1, QSPI_CLOCK_SOURCE_SOURCE2_SEL2}, scope=ECU, origin=INFINEON_AURIX2G, post-build-variant-value=true, set at post-build, default-value=QSPI_CLOCK_SOURCE_DISABLED_SEL0  # This parameter will define the input clock source for QSPI peripheral. QSPI_CLOCK_SOURCE_DISABLED_SEL0: AscLin clock source is disabled. QSPI_CLOCK_SOURCE_SOURCE1_SEL1: McuClockReferencePointFrequency1 is used as input clock source for QSPI dividers. QSPI_CLOCK_SOURCE_SOURCE2_SEL2: McuClockReferencePointFrequency2 is used as input clock source for QSPI dividers.
            float McuQspiFrequency: 0.0..2.0E8, origin=INFINEON_AURIX2G, post-build-variant-value=true, set at post-build, default-value=100000000.0  # This parameter specifies QSPI peripheral frequency. The unit is Hz. Target frequency to be configured should be perfectly divisible by one of the following dividers 1, 2, 3, 4, 5, 6, 8, 10, 12 and 15
            float McuAdcFrequency: 2.0E7..1.6E8, scope=ECU, origin=INFINEON_AURIX2G, post-build-variant-value=true, set at post-build, default-value=1.6E8  # This parameter specifies ADC peripheral frequency. The unit is Hz. This clock frequency is always equal to McuClockReferencePointFrequency1.
            enumeration McuConvCtrlPhaseSynchConf: {PHASE_SYNCH_CONST_ACTIVE_SEL0, PHASE_SYNCH_PER_FREQ_BY_2_SEL1, PHASE_SYNCH_PER_FREQ_BY_3_SEL2, PHASE_SYNCH_PER_FREQ_BY_4_SEL3, PHASE_SYNCH_PER_FREQ_BY_5_SEL4, PHASE_SYNCH_PER_FREQ_BY_6_SEL5, PHASE_SYNCH_PER_FREQ_BY_7_SEL6, PHASE_SYNCH_PER_FREQ_BY_8_SEL7, PHASE_SYNCH_PER_FREQ_BY_9_SEL8, PHASE_SYNCH_PER_FREQ_BY_10_SEL9, PHASE_SYNCH_PER_FREQ_BY_11_SEL10, PHASE_SYNCH_PER_FREQ_BY_12_SEL11, PHASE_SYNCH_PER_FREQ_BY_13_SEL12, PHASE_SYNCH_PER_FREQ_BY_14_SEL13, PHASE_SYNCH_PER_FREQ_BY_15_SEL14, PHASE_SYNCH_PER_FREQ_BY_16_SEL15}, scope=ECU, origin=INFINEON_AURIX2G, post-build-variant-value=true, set at post-build, default-value=PHASE_SYNCH_CONST_ACTIVE_SEL0  # This parameter defines the phase shift frequency divider for converter control block. This parameter is included here as this is a common across ADC and DSADC module. PHASE_SYNCH_CONST_ACTIVE_SEL0: Constant phase signal is active. PHASE_SYNCH_PER_FREQ_BY_2_SEL1: Phase synchronization is generated at fPER by 2. PHASE_SYNCH_PER_FREQ_BY_3_SEL2: Phase synchronization is generated at fPER by 3. PHASE_SYNCH_PER_FREQ_BY_4_SEL3: Phase synchronization is generated at fPER by 4. PHASE_SYNCH_PER_FREQ_BY_5_SEL4: Phase synchronization is generated at fPER by 5. PHASE_SYNCH_PER_FREQ_BY_6_SEL5: Phase synchronization is generated at fPER by 6. PHASE_SYNCH_PER_FREQ_BY_7_SEL6: Phase synchronization is generated at fPER by 7. PHASE_SYNCH_PER_FREQ_BY_8_SEL7: Phase synchronization is generated at fPER by 8. PHASE_SYNCH_PER_FREQ_BY_9_SEL8: Phase synchronization is generated at fPER by 9. PHASE_SYNCH_PER_FREQ_BY_10_SEL9: Phase synchronization is generated at fPER by 10. PHASE_SYNCH_PER_FREQ_BY_11_SEL10: Phase synchronization is generated at fPER by 11. PHASE_SYNCH_PER_FREQ_BY_12_SEL11: Phase synchronization is generated at fPER by 12. PHASE_SYNCH_PER_FREQ_BY_13_SEL12: Phase synchronization is generated at fPER by 13. PHASE_SYNCH_PER_FREQ_BY_14_SEL13: Phase synchronization is generated at fPER by 14. PHASE_SYNCH_PER_FREQ_BY_15_SEL14: Phase synchronization is generated at fPER by 15. PHASE_SYNCH_PER_FREQ_BY_16_SEL15: Phase synchronization is generated at fPER by 16.
            float McuI2CFrequency: 0.0..1.0E8, scope=ECU, origin=INFINEON_AURIX2G, post-build-variant-value=true, set at post-build, default-value=100000000  # This parameter specifies I2C peripheral frequency. The unit is Hz. McuI2CFrequency has to be divisible by McuClockReferencePointFrequency2 with the divider values specified in HW TS specification.
            boolean McuEbuClkEnable: origin=INFINEON_AURIX2G, post-build-variant-value=true, set at post-build, default-value=false  # This parameter specifies if frequencies provided for EBU module, fEBU is enabled or not TRUE : fEBU is enabled. FALSE: fEBU is disabled. The parameter will be disabled if EBU interface doesn't exist on the HW.
            float McuEbuFrequency: 2.0E7..1.6E8, scope=ECU, origin=INFINEON_AURIX2G, post-build-variant-value=true, set at post-build, default-value=1.6E8  # This parameter specifies EBU peripheral frequency. The unit is Hz. This clock frequency is always same as McuClockReferencePointFrequency1.
            float McuHsctFrequency: 0.0..4.0E8, scope=ECU, origin=INFINEON_AURIX2G, post-build-variant-value=true, set at post-build, default-value=1.0E7  # This parameter specifies HSCT frequency. The unit is Hz. This clock frequency is always same Peripheral DCO frequency / 2.
            boolean McuHspdmClkEnable: origin=INFINEON_AURIX2G, post-build-variant-value=true, set at post-build, default-value=false  # This parameter specifies if frequencies provided for HSPDM module, fHSPDM160 and fHSPDM320 are enabled or not TRUE : fHSPDM160 and fHSPDM320 are enabled. FALSE: fHSPDM160 and fHSPDM320 are disabled. The parameter will be disabled if High Speed Pulse Density Modulator IP doesn't exist on the HW.
            float McuHspdm160Frequency: 2.0E7..1.6E8, scope=ECU, origin=INFINEON_AURIX2G, post-build-variant-value=true, set at post-build, default-value=1.6E8  # This parameter specifies HSPDM160 peripheral frequency. The unit is Hz. This clock frequency is always equal to McuClockReferencePointFrequency1.
            float McuHspdm320Frequency: 2.0E7..3.2E8, scope=ECU, origin=INFINEON_AURIX2G, post-build-variant-value=true, set at post-build, default-value=3.2E8  # This parameter specifies HSPDM320 peripheral frequency. The unit is Hz. This clock frequency is always equal to fPLL1 or fBACKUP(based on McuClockDistributionInpClockSel).
            float McuAdasFrequency: 0.0..3.0E8, scope=ECU, origin=INFINEON_AURIX2G, post-build-variant-value=true, set at post-build, default-value=3.0E8  # This parameter specifies ADAS peripheral frequency. McuAdasFrequency has to be divisible by McuClockReferencePointFrequency0 with the divider values specified in HW TS specification. The unit is Hz. The parameter will be disabled if ADAS IP doesn't exist on the HW.
            float McuGEthFrequency: 0.0..2.0E8, scope=ECU, origin=INFINEON_AURIX2G, post-build-variant-value=true, set at post-build, default-value=150000000  # This parameter specifies Gigabit Ethernet peripheral frequency. McuGEthFrequency has to be divisible by McuClockReferencePointFrequency0 with the divider values specified in HW TS specification. The unit is Hz.
            float McuMcanHFrequency: 0.0..1.0E8, scope=ECU, origin=INFINEON_AURIX2G, post-build-variant-value=true, set at post-build, default-value=100000000  # This parameter specifies MCANH peripheral frequency. McuMcanHFrequency has to be divisible by McuClockReferencePointFrequency0 with the divider values specified in HW TS specification. The unit is Hz.
          container McuExternalClockOutputConfig  # This container defines the configuration (parameters) for External clock out of the MCU.
            boolean McuExtClock0Enable: origin=INFINEON_AURIX2G, post-build-variant-value=true, set at post-build, default-value=false  # This parameter specifies if external clock output 0 is enabled/disabled. TRUE : EXTCLK0 signal is available on external pad. FALSE: EXTCLK0 signal is not available on external pad.
            enumeration McuExtClockOutSel0: {FOUT_EXT_CLOCK0_SEL0, PLL0_EXT_CLOCK0_SEL1, PLL1_EXT_CLOCK0_SEL2, OSC0_EXT_CLOCK0_SEL3, BACKUP_EXT_CLOCK0_SEL4, PLL2_EXT_CLOCK0_SEL5, BBB_EXT_CLOCK0_SEL6, SRI_EXT_CLOCK0_SEL8, SPB_EXT_CLOCK0_SEL9, FSI_EXT_CLOCK0_SEL10, STM_EXT_CLOCK0_SEL11, GTM_EXT_CLOCK0_SEL12, TCK_EXT_CLOCK0_SEL13, FSI2_EXT_CLOCK0_SEL14, ERAY_MT0_EXT_CLOCK0_SEL15}, origin=INFINEON_AURIX2G, post-build-variant-value=true, set at post-build, default-value=FOUT_EXT_CLOCK0_SEL0  # This parameter will define clock source for external clock output 0. This parameter is included here as this is a common across ADC and DSADC module. FOUT_EXT_CLOCK0_SEL0: FOUT clock is selected. PLL0_EXT_CLOCK0_SEL1: PLL0 clock is selected. PLL1_EXT_CLOCK0_SEL2: PLL1 clock is selected. OSC0_EXT_CLOCK0_SEL3: OSC0 clock is selected. BACKUP_EXT_CLOCK0_SEL4: BACKUP clock is selected. PLL2_EXT_CLOCK0_SEL5: PLL2 clock is selected. BBB_EXT_CLOCK0_SEL6: BBB clock is selected. SRI_EXT_CLOCK0_SEL8: SRI clock is selected. SPB_EXT_CLOCK0_SEL9: SPB clock is selected. FSI_EXT_CLOCK0_SEL10: FSI clock is selected. STM_EXT_CLOCK0_SEL11: STM clock is selected. GTM_EXT_CLOCK0_SEL12: GTM clock is selected. TCK_EXT_CLOCK0_SEL13: TCK clock is selected. FSI2_EXT_CLOCK0_SEL14: FSI2 clock is selected. ERAY_MT0_EXT_CLOCK0_SEL15: ERAY_MT0 clock is selected. Note: ALT mode for corresponding port pin must be configured in port driver to observe the output at a port pin.
            boolean McuExtClock1Enable: origin=INFINEON_AURIX2G, post-build-variant-value=true, set at post-build, default-value=false  # This parameter specifies if external clock output 1 is enabled/disabled. TRUE : EXTCLK1 signal is available on external pad. FALSE: EXTCLK1 signal is not available on external pad.
            boolean McuExtClock1Inverted: origin=INFINEON_AURIX2G, post-build-variant-value=true, set at post-build, default-value=false  # This parameter specifies if external clock output 1 would be inverted or not. TRUE : output signal is inverted of the actual signal for external clock source1. FALSE: output signal is not inverted of the actual signal for external clock .
            enumeration McuExtClockOutSel1: {FOUT_EXT_CLOCK1_SEL0, PLL0_EXT_CLOCK1_SEL1, PLL1_EXT_CLOCK1_SEL2, EBU_EXT_CLOCK1_SEL3, BACKUP_EXT_CLOCK1_SEL4, MCAN_EXT_CLOCK1_SEL5, ADC_EXT_CLOCK1_SEL6, QSPI_EXT_CLOCK1_SEL7, SRI_EXT_CLOCK1_SEL8, SPB_EXT_CLOCK1_SEL9, I2C_EXT_CLOCK1_SEL10, MSC_EXT_CLOCK1_SEL11, ERAY_EXT_CLOCK1_SEL12, ASCLINF_EXT_CLOCK1_SEL13, ASCLINS_EXT_CLOCK1_SEL14, OSCFL_EXT_CLOCK1_SEL15}, origin=INFINEON_AURIX2G, post-build-variant-value=true, set at post-build, default-value=FOUT_EXT_CLOCK1_SEL0  # This parameter will define clock source for external clock output 1. This parameter is included here as this is a common across ADC and DSADC module. FOUT_EXT_CLOCK1_SEL0: FOUT clock is selected. PLL0_EXT_CLOCK1_SEL1: PLL0 clock is selected. PLL1_EXT_CLOCK1_SEL2: PLL1 clock is selected. EBU_EXT_CLOCK1_SEL3: EBU clock is selected. BACKUP_EXT_CLOCK1_SEL4: BACKUP clock is selected. MCAN_EXT_CLOCK1_SEL5: MCAN clock is selected. ADC_EXT_CLOCK1_SEL6: ADC clock is selected. QSPI_EXT_CLOCK1_SEL7: QSPI clock is selected. SRI_EXT_CLOCK1_SEL8: SRI clock is selected. SPB_EXT_CLOCK1_SEL9: SPB clock is selected. I2C_EXT_CLOCK1_SEL10: I2C clock is selected. MSC_EXT_CLOCK1_SEL11: MSC clock is selected. ERAY_EXT_CLOCK1_SEL12: ERAY clock is selected. ASCLINF_EXT_CLOCK1_SEL13: ASCLINF clock is selected. ASCLINS_EXT_CLOCK1_SEL14: ASCLINS clock is selected. OSCFL_EXT_CLOCK1_SEL15: OSCFL clock is selected. Note: ALT mode for corresponding port pin must be configured in port driver to observe the output at a port pin.
            integer McuExtClock1Div: 1..256, origin=INFINEON_AURIX2G, post-build-variant-value=true, set at post-build, default-value=1  # This parameter specifies reload value of the divider that generates fOUT out of fSPB (fOUT = fSPB/(McuExtClock1Div)). The divider itself is cleared each time bit EN1 is cleared. The value entered by user is decremented by 1 and programmed into EXTCON.DIV1
          container McuClockMonitorConfig  # This container defines the configuration for clock monitoring MCU.
            boolean McuPll{0..2}ClockMonEnable: origin=INFINEON_AURIX2G, post-build-variant-value=true, set at post-build, default-value=false  # This parameter specifies if PLL{0..2} monitoring is enabled/disabled. TRUE : PLL{0..2} monitoring is Enabled. FALSE: PLL{0..2} monitoring is Disabled.
            boolean McuSpbClockMonEnable: origin=INFINEON_AURIX2G, post-build-variant-value=true, set at post-build, default-value=false  # This parameter specifies if SPB clock monitoring is enabled/disabled. TRUE : SPB clock monitoring is Enabled. FALSE: SPB clock monitoring is Disabled.
            boolean McuBackupClockMonEnable: origin=INFINEON_AURIX2G, post-build-variant-value=true, set at post-build, default-value=false  # This parameter specifies if Backup clock monitoring is enabled/disabled. TRUE : Backup clock monitoring is Enabled. FALSE: Backup clock monitoring is Disabled.
            boolean McuBackupClockRangeMonEnable: origin=INFINEON_AURIX2G, post-build-variant-value=true, set at post-build, default-value=false  # This parameter specifies if Backup clock range monitoring is enabled/disabled. TRUE : Backup clock range monitoring is Enabled. FALSE: Backup clock range monitoring is Disabled.
        container McuClockReferencePoint [1..256]: multiplicity set at post-build, post-build-variant-multiplicity=true  # This container defines a reference point in the Mcu Clock tree. It defines the frequencies which then can be used by other modules as an input value. Lower multiplicity is 1, as even in the simplest case (only one frequency is used), there is one frequency to be defined.
          enumeration McuClockRefSelection: {MCU_USER_DEFINED_FREQUENCY, MCU_CPU0_FREQUENCY, MCU_CPU1_FREQUENCY, MCU_CPU2_FREQUENCY, MCU_CPU3_FREQUENCY, MCU_CPU4_FREQUENCY, MCU_CPU5_FREQUENCY, MCU_SOURCE0_FREQUENCY, MCU_SOURCE1_FREQUENCY, MCU_SOURCE2_FREQUENCY, MCU_FSI_FREQUENCY, MCU_SRI_FREQUENCY, MCU_FSI2_FREQUENCY, MCU_SPB_FREQUENCY, MCU_REF_FREQUENCY_1, MCU_REF_FREQUENCY_2, MCU_BBB_FREQUENCY, MCU_ETHRAM_FREQUENCY, MCU_ASCLINFAST_FREQUENCY, MCU_ERAY_FREQUENCY, MCU_ADAS_FREQUENCY, MCU_MSC_FREQUENCY, MCU_GETH_FREQUENCY, MCU_STM_FREQUENCY, MCU_MCANH_FREQUENCY, MCU_MCAN_FREQUENCY, MCU_EBU_FREQUENCY, MCU_QSPI_FREQUENCY, MCU_HSPDM160_FREQUENCY, MCU_ADC_FREQUENCY, MCU_I2C_FREQUENCY, MCU_ASCLINSLOW_FREQUENCY, MCU_HSPDM320_FREQUENCY, MCU_GTM_FREQUENCY, MCU_HSCT_FREQUENCY}, origin=INFINEON_AURIX2G, post-build-variant-value=true, set at post-build, default-value=MCU_USER_DEFINED_FREQUENCY  # This parameter selects the source of clock reference, based on which McuClockReferencePointFrequency is populated with frequency. If user selected MCU_USER_DEFINED_FREQUENCY, the value has to be entered by the user in parameter McuClockReferencePointFrequency.
          float McuClockReferencePointFrequency: 0.0..3.2E8, scope=ECU, post-build-variant-value=true, set at post-build, default-value=0.0  # This is the frequency for the specific instance of the McuClockReferencePoint container. It shall be given in Hz.
      container McuDemEventParameterRefs [0..1]: multiplicity set at pre-compile  # Container for the references to DemEventParameter elements which shall be invoked using the API Dem_ReportErrorStatus API in case the corresponding error occurs. The EventId is taken from the referenced DemEventParameter's DemEventId symbolic name. The standardized errors are provided in the container and can be extended by vendor specific error references.
        symbolic name reference MCU_E_CLOCK_FAILURE [0..1]: multiplicity set at pre-compile, set at pre-compile, destination=DemEventParameter  # Reference to configured DEM event to report Clock source failure.
      container McuModeSettingConf [1..3]: multiplicity set at pre-compile  # This container contains the configuration (parameters) for the Mode setting of the MCU.
        integer McuMode: 0..2, set at pre-compile, symbolic-name-value=true, default-value=0  # The parameter represents the MCU Mode settings. 0 : IDLE mode is selected. 1 : SLEEP mode is selected. 2: STANDBY mode is selected.
        boolean McuEvrcLPMOnSleepReqEnable: origin=INFINEON_AURIX2G, post-build-variant-value=true, set at post-build, default-value=false  # This parameter enables EVRC low power mode in sleep mode. TRUE: Entering into Low power mode for EVRC on sleep mode request is enabled. FALSE: Entering into Low power mode for EVRC on sleep mode request is disabled.
        container McuStdbyModeSettingConf  # This container contains the configuration (parameters) for the MCU Standby Mode setting.
          boolean McuStdbyModePortTriStateEnable: origin=INFINEON_AURIX2G, post-build-variant-value=true, set at post-build, default-value=false  # This parameter specifies if pads is in tristate while in standby mode. TRUE: Tristate is enabled for port pins while in standby mode. FALSE: Tristate is disabled for port pins while in standby mode.
          boolean McuStdbyModeESR0TriStateEnable: origin=INFINEON_AURIX2G, post-build-variant-value=true, set at post-build, default-value=false  # This parameter specifies if ESR0 is in tristate while in standby mode. TRUE: Tristate is enabled for ESR0 while in standby mode. FALSE: Tristate is disabled for ESR0 while in standby mode.
          boolean McuStdbyModeWakeupFromPORST: origin=INFINEON_AURIX2G, post-build-variant-value=true, set at post-build, default-value=true  # This parameter specifies wakeup configramtion from PORST. TRUE: Wakeup from standby mode via PORST is enabled. FALSE: Wakeup from standby mode via PORST is disabled.
          boolean McuStdbyModePORSTFilterEnable: origin=INFINEON_AURIX2G, post-build-variant-value=true, set at post-build, default-value=false  # This parameter specifies if PORST digital filter is enabled or disabled. TRUE: PORST digital filter is enabled. FALSE: PORST digital filter is disabled.
          boolean McuStdbyModeWakeupFromEVR: origin=INFINEON_AURIX2G, post-build-variant-value=true, set at post-build, default-value=false  # This parameter specifies if wakeup from standby mode is enabled via EVR. TRUE: Wakeup from standby mode via EVR is enabled. FALSE: Wakeup from standby mode via EVR is disabled.
          boolean McuStdbyModeWakeupFromSCR: origin=INFINEON_AURIX2G, post-build-variant-value=true, set at post-build, default-value=false  # This parameter specifies if wakeup from standby mode via standby controller is enabled. TRUE: Wakeup from standby mode via standby controller is enabled. FALSE: Wakeup from standby mode via standby controller is disabled.
          enumeration McuStdbyModeClkSelection: {OSC_CLOCK_100KHZ_ONLY_SEL0, OSC_CLOCK_100KHZ_100MHZ_SEL1}, origin=INFINEON_AURIX2G, post-build-variant-value=true, set at post-build, default-value=OSC_CLOCK_100KHZ_ONLY_SEL0  # The parameter specifies the active oscillator clock during standby mode operation. OSC_CLOCK_100KHZ_ONLY_SEL0 : Only 100KHz oscillator clock is active in standby mode. OSC_CLOCK_100KHZ_100MHZ_SEL1 : Both 100KHz oscillator clock and 100MHz oscillator clock are active in standby mode.
          enumeration McuStdbyModeBlankingFilterDelay: {DELAY_0_MS_SEL0, DELAY_2_5_MS_SEL1, DELAY_5_MS_SEL2, DELAY_10_MS_SEL3, DELAY_20_MS_SEL4, DELAY_40_MS_SEL5, DELAY_80_MS_SEL6, DELAY_160_MS_SEL7, DELAY_320_MS_SEL8, DELAY_640_MS_SEL9, DELAY_1280_MS_SEL10, DELAY_2560_MS_SEL11, DELAY_5120_MS_SEL12, DELAY_10240_MS_SEL13}, origin=INFINEON_AURIX2G, post-build-variant-value=true, set at post-build, default-value=DELAY_0_MS_SEL0  # The parameter specifies the delay for blanking filter. DELAY_0_MS_SEL0 : No delay. DELAY_2_5_MS_SEL1 : selected delay is 2.5 ms. DELAY_5_MS_SEL2 : selected delay is 5 ms. DELAY_10_MS_SEL3 : selected delay is 10 ms. DELAY_20_MS_SEL4 : selected delay is 20 ms. DELAY_40_MS_SEL5 : selected delay is 40 ms. DELAY_80_MS_SEL6 : selected delay is 80 ms. DELAY_160_MS_SEL7 : selected delay is 160 ms. DELAY_320_MS_SEL8 : selected delay is 320 ms. DELAY_640_MS_SEL9 : selected delay is 640 ms. DELAY_1280_MS_SEL10 : selected delay is 1280 ms. DELAY_2560_MS_SEL11 : selected delay is 2560 ms. DELAY_5120_MS_SEL12 : selected delay is 5120 ms. DELAY_10240_MS_SEL13 : selected delay is 10240 ms. This can be set only when McuStdbyModeWakeupFromEVR = true.
          enumeration McuStdbyModeRamEnable: {MCU_STANDBYRAM_DISABLED_SEL0, MCU_STANDBYRAM_CPU0_BLK0_SEL1, MCU_STANDBYRAM_CPU0_BLK0_BLK1_SEL2, MCU_STANDBYRAM_CPU1_BLK0_BLK1_SEL4, MCU_STANDBYRAM_CPU0_CPU1_BLK0_BLK1_SEL7}, origin=INFINEON_AURIX2G, set at pre-compile, default-value=MCU_STANDBYRAM_DISABLED_SEL0  # This parameter enables dLMU0/dLMU1 powered up in sleep mode. MCU_STANDBYRAM_DISABLED_SEL0 : Standby ram is disabled. MCU_STANDBYRAM_CPU0_BLK0_SEL1 : standby ram is enabled as dLMU0 MCU_STANDBYRAM_CPU0_BLK0_BLK1_SEL2 : standby ram is enabled as dLMU0 BLK0 and BLK1. MCU_STANDBYRAM_CPU1_BLK0_BLK1_SEL4 : standby ram is enabled as dLMU1 BLK0 and BLK1. MCU_STANDBYRAM_CPU0_CPU1_BLK0_BLK1_SEL7 : standby ram is enabled as dLMU0 and dLMU1. Only BLK0 addresses (start of dLMU0/1) are supported right in respective selections.
          container McuStdbyModeESR0Conf  # This container defines the configuration (parameters) for ESR0 in standby mode.
            boolean McuStdbyModeESR0WakeupEnable: origin=INFINEON_AURIX2G, post-build-variant-value=true, set at post-build, default-value=false  # This parameter specifies if wakeup from standby mode is enabled via ESR0. TRUE: Wakeup from standby mode through ESR0 is enabled. FALSE: Wakeup from standby mode through ESR0 is disabled.
            boolean McuStdbyModeESR0FltEnable: origin=INFINEON_AURIX2G, post-build-variant-value=true, set at post-build, default-value=false  # This parameter specifies if digital filter is enabled for ESR0 to wakeup from standby mode. TRUE : Digital filter is enabled for ESR0 wakeup from standby mode. FALSE: Digital filter is disabled for ESR0 wakeup from standby mode.
            enumeration McuStdbyModeESR0EdgeDetection: {ESR0_TRIG_RISING_EDGE_SEL1, ESR0_TRIG_FALLING_EDGE_SEL2, ESR0_TRIG_RISING_FALLING_EDGE_SEL3}, origin=INFINEON_AURIX2G, post-build-variant-value=true, set at post-build, default-value=ESR0_TRIG_RISING_EDGE_SEL1  # The parameter specifies if trigger is generated on rising edge detection, falling edge detection or both. ESR0_TRIG_RISING_EDGE_SEL1: A trigger is generated on rising edge detection. ESR0_TRIG_FALLING_EDGE_SEL2: A trigger is generated on falling edge detection. ESR0_TRIG_RISING_FALLING_EDGE_SEL3: A trigger is generated on both rising edge detection and falling edge detection.
          container McuStdbyModeESR1Conf  # This container contains the configuration (parameters) for the ESR1 configuration in Mcu standby mode.
            boolean McuStdbyModeESR1WakeupEnable: origin=INFINEON_AURIX2G, post-build-variant-value=true, set at post-build, default-value=false  # This parameter specifies if wakeup from standby mode is enabled via ESR1. TRUE: Wakeup from standby mode through ESR1 is enabled. FALSE: Wakeup from standby mode through ESR1 is disabled.
            boolean McuStdbyModeESR1FltEnable: origin=INFINEON_AURIX2G, post-build-variant-value=true, set at post-build, default-value=false  # This parameter specifies if digital filter is enabled for ESR1 to wakeup from standby mode. TRUE: Digital filter is enabled for ESR1 wakeup from standby mode. FALSE: Digital filter is disabled for ESR1 wakeup from standby mode.
            enumeration McuStdbyModeESR1EdgeDetection: {ESR1_TRIG_RISING_EDGE_SEL1, ESR1_TRIG_FALLING_EDGE_SEL2, ESR1_TRIG_RISING_FALLING_EDGE_SEL3}, origin=INFINEON_AURIX2G, post-build-variant-value=true, set at post-build, default-value=ESR1_TRIG_RISING_EDGE_SEL1  # The parameter specifies if trigger is generated on rising edge detection, falling edge detection or both. ESR1_TRIG_RISING_EDGE_SEL1: A trigger is generated on rising edge detection. ESR1_TRIG_FALLING_EDGE_SEL2: A trigger is generated on falling edge detection. ESR1_TRIG_RISING_FALLING_EDGE_SEL3: A trigger is generated on both rising edge detection and falling edge detection.
          container McuStdbyModePinAConf  # This container contains the configuration (parameters) for standby PinA mode.
            boolean McuStdbyModePinAWakeupEnable: origin=INFINEON_AURIX2G, post-build-variant-value=true, set at post-build, default-value=false  # This parameter specifies if wakeup from standby mode is enabled via PINA. TRUE: Wakeup from standby mode through PINA is enabled. FALSE: Wakeup from standby mode through PINA is disabled.
            boolean McuStdbyModePinAFltEnable: origin=INFINEON_AURIX2G, post-build-variant-value=true, set at post-build, default-value=false  # This parameter specifies if digital filter is enabled for PINA to wakeup from standby mode. TRUE: Digital filter is enabled for PINA wakeup from standby mode. FALSE: Digital filter is disabled for PINA wakeup from standby mode.
            enumeration McuStdbyModePinAEdgeDetection: {PINA_TRIG_RISING_EDGE_SEL1, PINA_TRIG_FALLING_EDGE_SEL2, PINA_TRIG_RISING_FALLING_EDGE_SEL3}, origin=INFINEON_AURIX2G, post-build-variant-value=true, set at post-build, default-value=PINA_TRIG_RISING_EDGE_SEL1  # The parameter specifies if trigger is generated on rising edge detection, falling edge detection or both. PINA_TRIG_RISING_EDGE_SEL1: A trigger is generated on rising edge detection. PINA_TRIG_FALLING_EDGE_SEL2: A trigger is generated on falling edge detection. PINA_TRIG_RISING_FALLING_EDGE_SEL3: A trigger is generated on both rising edge detection and falling edge detection.
          container McuStdbyModePinBConf  # This container contains the configuration (parameters) for PinB MCU standby mode.
            boolean McuStdbyModePinBWakeupEnable: origin=INFINEON_AURIX2G, post-build-variant-value=true, set at post-build, default-value=false  # This parameter specifies if wakeup from standby mode is enabled via PINB. TRUE : Wakeup from standby mode through PINB is enabled. FALSE: Wakeup from standby mode through PINB is disabled.
            boolean McuStdbyModePinBFltEnable: origin=INFINEON_AURIX2G, post-build-variant-value=true, set at post-build, default-value=false  # This parameter specifies if digital filter is enabled for PINB to wakeup from standby mode. TRUE: Digital filter is enabled for PINB wakeup from standby mode. FALSE: Digital filter is disabled for PINB wakeup from standby mode.
            enumeration McuStdbyModePinBEdgeDetection: {PINB_TRIG_RISING_EDGE_SEL1, PINB_TRIG_FALLING_EDGE_SEL2, PINB_TRIG_RISING_FALLING_EDGE_SEL3}, origin=INFINEON_AURIX2G, post-build-variant-value=true, set at post-build, default-value=PINB_TRIG_RISING_EDGE_SEL1  # The parameter specifies if trigger is generated on rising edge detection, falling edge detection or both. PINB_TRIG_RISING_EDGE_SEL1: A trigger is generated on rising edge detection. PINB_TRIG_FALLING_EDGE_SEL2: A trigger is generated on falling edge detection. PINB_TRIG_RISING_FALLING_EDGE_SEL3: A trigger is generated on both rising edge detection and falling edge detection.
          container McuStdbyModeWakeupTimerConf  # This container contains the configuration (parameters) for Standby wakeup from timer.
            boolean McuStdbyModeWakeupTimerEnable: origin=INFINEON_AURIX2G, post-build-variant-value=true, set at post-build, default-value=false  # This parameter specifies specifies if wake up from low power mode is supported through wake up timer. TRUE: Wakeup from low power modes with wake up timer is enabled. FALSE: Wakeup from low power modes with wake up timer is disabled.
            integer McuStdbyModeWakeupTimerValue: 0..16777215, origin=INFINEON_AURIX2G, post-build-variant-value=true, set at post-build, default-value=16777215  # This parameter specifies the wakeup timer reload value
            enumeration McuStdbyModeWakeupTimerClkDiv: {WUT_100KHZ_NO_DIV_CLK_SEL0, WUT_100KHZ_DIV_CLK_SEL1}, origin=INFINEON_AURIX2G, post-build-variant-value=true, set at post-build, default-value=WUT_100KHZ_NO_DIV_CLK_SEL0  # The parameter specifies the wakeup timer clock source selection. WUT_100KHZ_NO_DIV_CLK_SEL0: wake up timer runs on 100KHz frequency . WUT_100KHZ_DIV_CLK_SEL1: wake up timer runs on 100KHz frequency divided by 1024 divider value.
            enumeration McuStdbyModeWakeupTimerMode: {WUT_AUTO_RELOAD_MODE_SEL0, WUT_AUTO_STOP_MODE_SEL1}, origin=INFINEON_AURIX2G, post-build-variant-value=true, set at post-build, default-value=WUT_AUTO_RELOAD_MODE_SEL0  # The parameter specifies the wakeup timer clock source selection. WUT_AUTO_RELOAD_MODE_SEL0: selected counter starts running from McuStdbyModeWakeupTimerValue downwards direction. On counter underflow, the wakeup counter value is reloaded with McuStdbyModeWakeupTimerValue again WUT_AUTO_STOP_MODE_SEL1: counter starts running from McuStdbyModeWakeupTimerValue downwards direction. On counter underflow, wakeup timer stops running.
      container McuRamSectorSettingConf [0..256]: multiplicity set at pre-compile  # This container contains the configuration (parameters) for the RAM Sector setting.
        integer McuRamSectorSettingId: 0..255, origin=INFINEON_AURIX2G, set at pre-compile, symbolic-name-value=true, default-value=0  # The Id of this McuRamSectorSettingConf to be used as argument for the API call Mcu_InitRamSection.
        integer McuRamDefaultValue: 0..255, post-build-variant-value=true, set at post-build, default-value=0  # This parameter shall represent the Data pre-setting to be initialized
        integer McuRamSectionBaseAddress: 0..4294967295, post-build-variant-value=true, set at post-build, default-value=1879048192  # This parameter shall represent the MCU RAM section base address
        integer McuRamSectionSize: 0..4294967295, post-build-variant-value=true, set at post-build, default-value=4  # This parameter represents the MCU RAM Section size in bytes.
      container GtmGlobalConfiguration  # This container contains the configuration (parameters) for Global GTM settings.
        container McuGtmClockManagementConf  # This container contains the configuration (parameters) for GTM Clock configurations.
          integer GtmCmuGlobalClockNumerator: 1..16777215, origin=INFINEON_AURIX2G, post-build-variant-value=true, set at post-build, default-value=1  # This parameter specifies the GTM global numerator value for configurable clock and fixed clock
          integer GtmCmuGlobalClockDenominator: 1..16777215, origin=INFINEON_AURIX2G, post-build-variant-value=true, set at post-build, default-value=1  # This parameter specifies the GTM global denominator value for configurable clock and fixed clock
          container GtmFixedClockSetting  # This container contains the configuration (parameters) for GTM Fixed Clock settings.
            boolean GtmCmuFixedClockEnable: origin=INFINEON_AURIX2G, post-build-variant-value=true, set at post-build, default-value=true  # This parameter specifies enable of fixed clock. TRUE: CMU fixed clock is enabled FALSE: CMU fixed clock is disabled
            enumeration GtmCmuFixedClockSel: {CMU_GLOBAL_CLOCK_SEL0, CMU_CLOCK0_SEL1, CMU_CLOCK1_SEL2, CMU_CLOCK2_SEL3, CMU_CLOCK3_SEL4, CMU_CLOCK4_SEL5, CMU_CLOCK5_SEL6, CMU_CLOCK6_SEL7, CMU_CLOCK7_SEL8}, origin=INFINEON_AURIX2G, post-build-variant-value=true, set at post-build, default-value=CMU_GLOBAL_CLOCK_SEL0  # The parameter specifies the divider for the fixed clock. CMU_GLOBAL_CLOCK_SEL0 : Global clock divider is selected. CMU_CLOCK0_SEL1 : clock0 divider is selected. CMU_CLOCK1_SEL2 : clock1 divider is selected. CMU_CLOCK2_SEL3 : clock2 divider is selected. CMU_CLOCK3_SEL4 : clock3 divider is selected. CMU_CLOCK4_SEL5 : clock4 divider is selected. CMU_CLOCK5_SEL6 : clock5 divider is selected. CMU_CLOCK6_SEL7 : clock6 divider is selected. CMU_CLOCK7_SEL8 : clock7 divider is selected.
          container GtmConfigClockSetting  # This container contains the configuration (parameters) for GTM configuration clock settings.
            boolean GtmCmuConfigClock0Enable: origin=INFINEON_AURIX2G, post-build-variant-value=true, set at post-build, default-value=true  # This parameter specifies enable of configurable Clock0. TRUE: CMU configurable Clock0 enabled FALSE: CMU configurable Clock0 is disabled
            integer GtmCmuConfigClock0Div: 0..16777215, origin=INFINEON_AURIX2G, post-build-variant-value=true, set at post-build, default-value=0  # This parameter specifies the configurable Clock0 divider value
            boolean GtmCmuConfigClock1Enable: origin=INFINEON_AURIX2G, post-build-variant-value=true, set at post-build, default-value=true  # This parameter specifies enable of configurable Clock1. TRUE : CMU configurable Clock1 enabled FALSE: CMU configurable Clock1 is disabled
            integer GtmCmuConfigClock1Div: 0..16777215, origin=INFINEON_AURIX2G, post-build-variant-value=true, set at post-build, default-value=0  # This parameter specifies the configurable Clock1 divider value
            boolean GtmCmuConfigClock2Enable: origin=INFINEON_AURIX2G, post-build-variant-value=true, set at post-build, default-value=true  # This parameter specifies enable of configurable Clock2. TRUE: CMU configurable Clock2 enabled. FALSE: CMU configurable Clock2 is disabled.
            integer GtmCmuConfigClock2Div: 0..16777215, origin=INFINEON_AURIX2G, post-build-variant-value=true, set at post-build, default-value=0  # This parameter specifies the configurable Clock2 divider value
            boolean GtmCmuConfigClock3Enable: origin=INFINEON_AURIX2G, post-build-variant-value=true, set at post-build, default-value=true  # This parameter specifies enable of configurable Clock3. TRUE: CMU configurable Clock3 enabled. FALSE: CMU configurable Clock3 is disabled
            integer GtmCmuConfigClock3Div: 0..16777215, origin=INFINEON_AURIX2G, post-build-variant-value=true, set at post-build, default-value=0  # This parameter specifies the configurable Clock3 divider value
            boolean GtmCmuConfigClock4Enable: origin=INFINEON_AURIX2G, post-build-variant-value=true, set at post-build, default-value=true  # This parameter specifies enable of configurable Clock4. TRUE: CMU configurable Clock4 enabled. FALSE: CMU configurable Clock4 is disabled.
            integer GtmCmuConfigClock4Div: 0..16777215, origin=INFINEON_AURIX2G, post-build-variant-value=true, set at post-build, default-value=0  # This parameter specifies the configurable Clock4 divider value
            boolean GtmCmuConfigClock5Enable: origin=INFINEON_AURIX2G, post-build-variant-value=true, set at post-build, default-value=true  # This parameter specifies enable of configurable Clock5. TRUE: CMU configurable Clock5 enabled. FALSE: CMU configurable Clock5 is disabled.
            integer GtmCmuConfigClock5Div: 0..16777215, origin=INFINEON_AURIX2G, post-build-variant-value=true, set at post-build, default-value=0  # This parameter specifies the configurable Clock5 divider value
            boolean GtmCmuConfigClock6Enable: origin=INFINEON_AURIX2G, post-build-variant-value=true, set at post-build, default-value=true  # This parameter specifies enable of configurable Clock6. TRUE: CMU configurable Clock6 enabled. FALSE: CMU configurable Clock6 is disabled.
            integer GtmCmuConfigClock6Div: 0..16777215, origin=INFINEON_AURIX2G, post-build-variant-value=true, set at post-build, default-value=0  # This parameter specifies the configurable Clock6 divider value
            boolean GtmCmuConfigClock7Enable: origin=INFINEON_AURIX2G, post-build-variant-value=true, set at post-build, default-value=true  # This parameter specifies enable of configurable Clock7. TRUE: CMU configurable Clock7 enabled. FALSE: CMU configurable Clock7 is disabled.
            integer GtmCmuConfigClock7Div: 0..16777215, origin=INFINEON_AURIX2G, post-build-variant-value=true, set at post-build, default-value=0  # This parameter specifies the configurable Clock7 divider value
          container GtmExtClockSetting  # This container contains the configuration (parameters) for GTM external clock settings.
            boolean GtmCmuExtClock0Enable: origin=INFINEON_AURIX2G, post-build-variant-value=true, set at post-build, default-value=false  # This parameter specifies if External Clock0 is enabled or not. TRUE : CMU External Clock0 is enabled. FALSE: CMU External Clock0 is disabled.
            integer GtmCmuExtClock0Numerator: 1..16777215, origin=INFINEON_AURIX2G, post-build-variant-value=true, set at post-build, default-value=1  # This parameter specifies the numerator value for external Clock0
            integer GtmCmuExtClock0Denominator: 1..16777215, origin=INFINEON_AURIX2G, post-build-variant-value=true, set at post-build, default-value=1  # This parameter specifies the denominator value for external Clock0
            boolean GtmCmuExtClock1Enable: origin=INFINEON_AURIX2G, post-build-variant-value=true, set at post-build, default-value=false  # This parameter specifies if External Clock1 is enabled or not. TRUE : CMU External Clock1 is enabled. FALSE: CMU External Clock1 is disabled.
            integer GtmCmuExtClock1Numerator: 1..16777215, origin=INFINEON_AURIX2G, post-build-variant-value=true, set at post-build, default-value=1  # This parameter specifies the numerator value for external Clock1
            integer GtmCmuExtClock1Denominator: 1..16777215, origin=INFINEON_AURIX2G, post-build-variant-value=true, set at post-build, default-value=1  # This parameter specifies the denominator value for external Clock1
            boolean GtmCmuExtClock2Enable: origin=INFINEON_AURIX2G, post-build-variant-value=true, set at post-build, default-value=false  # This parameter specifies if External Clock2 is enabled or not. TRUE : CMU External Clock2 is enabled. FALSE: CMU External Clock2 is disabled.
            integer GtmCmuExtClock2Numerator: 1..16777215, origin=INFINEON_AURIX2G, post-build-variant-value=true, set at post-build, default-value=1  # This parameter specifies the numerator value for external Clock2
            integer GtmCmuExtClock2Denominator: 1..16777215, origin=INFINEON_AURIX2G, post-build-variant-value=true, set at post-build, default-value=1  # This parameter specifies the denominator value for external Clock2
        container GtmClusterConf [12..12]  # This container contains the configuration (parameters) for GTM Cluster settings.
          enumeration GtmCmuClusterInputClockDividerEnable: {CLS_CLK_CFG_DISABLED_SEL0, CLS_CLK_CFG_ENABLED_WITHOUT_DIV_SEL1, CLS_CLK_CFG_ENABLED_WITH_DIV_SEL2}, origin=INFINEON_AURIX2G, post-build-variant-value=true, set at post-build, default-value=CLS_CLK_CFG_ENABLED_WITH_DIV_SEL2  # This configuration parameter enables/disables the dividing of fGTM to CMU for cluster-x. CLS_CLK_CFG_DISABLED_SEL0: Cluster x is disabled CLS_CLK_CFG_ENABLED_WITHOUT_DIV_SEL1: Cluster x is enabled without clock divider. CLS_CLK_CFG_ENABLED_WITH_DIV_SEL2: Cluster x is enabled with clock divider. The configuration value CLS0_CLK_DIV defines the primary input clock period for CMU. If CLS0_CLK_DIV is configured to a value 0b10 (i.e. clock divider 2), the maximum CMU clock frequency for all other cluster c=1..n is also limited to configured CMU clock frequency of cluster 0. NOTE: For the Clusters greater than 4, (only 100MHz capable), the allowed settings for the CLS_CLK_DIV are 00 and 10 (clock divider 2).
          container GtmClusterConfClockSetting  # This container contains the configuration (parameters) for GTM cluster clock settings.
            enumeration GtmClusterConfClock0Src: {CMU_CONF_CLOCK0_SEL0, CMU_CONF_CLOCK8_SEL1, EXT_CAPTURE_SEL2}, origin=INFINEON_AURIX2G, post-build-variant-value=true, set at post-build, default-value=CMU_CONF_CLOCK0_SEL0  # The parameter specifies specifies the input clock source for current GTM cluster sub peripheral using configurable Clock0. CMU_CONF_CLOCK0_SEL0: Configurable clock-x is used for clock. CMU_CONF_CLOCK8_SEL1: Configurable clock8 is used for clock. EXT_CAPTURE_SEL2: External capture source is used for clock.
            enumeration GtmClusterConfClock1Src: {CMU_CONF_CLOCK1_SEL0, CMU_CONF_CLOCK8_SEL1, EXT_CAPTURE_SEL2}, origin=INFINEON_AURIX2G, post-build-variant-value=true, set at post-build, default-value=CMU_CONF_CLOCK1_SEL0  # The parameter specifies specifies the input clock source for current GTM cluster sub peripheral using configurable Clock1. CMU_CONF_CLOCK1_SEL0: Configurable clock1 is used for clock. CMU_CONF_CLOCK8_SEL1: Configurable clock8 is used for clock. EXT_CAPTURE_SEL2: External capture source is used for clock.
            enumeration GtmClusterConfClock2Src: {CMU_CONF_CLOCK2_SEL0, CMU_CONF_CLOCK8_SEL1, EXT_CAPTURE_SEL2}, origin=INFINEON_AURIX2G, post-build-variant-value=true, set at post-build, default-value=CMU_CONF_CLOCK2_SEL0  # The parameter specifies specifies the input clock source for current GTM cluster sub peripheral using configurable Clock2. CMU_CONF_CLOCK2_SEL0: Configurable clock1 is used for clock. CMU_CONF_CLOCK8_SEL1: Configurable clock8 is used for clock. EXT_CAPTURE_SEL2: External capture source is used for clock.
            enumeration GtmClusterConfClock3Src: {CMU_CONF_CLOCK3_SEL0, CMU_CONF_CLOCK8_SEL1, EXT_CAPTURE_SEL2}, origin=INFINEON_AURIX2G, post-build-variant-value=true, set at post-build, default-value=CMU_CONF_CLOCK3_SEL0  # The parameter specifies specifies the input clock source for current GTM cluster sub peripheral using configurable Clock3. CMU_CONF_CLOCK3_SEL0: Configurable clock3 is used for clock. CMU_CONF_CLOCK8_SEL1: Configurable clock8 is used for clock. EXT_CAPTURE_SEL2: External capture source is used for clock.
            enumeration GtmClusterConfClock4Src: {CMU_CONF_CLOCK4_SEL0, CMU_CONF_CLOCK8_SEL1, EXT_CAPTURE_SEL2}, origin=INFINEON_AURIX2G, post-build-variant-value=true, set at post-build, default-value=CMU_CONF_CLOCK4_SEL0  # The parameter specifies specifies the input clock source for current GTM cluster sub peripheral using configurable Clock4. CMU_CONF_CLOCK4_SEL0: Configurable clock4 is used for clock. CMU_CONF_CLOCK8_SEL1: Configurable clock8 is used for clock. EXT_CAPTURE_SEL2: External capture source is used for clock.
            enumeration GtmClusterConfClock5Src: {CMU_CONF_CLOCK5_SEL0, CMU_CONF_CLOCK8_SEL1, EXT_CAPTURE_SEL2}, origin=INFINEON_AURIX2G, post-build-variant-value=true, set at post-build, default-value=CMU_CONF_CLOCK5_SEL0  # The parameter specifies specifies the input clock source for current GTM cluster sub peripheral using configurable Clock4. CMU_CONF_CLOCK5_SEL0: Configurable clock5 is used for clock. CMU_CONF_CLOCK8_SEL1: Configurable clock8 is used for clock. EXT_CAPTURE_SEL2: External capture source is used for clock.
            enumeration GtmClusterConfClock6Src: {CMU_CONF_CLOCK6_SEL0, CMU_CONF_CLOCK8_SEL1, EXT_CAPTURE_SEL2}, origin=INFINEON_AURIX2G, post-build-variant-value=true, set at post-build, default-value=CMU_CONF_CLOCK6_SEL0  # The parameter specifies specifies the input clock source for current GTM cluster sub peripheral using configurable Clock6. CMU_CONF_CLOCK6_SEL0: Configurable clock6 is used for clock. CMU_CONF_CLOCK8_SEL1: Configurable clock8 is used for clock. EXT_CAPTURE_SEL2: External capture source is used for clock.
            enumeration GtmClusterConfClock7Src: {CMU_CONF_CLOCK7_SEL0, CMU_CONF_CLOCK8_SEL1, EXT_CAPTURE_SEL2}, origin=INFINEON_AURIX2G, post-build-variant-value=true, set at post-build, default-value=CMU_CONF_CLOCK7_SEL0  # The parameter specifies specifies the input clock source for current GTM cluster sub peripheral using configurable Clock7. CMU_CONF_CLOCK7_SEL0: Configurable clock7 is used for clock. CMU_CONF_CLOCK8_SEL1: Configurable clock8 is used for clock. EXT_CAPTURE_SEL2: External capture source is used for clock.
          container GtmClusterFixedClockSetting  # This container contains the configuration (parameters) for GTM cluster fixed clock settings.
            enumeration GtmClusterFixedClockSrc: {CMU_FIXED_CLOCK0_SEL0, CMU_CONF_CLOCK8_SEL1}, origin=INFINEON_AURIX2G, post-build-variant-value=true, set at post-build, default-value=CMU_FIXED_CLOCK0_SEL0  # The parameter specifies specifies the input clock source for current GTM cluster sub peripheral using fixe Clock. CMU_FIXED_CLOCK0_SEL0: Fixed clock0 is used for clock. CMU_CONF_CLOCK8_SEL1: Configurable clock8 is used for clock. EXT_CAPTURE_SEL2: External capture source is used for clock.
        container GtmTbuChannelConf [4..4]  # This container contains the configuration (parameters) for GTM TBU channel settings.
          boolean GtmTbuChannelEnable: origin=INFINEON_AURIX2G, post-build-variant-value=true, set at post-build, default-value=false  # This parameter specifies enable TBU channel. TRUE: Channel is enabled FALSE: Channel is disabled
          enumeration GtmTbuChClockSourceSelection: {CMU_CLOCK0_SEL0, CMU_CLOCK1_SEL1, CMU_CLOCK2_SEL2, CMU_CLOCK3_SEL3, CMU_CLOCK4_SEL4, CMU_CLOCK5_SEL5, CMU_CLOCK6_SEL6, CMU_CLOCK7_SEL7}, origin=INFINEON_AURIX2G, post-build-variant-value=true, set at post-build, default-value=CMU_CLOCK0_SEL0  # This parameter will defines configurable clock source selection for the corresponding TBU channel. CMU_CLOCK0_SEL0 : Clock0 is selected as source. CMU_CLOCK1_SEL1 : Clock1 is selected as source. CMU_CLOCK2_SEL2 : Clock2 is selected as source. CMU_CLOCK3_SEL3 : Clock3 is selected as source. CMU_CLOCK4_SEL4 : Clock4 is selected as source. CMU_CLOCK5_SEL5 : Clock5 is selected as source. CMU_CLOCK6_SEL6 : Clock6 is selected as source. CMU_CLOCK7_SEL7 : Clock7 is selected as source.
          enumeration GtmTbuChResolutionSel: {TBU_CH_LOWER_COUNT_BITS_SEL0, TBU_CH_UPPER_COUNT_BITS_SEL1}, origin=INFINEON_AURIX2G, post-build-variant-value=true, set at post-build, default-value=TBU_CH_LOWER_COUNT_BITS_SEL0  # This parameter defines the resolution of time base values given by TBU_CH0_BASE. TBU_CH_LOWER_COUNT_BITS_SEL0 : 0 __ 23 bits of TBU_CH0_BASE is considered. TBU_CH_UPPER_COUNT_BITS_SEL1 : 3 __ 26 bits of TBU_CH0_BASE is considered.
          enumeration GtmTbuChMode: {FREE_RUNNING_COUNTER_SEL0, FORWARD_BACKWARD_SEL1}, origin=INFINEON_AURIX2G, post-build-variant-value=true, set at post-build, default-value=FREE_RUNNING_COUNTER_SEL0  # This parameter defines TBU channle run mode. FREE_RUNNING_COUNTER_SEL0 : TBU channel is in free running counter mode. FORWARD_BACKWARD_SEL1 : TBU channel is in forward backward counter mode. (default for TBU channel 3)
          enumeration GtmTbuChModuloCntrSel: {TBU_CH1_SEL0, TBU_CH2_SEL1}, origin=INFINEON_AURIX2G, post-build-variant-value=true, set at post-build, default-value=TBU_CH1_SEL0  # This parameter defines TBU channle run mode. TBU_CH1_SEL0 : TBU_CH1 values used. TBU_CH2_SEL1 : TBU_CH2 values used.
        container GtmTomGlobalConf [6..6]  # This container contains the configuration (parameters) for GTM TOM unit global settings.
          container GtmTomGroupConf [2..2]  # This container contains the configuration (parameters) for GTM TOM group settings.
            container GtmTomActionTimeBaseUnitConf  # This container contains the configuration (parameters) for GTM TOM group time base settings.
              enumeration GtmTomActionTimeBaseSelection: {TOM_ACT_TB_TBU_TS0, TOM_ACT_TB_TBU_TS1, TOM_ACT_TB_TBU_TS2}, origin=INFINEON_AURIX2G, post-build-variant-value=true, set at post-build, default-value=TOM_ACT_TB_TBU_TS0  # This parameter specifies time base selected to compare with value configured in GtmTomActionTimeBaseValue. TOM_ACT_TB_TBU_TS0 : TBU_TS0 is used as reference time base for TOM group. TOM_ACT_TB_TBU_TS1 : TBU_TS1 is used as reference time base for TOM group. TOM_ACT_TB_TBU_TS2 : TBU_TS2 is used as reference time base for TOM group.
              integer GtmTomActionTimeBaseValue: 1..16777215, origin=INFINEON_AURIX2G, post-build-variant-value=true, set at post-build, default-value=1  # This parameter specifies the time base value for TOM group channel level trigger
          container GtmTomChannelConf [16..16]  # This container contains the configuration (parameters) for GTM TOM channel settings.
            boolean GtmTomChResetCn0OnTriggerEnable: origin=INFINEON_AURIX2G, post-build-variant-value=true, set at post-build, default-value=false  # This parameter specifies enables/disables Tom channel counter Cn0 value is reset on global trigger from any of the trigger sources. TRUE: Resetting of Tom channel Cn0 on global trigger from any trigger source is enabled. FALSE: Resetting of Tom channel Cn0 on global trigger from any trigger source is disabled.
            boolean GtmTomChInternalTriggerEnable: origin=INFINEON_AURIX2G, post-build-variant-value=true, set at post-build, default-value=false  # This parameter specifies enables/disables internal trigger from channel 0 of the corresponding group channel number. TRUE: Enable internal trigger from channel 0 or 8 (based on the TGC a channel belong to). FALSE: Disable internal trigger from channel 0 or 8 (based on the TGC a channel belong to)
        container GtmAtomGlobalConf [12..12]  # This container contains the configuration (parameters) for GTM ATOM unit global settings.
          container GtmAtomGroupConf  # This container contains the configuration (parameters) for GTM ATOM group settings.
            container GtmAtomActionTimeBaseUnitConf  # This container contains the configuration (parameters) for GTM ATOM group time base settings.
              enumeration GtmAtomActionTimeBaseSelection: {ATOM_ACT_TB_TBU_TS0, ATOM_ACT_TB_TBU_TS1, ATOM_ACT_TB_TBU_TS2}, origin=INFINEON_AURIX2G, post-build-variant-value=true, set at post-build, default-value=ATOM_ACT_TB_TBU_TS0  # This parameter specifies time base selected to compare with value configured in GtmAtomActionTimeBaseValue. ATOM_ACT_TB_TBU_TS0 : TBU_TS0 is used as reference time base for ATOM group. ATOM_ACT_TB_TBU_TS1 : TBU_TS1 is used as reference time base for ATOM group. ATOM_ACT_TB_TBU_TS2 : TBU_TS2 is used as reference time base for ATOM group.
              integer GtmAtomActionTimeBaseValue: 1..16777215, origin=INFINEON_AURIX2G, post-build-variant-value=true, set at post-build, default-value=1  # This parameter specifies the time base value for ATOM group channel level trigger
          container GtmAtomChannelConf [8..8]  # This container contains the configuration (parameters) for GTM ATOM channel common settings.
            boolean GtmAtomChResetCn0OnTriggerEnable: origin=INFINEON_AURIX2G, post-build-variant-value=true, set at post-build, default-value=false  # This parameter specifies enables/disables Atom channel counter Cn0 value is reset on global trigger from any of the trigger sources. TRUE: Resetting of Atom channel Cn0 on global trigger from any trigger source is enabled. FALSE: Resetting of Atom channel Cn0 on global trigger from any trigger source is disabled.
            boolean GtmAtomChInternalTriggerEnable: origin=INFINEON_AURIX2G, post-build-variant-value=true, set at post-build, default-value=false  # This parameter specifies enables/disables internal trigger from channel 0 of the corresponding group channel number. TRUE: Enable internal trigger from channel 0 or 8 (based on the AGC a channel belong to). FALSE: Disable internal trigger from channel 0 or 8 (based on the AGC a channel belong to)
        container GtmTriggerForAdc [12..12]  # This Specifies the TOM/ATOM channels that can be used as ADC Triggers
          enumeration GtmAdcTrigger{0..4}Select: {TRIG_0_NO_TRIGGER, TRIG_1, TRIG_2, TRIG_3, TRIG_4, TRIG_5, TRIG_6, TRIG_7, TRIG_8, TRIG_9, TRIG_10, TRIG_11, TRIG_12, TRIG_13, TRIG_14, TRIG_15}, origin=INFINEON_AURIX2G, post-build-variant-value=true, set at post-build, default-value=TRIG_0_NO_TRIGGER  # This parameter defines the GTM timer (TOM/ATOM) channel controlling the adc_trig{0..4} signal. TRIG_'VAL'_NO_TRIGGER indicating that this trigger line is electrically disconnected from possible trigger sources. TRIG_'VAL' - 'VAL' is the value programmed into the register. TOMx/ATOMx is the module containing Channel which generates the trigger.
    container McuHardwareResourceAllocationConf  # Mcu Hardware resource allocation configuration
      container McuGtmAllocationConf  # Mcu GTM unit resource allocation configuration
        container McuGtmTimAllocationConf [8..8]  # This container contains the TIM Configuration for GTM
          container McuGtmTimChannelAllocationConf [8..8]  # This container contains the TIM Channel Configuration
            enumeration McuGtmTimChannelAllocationConf: {GTM_TIM_CHANNEL_NOT_USED, GTM_TIM_CHANNEL_USED_BY_ICU}, origin=INFINEON_AURIX2G, set at pre-compile, default-value=GTM_TIM_CHANNEL_NOT_USED  # This decides as to if this Channel is used for ICU or will it not be used. GTM_TIM_CHANNEL_NOT_USED: Specifies that this Channel is not configured by any module (unused). GTM_TIM_CHANNEL_USED_BY_ICU: Specifies that this Channel is configured by ICU module.
        container McuGtmTomAllocationConf [6..6]  # This container contains the TOM Configuration for GTM
          container McuGtmTomChannelAllocationConf [16..16]  # This container contains the TOM Channel Configuration
            enumeration McuGtmTomChannelAllocationConf: {GTM_TOM_CHANNEL_NOT_USED, GTM_TOM_CHANNEL_USED_BY_ADC, GTM_TOM_CHANNEL_USED_BY_WDG, GTM_TOM_CHANNEL_USED_BY_PWM, GTM_TOM_CHANNEL_USED_BY_GPT, GTM_TOM_CHANNEL_USED_BY_OCU, GTM_TOM_CHANNEL_USED_BY_DSADC}, origin=INFINEON_AURIX2G, set at pre-compile, default-value=GTM_TOM_CHANNEL_NOT_USED  # This decides as to if this Channel is used or will it not be used. GTM_TOM_CHANNEL_NOT_USED: Specifies that this Channel is not configured by any module (unused). GTM_TOM_CHANNEL_USED_BY_ADC: Specifies that this Channel is configured by ADC module. GTM_TOM_CHANNEL_USED_BY_WDG: Specifies that this Channel is configured by WDG module. GTM_TOM_CHANNEL_USED_BY_PWM: Specifies that this Channel is configured by PWM module. GTM_TOM_CHANNEL_USED_BY_GPT: Specifies that this Channel is configured by GPT module. GTM_TOM_CHANNEL_USED_BY_OCU: Specifies that this Channel is configured by OCU module. GTM_TOM_CHANNEL_USED_BY_DSADC: Specifies that this Channel is configured by DSADC module.
        container McuGtmAtomAllocationConf [12..12]  # This container contains the ATOM Configuration for GTM
          container McuGtmAtomChannelAllocationConf [8..8]  # This container contains the ATOM Channel Configuration
            enumeration McuGtmAtomChannelAllocationConf: {GTM_ATOM_CHANNEL_NOT_USED, GTM_ATOM_CHANNEL_USED_BY_ADC, GTM_ATOM_CHANNEL_USED_BY_DSADC, GTM_ATOM_CHANNEL_USED_BY_GPT, GTM_ATOM_CHANNEL_USED_BY_OCU, GTM_ATOM_CHANNEL_USED_BY_PWM, GTM_ATOM_CHANNEL_USED_BY_WDG}, origin=INFINEON_AURIX2G, set at pre-compile, default-value=GTM_ATOM_CHANNEL_NOT_USED  # This decides as to if this Channel is used or will it not be used. GTM_ATOM_CHANNEL_NOT_USED: Specifies that this Channel is not configured by any module (unused). GTM_ATOM_CHANNEL_USED_BY_ADC: Specifies that this Channel is configured by ADC module. GTM_ATOM_CHANNEL_USED_BY_DSADC: Specifies that this Channel is configured by DSADC module. GTM_ATOM_CHANNEL_USED_BY_GPT: Specifies that this Channel is configured by GPT module. GTM_ATOM_CHANNEL_USED_BY_OCU: Specifies that this Channel is configured by OCU module. GTM_ATOM_CHANNEL_USED_BY_PWM: Specifies that this Channel is configured by PWM module. GTM_ATOM_CHANNEL_USED_BY_WDG: Specifies that this Channel is configured by WDG module.
      container McuAscLinAllocationConf [12..12]  # This container contains the AscLin Configuration
        container McuAscLinChannelAllocationConf  # This container defines the AscLin Channel Configuration
          enumeration McuAscLinChannelAllocationConf: {ASCLIN_CH_NOT_USED, ASCLIN_CH_USED_BY_LIN_DRIVER, ASCLIN_CH_USED_BY_UART_DRIVER, ASCLIN_CH_USED_BY_STDLIN_DRIVER}, origin=INFINEON_AURIX2G, set at pre-compile, default-value=ASCLIN_CH_NOT_USED  # This decides the usage of ASCLIN channel. This parameter is currently disabled, as none of the drivers are using ASCLIN channels. ASCLIN_CH_NOT_USED: Specifies that this Channel is not configured by any module (unused). ASCLIN_CH_USED_BY_LIN_DRIVER: Specifies that this Channel is configured by LIN module. ASCLIN_CH_USED_BY_UART_DRIVER: Specifies that this Channel is configured by UART module. ASCLIN_CH_USED_BY_STDLIN_DRIVER: Specifies that this Channel is configured by STDLIN module.
      container McuCcu6ModuleAllocationConf [2..2]  # This container contains the Ccu6 Configuration
        enumeration McuCcu6ModuleAllocationConf: {CCU6_MODULE_NOT_USED, CCU6_MODULE_USED_BY_ADC_DRIVER, CCU6_MODULE_USED_BY_ICU_DRIVER, CCU6_MODULE_USED_BY_PWM_DRIVER}, origin=INFINEON_AURIX2G, set at pre-compile, default-value=CCU6_MODULE_NOT_USED  # This decides the usage of CCU6 module. CCU6_MODULE_NOT_USED: Specifies that this Channel is not configured by any module (unused). CCU6_MODULE_USED_BY_ADC_DRIVER: Specifies that this Module is configured by ADC module. CCU6_MODULE_USED_BY_ICU_DRIVER: Specifies that this Module is configured by ICU module. CCU6_MODULE_USED_BY_PWM_DRIVER: Specifies that this Module is configured by PWM module.
      container McuGpt12ModuleAllocationConf [2..2]  # This container contains the GPT12 Configuration
        enumeration McuGpt12ModuleAllocationConf: {GPT_BLOCK_NOT_USED, GPT_BLOCK_USED_BY_ICU_DRIVER}, origin=INFINEON_AURIX2G, set at pre-compile, default-value=GPT_BLOCK_NOT_USED  # This decides the usage of GPT block. GPT_BLOCK_NOT_USED: Specifies that this Channel is not configured by any module (unused). GPT_BLOCK_USED_BY_ICU_DRIVER: Specifies that this Module is configured by ICU module. Note: McuGpt12ModuleAllocationConf_0 corresponds to GPT1 block, McuGpt12ModuleAllocationConf_1 corresponds to GPT2 block.
      container McuEruAllocationConf  # This container contains the ERU module configurations
        container McuEruChannelInputLineConf [8..8]  # This container contains the ERU input line Configuration
          enumeration McuEruChannelInputLineConf: {ERU_CHANNEL_INP_NOT_USED, ERU_CHANNEL_INP_USED_BY_ADC_DRIVER, ERU_CHANNEL_INP_USED_BY_DSADC_DRIVER, ERU_CHANNEL_INP_USED_BY_ICU_DRIVER, ERU_CHANNEL_INP_USED_BY_OCU_DRIVER}, origin=INFINEON_AURIX2G, set at pre-compile, default-value=ERU_CHANNEL_INP_NOT_USED  # This decides usage of ERU input channel. ERU_CHANNEL_INP_NOT_USED: Specifies that this Channel is not configured by any module (unused). ERU_CHANNEL_INP_USED_BY_ADC_DRIVER: Specifies that this Channel is configured by ADC module. ERU_CHANNEL_INP_USED_BY_ICU_DRIVER: Specifies that this Channel is configured by ICU module. ERU_CHANNEL_INP_USED_BY_DSADC_DRIVER: Specifies that this Channel is configured by DSADC module. ERU_CHANNEL_INP_USED_BY_OCU_DRIVER: Specifies that this Channel is configured by OCU module.
        container McuEruChannelOutputUnitConf [8..8]  # This container contains the ERU output line Configuration
          enumeration McuEruChannelOutputUnitConf: {ERU_CHANNEL_OUT_NOT_USED, ERU_CHANNEL_OUT_USED_BY_ADC_DRIVER, ERU_CHANNEL_OUT_USED_BY_ICU_DRIVER, ERU_CHANNEL_OUT_USED_BY_OCU_DRIVER, ERU_CHANNEL_OUT_USED_BY_DSADC_DRIVER}, origin=INFINEON_AURIX2G, set at pre-compile, default-value=ERU_CHANNEL_OUT_NOT_USED  # This decides the usage of ERU output channel. ERU_CHANNEL_OUT_NOT_USED: Specifies that this Channel is not configured by any module (unused). ERU_CHANNEL_OUT_USED_BY_ADC_DRIVER: Specifies that this Channel is configured by ADC module. ERU_CHANNEL_OUT_USED_BY_ICU_DRIVER: Specifies that this Channel is configured by ICU module. ERU_CHANNEL_OUT_USED_BY_OCU_DRIVER: Specifies that this Channel is configured by OCU module. ERU_CHANNEL_OUT_USED_BY_DSADC_DRIVER: Specifies that this Channel is configured by DSADC module.
      container McuStmAllocationConf [6..6]  # Mcu STM resource allocation configuration
        enumeration McuStmCmp0RegAllocationConf: {STM_CMP0_NOT_USED, STM_CMP0_USED_BY_WDG, STM_CMP0_USED_BY_STM}, origin=INFINEON_AURIX2G, set at pre-compile, default-value=STM_CMP0_NOT_USED  # The STM timer compare register 0 usage. STM_CMP0_NOT_USED: STM timer compare register 0 not used. STM_CMP0_USED_BY_WDG: STM timer compare register 0 used by WDG. STM_CMP0_USED_BY_STM: STM timer compare register 0 used by STM.
        enumeration McuStmCmp1RegAllocationConf: {STM_CMP1_NOT_USED, STM_CMP1_USED_BY_WDG, STM_CMP1_USED_BY_STM}, origin=INFINEON_AURIX2G, set at pre-compile, default-value=STM_CMP1_NOT_USED  # The STM timer compare register 1 usage. STM_CMP1_NOT_USED: STM timer compare register 1 not used. STM_CMP1_USED_BY_WDG: STM timer compare register 1 used by WDG. STM_CMP1_USED_BY_STM: STM timer compare register 1 used by STM.
    container McuDemEventParameterRefsConf [0..1]: multiplicity set at pre-compile  # Container for the references to DemEventParameter elements which shall be invoked using the API Dem_ReportErrorStatus API in case the corresponding error occurs. The EventId is taken from the referenced DemEventParameter's DemEventId symbolic name. The standardized errors are provided in the container and can be extended by vendor specific error references.
      symbolic name reference MCU_E_OSC_FAILURE [0..1]: multiplicity set at pre-compile, origin=INFINEON_AURIX2G, set at pre-compile, destination=DemEventParameter  # Reference to the DemEventParameter which shall be raised on Oscillator Failure
      symbolic name reference MCU_E_SYSTEM_PLL_TIMEOUT_ERR [0..1]: multiplicity set at pre-compile, origin=INFINEON_AURIX2G, set at pre-compile, destination=DemEventParameter  # Reference to the DemEventParameter which is raised due to inability of System PLL K2 divider and power mode to be updated within the specified time.
      symbolic name reference MCU_E_PERIPHERAL_PLL_TIMEOUT_ERR [0..1]: multiplicity set at pre-compile, origin=INFINEON_AURIX2G, set at pre-compile, destination=DemEventParameter  # Reference to the DemEventParameter which shall be raised due to inability of Peripheral PLL K2/K3 dividers and power mode to be updated within the specified time.
      symbolic name reference MCU_E_SYSTEM_PLL_LOCK_LOSS [0..1]: multiplicity set at pre-compile, origin=INFINEON_AURIX2G, set at pre-compile, destination=DemEventParameter  # Reference to the DemEventParameter which shall be raised on system PLL lock loss
      symbolic name reference MCU_E_PERIPHERAL_PLL_LOCK_LOSS [0..1]: multiplicity set at pre-compile, origin=INFINEON_AURIX2G, set at pre-compile, destination=DemEventParameter  # Reference to the DemEventParameter which shall be raised on peripheral PLL lock loss
      symbolic name reference MCU_E_GTM_CLC_ENABLE_ERR [0..1]: multiplicity set at pre-compile, origin=INFINEON_AURIX2G, set at pre-compile, destination=DemEventParameter  # Reference to the DemEventParameter which shall be raised on GTM - CLC enable error
      symbolic name reference MCU_E_GTM_CLC_DISABLE_ERR [0..1]: multiplicity set at pre-compile, origin=INFINEON_AURIX2G, set at pre-compile, destination=DemEventParameter  # Reference to the DemEventParameter which shall be raised on GTM - CLC disable error
      symbolic name reference MCU_E_CONVCTRL_CLC_ENABLE_ERR [0..1]: multiplicity set at pre-compile, origin=INFINEON_AURIX2G, set at pre-compile, destination=DemEventParameter  # Reference to the DemEventParameter which shall be raised on CONVCTRL - CLC enable error
      symbolic name reference MCU_E_CONVCTRL_CLC_DISABLE_ERR [0..1]: multiplicity set at pre-compile, origin=INFINEON_AURIX2G, set at pre-compile, destination=DemEventParameter  # Reference to the DemEventParameter which shall be raised on CONVCTRL - CLC disable error
      symbolic name reference MCU_E_CCUCON_UPDATE_ERR [0..1]: multiplicity set at pre-compile, origin=INFINEON_AURIX2G, set at pre-compile, destination=DemEventParameter  # Reference to the DemEventParameter which shall be raised on CCUCON register update inability error
      symbolic name reference MCU_E_CCU6_CLC_ENABLE_ERR [0..1]: multiplicity set at pre-compile, origin=INFINEON_AURIX2G, set at pre-compile, destination=DemEventParameter  # Reference to the DemEventParameter which shall be raised on CCU6 kernel - CLC enable error
      symbolic name reference MCU_E_CCU6_CLC_DISABLE_ERR [0..1]: multiplicity set at pre-compile, origin=INFINEON_AURIX2G, set at pre-compile, destination=DemEventParameter  # Reference to the DemEventParameter which shall be raised on CCU6 kernel - CLC disable error
      symbolic name reference MCU_E_GPT12_CLC_ENABLE_ERR [0..1]: multiplicity set at pre-compile, origin=INFINEON_AURIX2G, set at pre-compile, destination=DemEventParameter  # Reference to the DemEventParameter which shall be raised on GPT12 module - CLC enable error
      symbolic name reference MCU_E_GPT12_CLC_DISABLE_ERR [0..1]: multiplicity set at pre-compile, origin=INFINEON_AURIX2G, set at pre-compile, destination=DemEventParameter  # Reference to the DemEventParameter which shall be raised on GPT12 module - CLC disable error
      symbolic name reference MCU_E_PMSWCR_UPDATE_ERR [0..1]: multiplicity set at pre-compile, origin=INFINEON_AURIX2G, set at pre-compile, destination=DemEventParameter  # Reference to the DemEventParameter which shall be raised on PMSWCR register, when this register is BUSY and cannot be written before the specified time elapses.
    container CommonPublishedInformation  # Common container, aggregated by all modules. It contains published information about vendor and versions.
      integer ArMajorVersion: 0..65535, origin=INFINEON_AURIX2G, set at published-information, default-value=4  # Major version number of AUTOSAR specification on which the appropriate implementation is based on.
      integer ArMinorVersion: 0..65535, origin=INFINEON_AURIX2G, set at published-information, default-value=2  # Minor version number of AUTOSAR specification on which the appropriate implementation is based on.
      integer ArPatchVersion: 0..65535, origin=INFINEON_AURIX2G, set at published-information, default-value=2  # Patch level version number of AUTOSAR specification on which the appropriate implementation is based on.
      integer SwMajorVersion: 0..65535, origin=INFINEON_AURIX2G, set at published-information, default-value=4  # Major version number of the vendor specific implementation of the module. The numbering is vendor specific.
      integer SwMinorVersion: 0..65535, origin=INFINEON_AURIX2G, set at published-information, default-value=0  # Minor version number of the vendor specific implementation of the module. The numbering is vendor specific.
      integer SwPatchVersion: 0..65535, origin=INFINEON_AURIX2G, set at published-information, default-value=0  # Patch level version number of the vendor specific implementation of the module. The numbering is vendor specific.
      integer ModuleId: 0..65535, origin=INFINEON_AURIX2G, set at published-information, default-value=101  # Module ID of this module from Module List
      integer VendorId: 0..65535, origin=INFINEON_AURIX2G, set at published-information, default-value=17  # Vendor ID of the dedicated implementation of this module according to the AUTOSAR vendor list
      string Release: origin=INFINEON_AURIX2G, set at published-information, default-value=_TRICORE_TC397  # AURIX2G derivative used for the implementation
    container McuPublishedInformation  # Container holding all MCU specific published information parameters
      container McuResetReasonConf [21..21]  # This container contains the configuration for the different type of reset reason that can be retrieved from Mcu_GetResetReason Api.
        integer McuResetReason: 0..255, scope=ECU, set at published-information, symbolic-name-value=true, default-value=0  # The parameter represents the different type of reset that the controller supports. This parameter is referenced by the parameter EcuMResetReason in the ECU State manager module.
