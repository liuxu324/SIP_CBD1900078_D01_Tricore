AUTOSAR XML (schema 4-2-2)
package /AURIX2G/EcucDefs
  module config Spi_Rec: definition=Spi
  bsw implementation Spi_Impl: programming-language=C, behavior=SpiBehavior, recommended-configuration=Spi_Rec, vendor-specific-module-def=Spi
