AUTOSAR XML (schema 4-2-2)
package /AURIX2G/EcucDefs
  module config Irq_Rec: definition=Irq
  bsw implementation Irq_Impl: programming-language=C, behavior=IrqBehavior, recommended-configuration=Irq_Rec, vendor-specific-module-def=Irq
