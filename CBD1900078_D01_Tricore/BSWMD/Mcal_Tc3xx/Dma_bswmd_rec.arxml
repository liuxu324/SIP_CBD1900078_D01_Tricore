AUTOSAR XML (schema 4-2-2)
package /AURIX2G/EcucDefs
  module config Dma_Rec: definition=Dma
  bsw implementation Dma_Impl: programming-language=C, behavior=DmaBehavior, recommended-configuration=Dma_Rec, vendor-specific-module-def=Dma
