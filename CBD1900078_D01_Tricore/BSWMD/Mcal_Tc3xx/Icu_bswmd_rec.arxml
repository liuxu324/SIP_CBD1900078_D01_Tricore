AUTOSAR XML (schema 4-2-2)
package /AURIX2G/EcucDefs
  module config Icu_Rec: definition=Icu
  bsw implementation Icu_Impl: programming-language=C, vendor-id=17, behavior=IcuBehavior, recommended-configuration=Icu_Rec, vendor-api-infix=TimerIp, vendor-specific-module-def=Icu
