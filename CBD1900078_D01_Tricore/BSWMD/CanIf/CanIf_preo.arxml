AUTOSAR XML (schema 4-0-3)
package /MICROSAR
  module config CanIf_Pre: definition=CanIf
