AUTOSAR XML (schema 4-0-3)
package /MICROSAR
  module config Rte_Rec: definition=Rte, implementation-config-variant=VARIANT-PRE-COMPILE
